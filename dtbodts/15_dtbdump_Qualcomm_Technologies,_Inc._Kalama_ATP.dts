/dts-v1/;

/ {
	compatible = "qcom,kalama-atp", "qcom,kalama", "qcom,atp";
	model = "Qualcomm Technologies, Inc. Kalama ATP";
	qcom,board-id = <0x10021 0x0>;
	qcom,msm-id = <0x258 0x20000 0x259 0x20000>;

	__fixups__ {
		APC1_pause = "/fragment@14/__overlay__/socd/cooling-maps/socd_apc1:cooling-device:0", "/fragment@14/__overlay__/pm8550vs_c_tz/cooling-maps/pm8550vs_c_apc1:cooling-device:0", "/fragment@14/__overlay__/xo-therm/cooling-maps/apc1_cdev:cooling-device:0";
		L10B = "/fragment@13/__overlay__/regulator-ocp-notifier:periph-1ca-supply:0";
		L11B = "/fragment@13/__overlay__/regulator-ocp-notifier:periph-1cb-supply:0";
		L12B = "/fragment@13/__overlay__/regulator-ocp-notifier:periph-1cc-supply:0", "/fragment@19/__overlay__/goodix-berlin@5d:iovdd-supply:0";
		L13B = "/fragment@13/__overlay__/regulator-ocp-notifier:periph-1cd-supply:0";
		L14B = "/fragment@13/__overlay__/regulator-ocp-notifier:periph-1ce-supply:0", "/fragment@19/__overlay__/goodix-berlin@5d:avdd-supply:0";
		L15B = "/fragment@13/__overlay__/regulator-ocp-notifier:periph-1cf-supply:0";
		L16B = "/fragment@13/__overlay__/regulator-ocp-notifier:periph-1d0-supply:0";
		L17B = "/fragment@13/__overlay__/regulator-ocp-notifier:periph-1d1-supply:0";
		L1B = "/fragment@13/__overlay__/regulator-ocp-notifier:periph-1c1-supply:0";
		L1C = "/fragment@13/__overlay__/regulator-ocp-notifier:periph-2c1-supply:0";
		L1D = "/fragment@13/__overlay__/regulator-ocp-notifier:periph-3c1-supply:0";
		L1E = "/fragment@13/__overlay__/regulator-ocp-notifier:periph-4c1-supply:0";
		L1F = "/fragment@13/__overlay__/regulator-ocp-notifier:periph-5c1-supply:0";
		L1G = "/fragment@13/__overlay__/regulator-ocp-notifier:periph-6c1-supply:0";
		L1K = "/fragment@13/__overlay__/regulator-ocp-notifier:periph-ac1-supply:0";
		L1M = "/fragment@13/__overlay__/regulator-ocp-notifier:periph-c40-supply:0";
		L1N = "/fragment@13/__overlay__/regulator-ocp-notifier:periph-d40-supply:0";
		L2B = "/fragment@13/__overlay__/regulator-ocp-notifier:periph-1c2-supply:0";
		L2D_LEVEL = "/fragment@13/__overlay__/regulator-ocp-notifier:periph-3c2-supply:0";
		L2E = "/fragment@13/__overlay__/regulator-ocp-notifier:periph-4c2-supply:0";
		L2F = "/fragment@13/__overlay__/regulator-ocp-notifier:periph-5c2-supply:0";
		L2G = "/fragment@13/__overlay__/regulator-ocp-notifier:periph-6c2-supply:0";
		L2K = "/fragment@13/__overlay__/regulator-ocp-notifier:periph-ac2-supply:0";
		L2M = "/fragment@13/__overlay__/regulator-ocp-notifier:periph-c41-supply:0";
		L2N = "/fragment@13/__overlay__/regulator-ocp-notifier:periph-d41-supply:0";
		L3C = "/fragment@13/__overlay__/regulator-ocp-notifier:periph-2c3-supply:0";
		L3E = "/fragment@13/__overlay__/regulator-ocp-notifier:periph-4c3-supply:0";
		L3F = "/fragment@13/__overlay__/regulator-ocp-notifier:periph-5c3-supply:0";
		L3G = "/fragment@13/__overlay__/regulator-ocp-notifier:periph-6c3-supply:0";
		L3K = "/fragment@13/__overlay__/regulator-ocp-notifier:periph-ac3-supply:0";
		L3L = "/fragment@13/__overlay__/regulator-ocp-notifier:periph-bc3-supply:0";
		L3M = "/fragment@13/__overlay__/regulator-ocp-notifier:periph-c42-supply:0";
		L3N = "/fragment@13/__overlay__/regulator-ocp-notifier:periph-d42-supply:0";
		L4K = "/fragment@13/__overlay__/regulator-ocp-notifier:periph-ac4-supply:0";
		L4L = "/fragment@13/__overlay__/regulator-ocp-notifier:periph-bc4-supply:0";
		L4M = "/fragment@13/__overlay__/regulator-ocp-notifier:periph-c43-supply:0";
		L4N = "/fragment@13/__overlay__/regulator-ocp-notifier:periph-d43-supply:0";
		L5B = "/fragment@13/__overlay__/regulator-ocp-notifier:periph-1c5-supply:0";
		L5K = "/fragment@13/__overlay__/regulator-ocp-notifier:periph-ac5-supply:0";
		L5L = "/fragment@13/__overlay__/regulator-ocp-notifier:periph-bc5-supply:0";
		L5M = "/fragment@13/__overlay__/regulator-ocp-notifier:periph-c44-supply:0";
		L5N = "/fragment@13/__overlay__/regulator-ocp-notifier:periph-d44-supply:0";
		L6B = "/fragment@13/__overlay__/regulator-ocp-notifier:periph-1c6-supply:0";
		L6K = "/fragment@13/__overlay__/regulator-ocp-notifier:periph-ac6-supply:0";
		L6L = "/fragment@13/__overlay__/regulator-ocp-notifier:periph-bc6-supply:0";
		L6M = "/fragment@13/__overlay__/regulator-ocp-notifier:periph-c45-supply:0";
		L6N = "/fragment@13/__overlay__/regulator-ocp-notifier:periph-d45-supply:0";
		L7B = "/fragment@13/__overlay__/regulator-ocp-notifier:periph-1c7-supply:0";
		L7K = "/fragment@13/__overlay__/regulator-ocp-notifier:periph-ac7-supply:0";
		L7L = "/fragment@13/__overlay__/regulator-ocp-notifier:periph-bc7-supply:0";
		L7M = "/fragment@13/__overlay__/regulator-ocp-notifier:periph-c46-supply:0";
		L7N = "/fragment@13/__overlay__/regulator-ocp-notifier:periph-d46-supply:0";
		L8B = "/fragment@13/__overlay__/regulator-ocp-notifier:periph-1c8-supply:0";
		L9B = "/fragment@13/__overlay__/regulator-ocp-notifier:periph-1c9-supply:0";
		battery_charger = "/fragment@23:target:0";
		cdsp_sw = "/fragment@14/__overlay__/socd/cooling-maps/socd_cdsp1:cooling-device:0", "/fragment@14/__overlay__/pm8550b-bcl-lvl0/cooling-maps/lbat_cdsp0:cooling-device:0", "/fragment@14/__overlay__/pm8550b-bcl-lvl1/cooling-maps/lbat_cdsp1:cooling-device:0", "/fragment@14/__overlay__/pm8550b-bcl-lvl2/cooling-maps/lbat_cdsp2:cooling-device:0", "/fragment@14/__overlay__/pm8550-bcl-lvl0/cooling-maps/vph_cdsp0:cooling-device:0", "/fragment@14/__overlay__/pm8550-bcl-lvl1/cooling-maps/vph_cdsp1:cooling-device:0", "/fragment@14/__overlay__/pm8550-bcl-lvl2/cooling-maps/vph_cdsp2:cooling-device:0", "/fragment@14/__overlay__/pm8550ve_f_tz/cooling-maps/pm8550vs_e_nsp:cooling-device:0", "/fragment@14/__overlay__/xo-therm/cooling-maps/cdsp_cdev:cooling-device:0";
		cpu3_hotplug = "/fragment@14/__overlay__/xo-therm/cooling-maps/cpu3_hot_cdev:cooling-device:0";
		cpu4_hotplug = "/fragment@14/__overlay__/xo-therm/cooling-maps/cpu4_hot_cdev:cooling-device:0";
		cpu5_hotplug = "/fragment@14/__overlay__/xo-therm/cooling-maps/cpu5_hot_cdev:cooling-device:0";
		cpu6_hotplug = "/fragment@14/__overlay__/xo-therm/cooling-maps/cpu6_hot_cdev:cooling-device:0";
		cpu7_hotplug = "/fragment@14/__overlay__/xo-therm/cooling-maps/cpu7_hot_cdev:cooling-device:0";
		cpu_3_4_5_pause = "/fragment@14/__overlay__/pm8550b-bcl-lvl0/cooling-maps/lbat_cpu_3_4_5:cooling-device:0", "/fragment@14/__overlay__/pm8550-bcl-lvl0/cooling-maps/vph_cpu_3_4_5:cooling-device:0";
		cpu_6_7_pause = "/fragment@14/__overlay__/pm8550b-bcl-lvl1/cooling-maps/lbat_cpu_6_7:cooling-device:0", "/fragment@14/__overlay__/pm8550-bcl-lvl1/cooling-maps/vph_cpu_6_7:cooling-device:0";
		display_fps = "/fragment@14/__overlay__/xo-therm/cooling-maps/display_cdev1:cooling-device:0", "/fragment@14/__overlay__/xo-therm/cooling-maps/display_cdev2:cooling-device:0", "/fragment@14/__overlay__/xo-therm/cooling-maps/display_cdev3:cooling-device:0", "/fragment@14/__overlay__/xo-therm/cooling-maps/display_cdev4:cooling-device:0";
		eusb2_phy0 = "/fragment@20:target:0";
		gcc = "/fragment@15/__overlay__:resets:0", "/fragment@18/__overlay__:resets:0";
		gcc_ufs_mem_phy_gdsc = "/fragment@17/__overlay__:vdd-phy-gdsc-supply:0";
		gcc_ufs_phy_gdsc = "/fragment@18/__overlay__:vdd-hba-supply:0";
		modem_lte_dsc = "/fragment@14/__overlay__/pm8550b-bcl-lvl0/cooling-maps/lbat_0_mdm_lte:cooling-device:0", "/fragment@14/__overlay__/pm8550b-bcl-lvl1/cooling-maps/lbat_1_mdm_lte:cooling-device:0", "/fragment@14/__overlay__/pm8550-bcl-lvl0/cooling-maps/vph_lte0:cooling-device:0", "/fragment@14/__overlay__/pm8550-bcl-lvl1/cooling-maps/vph_lte1:cooling-device:0", "/fragment@14/__overlay__/pm8550ve_f_tz/cooling-maps/pm8550vs_e_lte:cooling-device:0", "/fragment@14/__overlay__/xo-therm/cooling-maps/lte_cdev:cooling-device:0";
		modem_nr_dsc = "/fragment@14/__overlay__/pm8550b-bcl-lvl0/cooling-maps/lbat_0_nr:cooling-device:0", "/fragment@14/__overlay__/pm8550b-bcl-lvl1/cooling-maps/lbat_1_nr:cooling-device:0", "/fragment@14/__overlay__/pm8550-bcl-lvl0/cooling-maps/vph_nr0:cooling-device:0", "/fragment@14/__overlay__/pm8550-bcl-lvl1/cooling-maps/vph_nr1:cooling-device:0";
		modem_nr_scg_dsc = "/fragment@14/__overlay__/pm8550b-bcl-lvl0/cooling-maps/lbat_0_nr_scg:cooling-device:0", "/fragment@14/__overlay__/pm8550b-bcl-lvl1/cooling-maps/lbat_1_nr_scg:cooling-device:0", "/fragment@14/__overlay__/pm8550-bcl-lvl0/cooling-maps/vph_nr0_scg:cooling-device:0", "/fragment@14/__overlay__/pm8550-bcl-lvl1/cooling-maps/vph_nr1_scg:cooling-device:0", "/fragment@14/__overlay__/pm8550ve_f_tz/cooling-maps/pm8550vs_e_nr:cooling-device:0", "/fragment@14/__overlay__/xo-therm/cooling-maps/nr_cdev:cooling-device:0";
		msm_gpu = "/fragment@14/__overlay__/socd/cooling-maps/socd_gpu0:cooling-device:0", "/fragment@14/__overlay__/pm8550b-bcl-lvl0/cooling-maps/lbat_gpu0:cooling-device:0", "/fragment@14/__overlay__/pm8550b-bcl-lvl1/cooling-maps/lbat_gpu1:cooling-device:0", "/fragment@14/__overlay__/pm8550b-bcl-lvl2/cooling-maps/lbat_gpu2:cooling-device:0", "/fragment@14/__overlay__/pm8550-bcl-lvl0/cooling-maps/vph_gpu0:cooling-device:0", "/fragment@14/__overlay__/pm8550-bcl-lvl1/cooling-maps/vph_gpu1:cooling-device:0", "/fragment@14/__overlay__/pm8550-bcl-lvl2/cooling-maps/vph_gpu2:cooling-device:0", "/fragment@14/__overlay__/pm8550vs_d_tz/cooling-maps/pm8550vs_d_gpu:cooling-device:0", "/fragment@14/__overlay__/xo-therm/cooling-maps/gpu_cdev:cooling-device:0";
		pcie1 = "/fragment@24:target:0";
		pm_humu_l15 = "/fragment@2/__overlay__/qcom,pm8550b@7/qcom,eusb2-repeater@fd00:vdd18-supply:0";
		pm_humu_l17 = "/fragment@18/__overlay__:vcc-supply:0";
		pm_humu_l5 = "/fragment@2/__overlay__/qcom,pm8550b@7/qcom,eusb2-repeater@fd00:vdd3-supply:0";
		pm_humu_l8 = "/fragment@15/__overlay__:vdd-io-supply:0";
		pm_humu_l9 = "/fragment@15/__overlay__:vdd-supply:0";
		pm_v6d_l1 = "/fragment@17/__overlay__:vdda-phy-supply:0";
		pm_v6e_l1 = "/fragment@17/__overlay__:vdda-qref-supply:0";
		pm_v6e_l3 = "/fragment@17/__overlay__:vdda-pll-supply:0";
		pm_v6g_l1 = "/fragment@18/__overlay__:vccq-supply:0";
		pm_v6g_l3 = "/fragment@18/__overlay__:qcom,vddp-ref-clk-supply:0";
		pm_v6g_s4 = "/fragment@18/__overlay__:qcom,vccq-parent-supply:0";
		qupv3_se4_i2c = "/fragment@19:target:0";
		sdc2_off = "/fragment@15/__overlay__:pinctrl-1:0";
		sdc2_on = "/fragment@15/__overlay__:pinctrl-0:0";
		sdhc_2 = "/fragment@15:target:0";
		soc = "/fragment@13:target:0", "/fragment@16:target:0";
		spmi_bus = "/fragment@0:target:0", "/fragment@2:target:0", "/fragment@4:target:0", "/fragment@6:target:0", "/fragment@8:target:0", "/fragment@9:target:0", "/fragment@11:target:0", "/fragment@13/__overlay__/regulator-ocp-notifier:interrupt-parent:0";
		thermal_zones = "/fragment@1:target:0", "/fragment@3:target:0", "/fragment@5:target:0", "/fragment@7:target:0", "/fragment@10:target:0", "/fragment@12:target:0", "/fragment@14:target:0";
		tlmm = "/fragment@18/__overlay__:reset-gpios:0", "/fragment@19/__overlay__/goodix-berlin@5d:interrupt-parent:0", "/fragment@19/__overlay__/goodix-berlin@5d:goodix,reset-gpio:0", "/fragment@19/__overlay__/goodix-berlin@5d:goodix,irq-gpio:0", "/fragment@19/__overlay__/goodix-berlin@5d:qts,trusted-touch-vm-gpio-list:0", "/fragment@19/__overlay__/goodix-berlin@5d:qts,trusted-touch-vm-gpio-list:12", "/fragment@19/__overlay__/goodix-berlin@5d:qts,trusted-touch-vm-gpio-list:24", "/fragment@19/__overlay__/goodix-berlin@5d:qts,trusted-touch-vm-gpio-list:36", "/fragment@19/__overlay__/goodix-berlin@5d:qts,trusted-touch-vm-gpio-list:48", "/fragment@19/__overlay__/goodix-berlin@5d:qts,trusted-touch-vm-gpio-list:60";
		ucsi = "/fragment@22:target:0";
		ufshc_mem = "/fragment@18:target:0";
		ufsphy_mem = "/fragment@17:target:0";
		usb0 = "/fragment@21:target:0";
	};

	__local_fixups__ {

		fragment@0 {

			__overlay__ {

				qcom,pm8550@1 {

					pm8550-temp-alarm@a00 {
						io-channels = <0x0>;
					};

					pwms@e800 {
						nvmem = <0x0 0x4>;
					};

					qcom,leds@ef00 {

						blue {
							pwms = <0x0>;
						};

						green {
							pwms = <0x0>;
						};

						red {
							pwms = <0x0>;
						};
					};
				};
			};
		};

		fragment@1 {

			__overlay__ {

				pm8550-bcl-lvl0 {
					thermal-sensors = <0x0>;
				};

				pm8550-bcl-lvl1 {
					thermal-sensors = <0x0>;
				};

				pm8550-bcl-lvl2 {
					thermal-sensors = <0x0>;
				};

				pm8550_tz {
					thermal-sensors = <0x0>;
				};
			};
		};

		fragment@10 {

			__overlay__ {

				pmr735d_k_tz {
					thermal-sensors = <0x0>;
				};

				pmr735d_l_tz {
					thermal-sensors = <0x0>;
				};
			};
		};

		fragment@12 {

			__overlay__ {

				pm8010m_tz {
					thermal-sensors = <0x0>;
				};

				pm8010n_tz {
					thermal-sensors = <0x0>;
				};

				xo-therm {
					thermal-sensors = <0x0>;
				};
			};
		};

		fragment@13 {

			__overlay__ {

				pmic-pon-log {
					nvmem = <0x0 0x4>;
				};

				reboot_reason {
					nvmem-cells = <0x0>;
				};

				regulator-dbo3 {
					gpio = <0x0>;
				};

				regulator-ocp-notifier {
					nvmem-cells = <0x0>;
				};
			};
		};

		fragment@14 {

			__overlay__ {

				pm8550-bcl-lvl0 {

					cooling-maps {

						vph_cdsp0 {
							trip = <0x0>;
						};

						vph_cpu_3_4_5 {
							trip = <0x0>;
						};

						vph_gpu0 {
							trip = <0x0>;
						};

						vph_lte0 {
							trip = <0x0>;
						};

						vph_nr0 {
							trip = <0x0>;
						};

						vph_nr0_scg {
							trip = <0x0>;
						};
					};
				};

				pm8550-bcl-lvl1 {

					cooling-maps {

						vph_cdsp1 {
							trip = <0x0>;
						};

						vph_cpu_6_7 {
							trip = <0x0>;
						};

						vph_gpu1 {
							trip = <0x0>;
						};

						vph_lte1 {
							trip = <0x0>;
						};

						vph_nr1 {
							trip = <0x0>;
						};

						vph_nr1_scg {
							trip = <0x0>;
						};
					};
				};

				pm8550-bcl-lvl2 {

					cooling-maps {

						vph_cdsp2 {
							trip = <0x0>;
						};

						vph_gpu2 {
							trip = <0x0>;
						};
					};
				};

				pm8550b-bcl-lvl0 {

					cooling-maps {

						lbat_0_mdm_lte {
							trip = <0x0>;
						};

						lbat_0_nr {
							trip = <0x0>;
						};

						lbat_0_nr_scg {
							trip = <0x0>;
						};

						lbat_cdsp0 {
							trip = <0x0>;
						};

						lbat_cpu_3_4_5 {
							trip = <0x0>;
						};

						lbat_gpu0 {
							trip = <0x0>;
						};
					};
				};

				pm8550b-bcl-lvl1 {

					cooling-maps {

						lbat_1_mdm_lte {
							trip = <0x0>;
						};

						lbat_1_nr {
							trip = <0x0>;
						};

						lbat_1_nr_scg {
							trip = <0x0>;
						};

						lbat_cdsp1 {
							trip = <0x0>;
						};

						lbat_cpu_6_7 {
							trip = <0x0>;
						};

						lbat_gpu1 {
							trip = <0x0>;
						};
					};
				};

				pm8550b-bcl-lvl2 {

					cooling-maps {

						lbat_cdsp2 {
							trip = <0x0>;
						};

						lbat_gpu2 {
							trip = <0x0>;
						};
					};
				};

				pm8550ve_f_tz {

					cooling-maps {

						pm8550vs_e_lte {
							trip = <0x0>;
						};

						pm8550vs_e_nr {
							trip = <0x0>;
						};

						pm8550vs_e_nsp {
							trip = <0x0>;
						};
					};
				};

				pm8550vs_c_tz {

					cooling-maps {

						pm8550vs_c_apc1 {
							trip = <0x0>;
						};
					};
				};

				pm8550vs_d_tz {

					cooling-maps {

						pm8550vs_d_gpu {
							trip = <0x0>;
						};
					};
				};

				socd {

					cooling-maps {

						socd_apc1 {
							trip = <0x0>;
						};

						socd_cdsp1 {
							trip = <0x0>;
						};

						socd_gpu0 {
							trip = <0x0>;
						};
					};
				};

				xo-therm {

					cooling-maps {

						apc1_cdev {
							trip = <0x0>;
						};

						cdsp_cdev {
							trip = <0x0>;
						};

						cpu3_hot_cdev {
							trip = <0x0>;
						};

						cpu4_hot_cdev {
							trip = <0x0>;
						};

						cpu5_hot_cdev {
							trip = <0x0>;
						};

						cpu6_hot_cdev {
							trip = <0x0>;
						};

						cpu7_hot_cdev {
							trip = <0x0>;
						};

						display_cdev1 {
							trip = <0x0>;
						};

						display_cdev2 {
							trip = <0x0>;
						};

						display_cdev3 {
							trip = <0x0>;
						};

						display_cdev4 {
							trip = <0x0>;
						};

						gpu_cdev {
							trip = <0x0>;
						};

						lte_cdev {
							trip = <0x0>;
						};

						nr_cdev {
							trip = <0x0>;
						};
					};
				};
			};
		};

		fragment@15 {

			__overlay__ {
				cd-gpios = <0x0>;
				pinctrl-0 = <0x4>;
				pinctrl-1 = <0x4>;
			};
		};

		fragment@16 {

			__overlay__ {

				gpio_keys {
					pinctrl-0 = <0x0>;

					vol_up {
						gpios = <0x0>;
					};
				};
			};
		};

		fragment@2 {

			__overlay__ {

				qcom,pm8550b@7 {

					pm8550b-temp-alarm-lite@c00 {
						io-channels = <0x0>;
					};

					pm8550b-temp-alarm@a00 {
						io-channels = <0x0>;
					};

					qcom,hv-haptics@f000 {
						nvmem = <0x0>;
					};
				};
			};
		};

		fragment@20 {

			__overlay__ {
				dummy-supply = <0x0>;
				usb-repeater = <0x0>;
			};
		};

		fragment@21 {

			__overlay__ {

				port {

					endpoint {
						remote-endpoint = <0x0>;
					};
				};
			};
		};

		fragment@22 {

			__overlay__ {

				connector {

					port {

						endpoint {
							remote-endpoint = <0x0>;
						};
					};
				};
			};
		};

		fragment@3 {

			__overlay__ {

				pm8550b-bcl-lvl0 {
					thermal-sensors = <0x0>;
				};

				pm8550b-bcl-lvl1 {
					thermal-sensors = <0x0>;
				};

				pm8550b-bcl-lvl2 {
					thermal-sensors = <0x0>;
				};

				pm8550b-ibat-lvl0 {
					thermal-sensors = <0x0>;
				};

				pm8550b-ibat-lvl1 {
					thermal-sensors = <0x0>;
				};

				pm8550b_lite_tz {
					thermal-sensors = <0x0>;
				};

				pm8550b_tz {
					thermal-sensors = <0x0>;
				};
			};
		};

		fragment@4 {

			__overlay__ {

				qcom,pm8550ve_f@5 {

					pm8550ve-f-temp-alarm@a00 {
						io-channels = <0x0>;
					};
				};
			};
		};

		fragment@5 {

			__overlay__ {

				pm8550ve_f_tz {
					thermal-sensors = <0x0>;
				};
			};
		};

		fragment@6 {

			__overlay__ {

				qcom,pm8550vs@2 {

					pm8550vs-c-temp-alarm@a00 {
						io-channels = <0x0>;
					};
				};

				qcom,pm8550vs@3 {

					pm8550vs-d-temp-alarm@a00 {
						io-channels = <0x0>;
					};
				};

				qcom,pm8550vs@4 {

					pm8550vs-e-temp-alarm@a00 {
						io-channels = <0x0>;
					};
				};

				qcom,pm8550vs@6 {

					pm8550vs-g-temp-alarm@a00 {
						io-channels = <0x0>;
					};
				};
			};
		};

		fragment@7 {

			__overlay__ {

				pm8550vs_c_tz {
					thermal-sensors = <0x0>;
				};

				pm8550vs_d_tz {
					thermal-sensors = <0x0>;
				};

				pm8550vs_e_tz {
					thermal-sensors = <0x0>;
				};

				pm8550vs_g_tz {
					thermal-sensors = <0x0>;
				};
			};
		};

		fragment@8 {

			__overlay__ {

				qcom,pmk8550@0 {

					pinctrl@b800 {
						pinctrl-0 = <0x0>;
					};
				};
			};
		};
	};

	__symbols__ {
		DBO3 = "/fragment@13/__overlay__/regulator-dbo3";
		alt_sleep_clk_default = "/fragment@8/__overlay__/qcom,pmk8550@0/pinctrl@b800/alt_sleep_clk/alt_sleep_clk_default";
		b_bcl_lvl0 = "/fragment@3/__overlay__/pm8550b-bcl-lvl0/trips/b-bcl-lvl0";
		b_bcl_lvl1 = "/fragment@3/__overlay__/pm8550b-bcl-lvl1/trips/b-bcl-lvl1";
		b_bcl_lvl2 = "/fragment@3/__overlay__/pm8550b-bcl-lvl2/trips/b-bcl-lvl2";
		bcl_lvl0 = "/fragment@1/__overlay__/pm8550-bcl-lvl0/trips/bcl-lvl0";
		bcl_lvl1 = "/fragment@1/__overlay__/pm8550-bcl-lvl1/trips/bcl-lvl1";
		bcl_lvl2 = "/fragment@1/__overlay__/pm8550-bcl-lvl2/trips/bcl-lvl2";
		bcl_soc = "/fragment@2/__overlay__/qcom,pm8550b@7/bcl-soc";
		display_test_config1 = "/fragment@12/__overlay__/xo-therm/trips/display-test-config1";
		display_test_config2 = "/fragment@12/__overlay__/xo-therm/trips/display-test-config2";
		display_test_config3 = "/fragment@12/__overlay__/xo-therm/trips/display-test-config3";
		display_test_config4 = "/fragment@12/__overlay__/xo-therm/trips/display-test-config4";
		eusb2_repeater_reset_default = "/fragment@6/__overlay__/qcom,pm8550vs@3/pinctrl@8800/eusb2_repeater_reset/eusb2_repeater_reset_default";
		hap_swr_slave_reg = "/fragment@2/__overlay__/qcom,pm8550b@7/qcom,hv-haptics@f000/qcom,hap-swr-slave-reg";
		ibat_lvl0 = "/fragment@3/__overlay__/pm8550b-ibat-lvl0/trips/ibat-lvl0";
		ibat_lvl1 = "/fragment@3/__overlay__/pm8550b-ibat-lvl1/trips/ibat-lvl1";
		key_vol_up_default = "/fragment@0/__overlay__/qcom,pm8550@1/pinctrl@8800/key_vol_up/key_vol_up_default";
		ocp_log = "/fragment@8/__overlay__/qcom,pmk8550@0/sdam@7000/ocp-log@76";
		pm8010_m = "/fragment@11/__overlay__/qcom,pm8010@c";
		pm8010_n = "/fragment@11/__overlay__/qcom,pm8010@d";
		pm8010m_tz = "/fragment@11/__overlay__/qcom,pm8010@c/pm8010-m-temp-alarm@2400";
		pm8010n_tz = "/fragment@11/__overlay__/qcom,pm8010@d/pm8010-n-temp-alarm@2400";
		pm8550_bcl = "/fragment@0/__overlay__/qcom,pm8550@1/bcl@4700";
		pm8550_flash = "/fragment@0/__overlay__/qcom,pm8550@1/qcom,flash_led@ee00";
		pm8550_flash0 = "/fragment@0/__overlay__/qcom,pm8550@1/qcom,flash_led@ee00/qcom,flash_0";
		pm8550_flash1 = "/fragment@0/__overlay__/qcom,pm8550@1/qcom,flash_led@ee00/qcom,flash_1";
		pm8550_flash2 = "/fragment@0/__overlay__/qcom,pm8550@1/qcom,flash_led@ee00/qcom,flash_2";
		pm8550_flash3 = "/fragment@0/__overlay__/qcom,pm8550@1/qcom,flash_led@ee00/qcom,flash_3";
		pm8550_gpios = "/fragment@0/__overlay__/qcom,pm8550@1/pinctrl@8800";
		pm8550_pwm_1 = "/fragment@0/__overlay__/qcom,pm8550@1/pwms@e800";
		pm8550_pwm_2 = "/fragment@0/__overlay__/qcom,pm8550@1/pwms@eb00";
		pm8550_rgb = "/fragment@0/__overlay__/qcom,pm8550@1/qcom,leds@ef00";
		pm8550_switch0 = "/fragment@0/__overlay__/qcom,pm8550@1/qcom,flash_led@ee00/qcom,led_switch_0";
		pm8550_switch1 = "/fragment@0/__overlay__/qcom,pm8550@1/qcom,flash_led@ee00/qcom,led_switch_1";
		pm8550_switch2 = "/fragment@0/__overlay__/qcom,pm8550@1/qcom,flash_led@ee00/qcom,led_switch_2";
		pm8550_temp_alarm = "/fragment@1/__overlay__/pm8550_tz";
		pm8550_torch0 = "/fragment@0/__overlay__/qcom,pm8550@1/qcom,flash_led@ee00/qcom,torch_0";
		pm8550_torch1 = "/fragment@0/__overlay__/qcom,pm8550@1/qcom,flash_led@ee00/qcom,torch_1";
		pm8550_torch2 = "/fragment@0/__overlay__/qcom,pm8550@1/qcom,flash_led@ee00/qcom,torch_2";
		pm8550_torch3 = "/fragment@0/__overlay__/qcom,pm8550@1/qcom,flash_led@ee00/qcom,torch_3";
		pm8550_trip0 = "/fragment@1/__overlay__/pm8550_tz/trips/trip0";
		pm8550_trip1 = "/fragment@1/__overlay__/pm8550_tz/trips/trip1";
		pm8550_trip2 = "/fragment@1/__overlay__/pm8550_tz/trips/trip2";
		pm8550_tz = "/fragment@0/__overlay__/qcom,pm8550@1/pm8550-temp-alarm@a00";
		pm8550b_bcl = "/fragment@2/__overlay__/qcom,pm8550b@7/bcl@4700";
		pm8550b_eusb2_repeater = "/fragment@2/__overlay__/qcom,pm8550b@7/qcom,eusb2-repeater@fd00";
		pm8550b_gpios = "/fragment@2/__overlay__/qcom,pm8550b@7/pinctrl@8800";
		pm8550b_haptics = "/fragment@2/__overlay__/qcom,pm8550b@7/qcom,hv-haptics@f000";
		pm8550b_lite_temp_alarm = "/fragment@3/__overlay__/pm8550b_lite_tz";
		pm8550b_lite_tz = "/fragment@2/__overlay__/qcom,pm8550b@7/pm8550b-temp-alarm-lite@c00";
		pm8550b_temp_alarm = "/fragment@3/__overlay__/pm8550b_tz";
		pm8550b_trip0 = "/fragment@3/__overlay__/pm8550b_tz/trips/trip0";
		pm8550b_trip1 = "/fragment@3/__overlay__/pm8550b_tz/trips/trip1";
		pm8550b_trip2 = "/fragment@3/__overlay__/pm8550b_tz/trips/trip2";
		pm8550b_tz = "/fragment@2/__overlay__/qcom,pm8550b@7/pm8550b-temp-alarm@a00";
		pm8550ve_f_gpios = "/fragment@4/__overlay__/qcom,pm8550ve_f@5/pinctrl@8800";
		pm8550ve_f_temp_alarm = "/fragment@5/__overlay__/pm8550ve_f_tz";
		pm8550ve_f_trip0 = "/fragment@5/__overlay__/pm8550ve_f_tz/trips/trip0";
		pm8550ve_f_trip1 = "/fragment@5/__overlay__/pm8550ve_f_tz/trips/trip1";
		pm8550ve_f_trip2 = "/fragment@5/__overlay__/pm8550ve_f_tz/trips/trip2";
		pm8550ve_f_tz = "/fragment@4/__overlay__/qcom,pm8550ve_f@5/pm8550ve-f-temp-alarm@a00";
		pm8550vs_c = "/fragment@6/__overlay__/qcom,pm8550vs@2";
		pm8550vs_c_gpios = "/fragment@6/__overlay__/qcom,pm8550vs@2/pinctrl@8800";
		pm8550vs_c_temp_alarm = "/fragment@7/__overlay__/pm8550vs_c_tz";
		pm8550vs_c_trip0 = "/fragment@7/__overlay__/pm8550vs_c_tz/trips/trip0";
		pm8550vs_c_trip1 = "/fragment@7/__overlay__/pm8550vs_c_tz/trips/trip1";
		pm8550vs_c_trip2 = "/fragment@7/__overlay__/pm8550vs_c_tz/trips/trip2";
		pm8550vs_c_tz = "/fragment@6/__overlay__/qcom,pm8550vs@2/pm8550vs-c-temp-alarm@a00";
		pm8550vs_d = "/fragment@6/__overlay__/qcom,pm8550vs@3";
		pm8550vs_d_gpios = "/fragment@6/__overlay__/qcom,pm8550vs@3/pinctrl@8800";
		pm8550vs_d_temp_alarm = "/fragment@7/__overlay__/pm8550vs_d_tz";
		pm8550vs_d_trip0 = "/fragment@7/__overlay__/pm8550vs_d_tz/trips/trip0";
		pm8550vs_d_trip1 = "/fragment@7/__overlay__/pm8550vs_d_tz/trips/trip1";
		pm8550vs_d_trip2 = "/fragment@7/__overlay__/pm8550vs_d_tz/trips/trip2";
		pm8550vs_d_tz = "/fragment@6/__overlay__/qcom,pm8550vs@3/pm8550vs-d-temp-alarm@a00";
		pm8550vs_e = "/fragment@6/__overlay__/qcom,pm8550vs@4";
		pm8550vs_e_gpios = "/fragment@6/__overlay__/qcom,pm8550vs@4/pinctrl@8800";
		pm8550vs_e_temp_alarm = "/fragment@7/__overlay__/pm8550vs_e_tz";
		pm8550vs_e_trip0 = "/fragment@7/__overlay__/pm8550vs_e_tz/trips/trip0";
		pm8550vs_e_trip1 = "/fragment@7/__overlay__/pm8550vs_e_tz/trips/trip1";
		pm8550vs_e_trip2 = "/fragment@7/__overlay__/pm8550vs_e_tz/trips/trip2";
		pm8550vs_e_tz = "/fragment@6/__overlay__/qcom,pm8550vs@4/pm8550vs-e-temp-alarm@a00";
		pm8550vs_g = "/fragment@6/__overlay__/qcom,pm8550vs@6";
		pm8550vs_g_gpios = "/fragment@6/__overlay__/qcom,pm8550vs@6/pinctrl@8800";
		pm8550vs_g_temp_alarm = "/fragment@7/__overlay__/pm8550vs_g_tz";
		pm8550vs_g_trip0 = "/fragment@7/__overlay__/pm8550vs_g_tz/trips/trip0";
		pm8550vs_g_trip1 = "/fragment@7/__overlay__/pm8550vs_g_tz/trips/trip1";
		pm8550vs_g_trip2 = "/fragment@7/__overlay__/pm8550vs_g_tz/trips/trip2";
		pm8550vs_g_tz = "/fragment@6/__overlay__/qcom,pm8550vs@6/pm8550vs-g-temp-alarm@a00";
		pmk8550_gpios = "/fragment@8/__overlay__/qcom,pmk8550@0/pinctrl@b800";
		pmk8550_rtc = "/fragment@8/__overlay__/qcom,pmk8550@0/rtc@6100";
		pmk8550_sdam_1 = "/fragment@8/__overlay__/qcom,pmk8550@0/sdam@7000";
		pmk8550_sdam_2 = "/fragment@8/__overlay__/qcom,pmk8550@0/sdam@7100";
		pmk8550_sdam_21 = "/fragment@8/__overlay__/qcom,pmk8550@0/sdam@8400";
		pmk8550_sdam_22 = "/fragment@8/__overlay__/qcom,pmk8550@0/sdam@8500";
		pmk8550_sdam_46 = "/fragment@8/__overlay__/qcom,pmk8550@0/sdam@9d00";
		pmk8550_sdam_5 = "/fragment@8/__overlay__/qcom,pmk8550@0/sdam@7400";
		pmk8550_sdam_6 = "/fragment@8/__overlay__/qcom,pmk8550@0/sdam@7500";
		pmk8550_vadc = "/fragment@8/__overlay__/qcom,pmk8550@0/vadc@9000";
		pmr735d_k_gpios = "/fragment@9/__overlay__/qcom,pmr735d@a/pinctrl@8800";
		pmr735d_k_temp_alarm = "/fragment@10/__overlay__/pmr735d_k_tz";
		pmr735d_k_trip0 = "/fragment@10/__overlay__/pmr735d_k_tz/trips/trip0";
		pmr735d_k_trip1 = "/fragment@10/__overlay__/pmr735d_k_tz/trips/trip1";
		pmr735d_k_trip2 = "/fragment@10/__overlay__/pmr735d_k_tz/trips/trip2";
		pmr735d_k_tz = "/fragment@9/__overlay__/qcom,pmr735d@a/pmr735d-k-temp-alarm@a00";
		pmr735d_l_gpios = "/fragment@9/__overlay__/qcom,pmr735d@b/pinctrl@8800";
		pmr735d_l_temp_alarm = "/fragment@10/__overlay__/pmr735d_l_tz";
		pmr735d_l_trip0 = "/fragment@10/__overlay__/pmr735d_l_tz/trips/trip0";
		pmr735d_l_trip1 = "/fragment@10/__overlay__/pmr735d_l_tz/trips/trip1";
		pmr735d_l_trip2 = "/fragment@10/__overlay__/pmr735d_l_tz/trips/trip2";
		pmr735d_l_tz = "/fragment@9/__overlay__/qcom,pmr735d@b/pmr735d-l-temp-alarm@a00";
		regulator_ocp_notifier = "/fragment@13/__overlay__/regulator-ocp-notifier";
		restart_reason = "/fragment@8/__overlay__/qcom,pmk8550@0/sdam@7100/restart@48";
		sd_card_det_default = "/fragment@0/__overlay__/qcom,pm8550@1/pinctrl@8800/sd_card_det/sd_card_det_default";
		socd_trip = "/fragment@3/__overlay__/socd/trips/socd-trip";
		usb_port0 = "/fragment@21/__overlay__/port/endpoint";
		usb_port0_connector = "/fragment@22/__overlay__/connector/port/endpoint";
		xo_config0 = "/fragment@12/__overlay__/xo-therm/trips/xo-config0";
		xo_config1 = "/fragment@12/__overlay__/xo-therm/trips/xo-config1";
	};

	fragment@0 {
		target = <0xffffffff>;

		__overlay__ {
			#address-cells = <0x2>;
			#interrupt-cells = <0x4>;
			#size-cells = <0x0>;
			interrupt-controller;

			qcom,pm8550@1 {
				#address-cells = <0x1>;
				#size-cells = <0x0>;
				compatible = "qcom,spmi-pmic";
				reg = <0x1 0x0>;

				bcl@4700 {
					#thermal-sensor-cells = <0x1>;
					compatible = "qcom,bcl-v5";
					interrupt-names = "bcl-lvl0", "bcl-lvl1", "bcl-lvl2";
					interrupts = <0x1 0x47 0x0 0x0 0x1 0x47 0x1 0x0 0x1 0x47 0x2 0x0>;
					phandle = <0x6>;
					qcom,pmic7-threshold;
					reg = <0x4700 0x100>;
				};

				pinctrl@8800 {
					#gpio-cells = <0x2>;
					#interrupt-cells = <0x2>;
					compatible = "qcom,pm8550-gpio";
					gpio-controller;
					interrupt-controller;
					phandle = <0x16>;
					reg = <0x8800>;

					key_vol_up {

						key_vol_up_default {
							bias-pull-up;
							function = "normal";
							input-enable;
							phandle = <0x2b>;
							pins = "gpio6";
							power-source = <0x1>;
						};
					};

					sd_card_det {

						sd_card_det_default {
							bias-pull-up;
							function = "normal";
							input-enable;
							output-disable;
							phandle = <0x2a>;
							pins = "gpio12";
							power-source = <0x1>;
						};
					};
				};

				pm8550-temp-alarm@a00 {
					#thermal-sensor-cells = <0x0>;
					compatible = "qcom,spmi-temp-alarm";
					interrupts = <0x1 0xa 0x0 0x3>;
					io-channel-names = "thermal";
					io-channels = <0x1 0x103>;
					phandle = <0x5>;
					reg = <0xa00>;
				};

				pwms@e800 {
					#pwm-cells = <0x2>;
					compatible = "qcom,pwm-lpg";
					nvmem = <0x2 0x3>;
					nvmem-names = "lpg_chan_sdam", "lut_sdam";
					phandle = <0x4>;
					qcom,lut-patterns = <0x0 0xa 0x14 0x1e 0x28 0x32 0x3c 0x46 0x50 0x5a 0x64 0x5a 0x50 0x46 0x3c 0x32 0x28 0x1e 0x14 0xa 0x0>;
					qcom,lut-sdam-base = <0x45>;
					qcom,num-lpg-channels = <0x3>;
					qcom,tick-duration-us = <0x1e78>;
					reg = <0xe800>;
					reg-names = "lpg-base";

					lpg@1 {
						qcom,lpg-chan-id = <0x1>;
						qcom,lpg-sdam-base = <0x48>;
						qcom,ramp-high-index = <0x13>;
						qcom,ramp-low-index = <0x0>;
						qcom,ramp-pattern-repeat;
						qcom,ramp-step-ms = <0x64>;
					};

					lpg@2 {
						qcom,lpg-chan-id = <0x2>;
						qcom,lpg-sdam-base = <0x56>;
						qcom,ramp-high-index = <0x13>;
						qcom,ramp-low-index = <0x0>;
						qcom,ramp-pattern-repeat;
						qcom,ramp-step-ms = <0x64>;
					};

					lpg@3 {
						qcom,lpg-chan-id = <0x3>;
						qcom,lpg-sdam-base = <0x64>;
						qcom,ramp-high-index = <0x13>;
						qcom,ramp-low-index = <0x0>;
						qcom,ramp-pattern-repeat;
						qcom,ramp-step-ms = <0x64>;
					};
				};

				pwms@eb00 {
					#pwm-cells = <0x2>;
					compatible = "qcom,pwm-lpg";
					phandle = <0x2f>;
					qcom,num-lpg-channels = <0x1>;
					reg = <0xeb00>;
					reg-names = "lpg-base";
				};

				qcom,flash_led@ee00 {
					compatible = "qcom,pm8350c-flash-led";
					interrupt-names = "led-fault-irq", "all-ramp-down-done-irq", "all-ramp-up-done-irq";
					interrupts = <0x1 0xee 0x0 0x1 0x1 0xee 0x3 0x1 0x1 0xee 0x4 0x1>;
					phandle = <0x31>;
					qcom,thermal-derate-current = <0xc8 0x1f4>;
					reg = <0xee00>;
					status = "ok";

					qcom,flash_0 {
						label = "flash";
						phandle = <0x32>;
						qcom,default-led-trigger = "flash0_trigger";
						qcom,duration-ms = <0x500>;
						qcom,id = <0x0>;
						qcom,ires-ua = <0x30d4>;
						qcom,led-name = "led:flash_0";
						qcom,max-current-ma = <0x5dc>;
					};

					qcom,flash_1 {
						label = "flash";
						phandle = <0x33>;
						qcom,default-led-trigger = "flash1_trigger";
						qcom,duration-ms = <0x500>;
						qcom,id = <0x1>;
						qcom,ires-ua = <0x30d4>;
						qcom,led-name = "led:flash_1";
						qcom,max-current-ma = <0x5dc>;
					};

					qcom,flash_2 {
						label = "flash";
						phandle = <0x34>;
						qcom,default-led-trigger = "flash2_trigger";
						qcom,duration-ms = <0x500>;
						qcom,id = <0x2>;
						qcom,ires-ua = <0x30d4>;
						qcom,led-name = "led:flash_2";
						qcom,max-current-ma = <0x5dc>;
					};

					qcom,flash_3 {
						label = "flash";
						phandle = <0x35>;
						qcom,default-led-trigger = "flash3_trigger";
						qcom,duration-ms = <0x500>;
						qcom,id = <0x3>;
						qcom,ires-ua = <0x30d4>;
						qcom,led-name = "led:flash_3";
						qcom,max-current-ma = <0x5dc>;
					};

					qcom,led_switch_0 {
						label = "switch";
						phandle = <0x3a>;
						qcom,default-led-trigger = "switch0_trigger";
						qcom,led-mask = <0x9>;
						qcom,led-name = "led:switch_0";
						qcom,symmetry-en;
					};

					qcom,led_switch_1 {
						label = "switch";
						phandle = <0x3b>;
						qcom,default-led-trigger = "switch1_trigger";
						qcom,led-mask = <0x6>;
						qcom,led-name = "led:switch_1";
						qcom,symmetry-en;
					};

					qcom,led_switch_2 {
						label = "switch";
						phandle = <0x3c>;
						qcom,default-led-trigger = "switch2_trigger";
						qcom,led-mask = <0xf>;
						qcom,led-name = "led:switch_2";
						qcom,symmetry-en;
					};

					qcom,torch_0 {
						label = "torch";
						phandle = <0x36>;
						qcom,default-led-trigger = "torch0_trigger";
						qcom,id = <0x0>;
						qcom,ires-ua = <0x30d4>;
						qcom,led-name = "led:torch_0";
						qcom,max-current-ma = <0x1f4>;
					};

					qcom,torch_1 {
						label = "torch";
						phandle = <0x37>;
						qcom,default-led-trigger = "torch1_trigger";
						qcom,id = <0x1>;
						qcom,ires-ua = <0x30d4>;
						qcom,led-name = "led:torch_1";
						qcom,max-current-ma = <0x1f4>;
					};

					qcom,torch_2 {
						label = "torch";
						phandle = <0x38>;
						qcom,default-led-trigger = "torch2_trigger";
						qcom,id = <0x2>;
						qcom,ires-ua = <0x30d4>;
						qcom,led-name = "led:torch_2";
						qcom,max-current-ma = <0x1f4>;
					};

					qcom,torch_3 {
						label = "torch";
						phandle = <0x39>;
						qcom,default-led-trigger = "torch3_trigger";
						qcom,id = <0x3>;
						qcom,ires-ua = <0x30d4>;
						qcom,led-name = "led:torch_3";
						qcom,max-current-ma = <0x1f4>;
					};
				};

				qcom,leds@ef00 {
					compatible = "qcom,tri-led";
					phandle = <0x30>;
					reg = <0xef00>;

					blue {
						label = "blue";
						led-sources = <0x2>;
						linux,default-trigger = "timer";
						pwms = <0x4 0x2 0xf4240>;
					};

					green {
						label = "green";
						led-sources = <0x1>;
						linux,default-trigger = "timer";
						pwms = <0x4 0x1 0xf4240>;
					};

					red {
						label = "red";
						led-sources = <0x0>;
						linux,default-trigger = "timer";
						pwms = <0x4 0x0 0xf4240>;
					};
				};
			};
		};
	};

	fragment@1 {
		target = <0xffffffff>;

		__overlay__ {

			pm8550-bcl-lvl0 {
				polling-delay = <0x0>;
				polling-delay-passive = <0x64>;
				thermal-governor = "step_wise";
				thermal-sensors = <0x6 0x5>;

				trips {

					bcl-lvl0 {
						hysteresis = <0x1>;
						phandle = <0x1e>;
						temperature = <0x1>;
						type = "passive";
					};
				};
			};

			pm8550-bcl-lvl1 {
				polling-delay = <0x0>;
				polling-delay-passive = <0x64>;
				thermal-governor = "step_wise";
				thermal-sensors = <0x6 0x6>;

				trips {

					bcl-lvl1 {
						hysteresis = <0x1>;
						phandle = <0x1f>;
						temperature = <0x1>;
						type = "passive";
					};
				};
			};

			pm8550-bcl-lvl2 {
				polling-delay = <0x0>;
				polling-delay-passive = <0x64>;
				thermal-governor = "step_wise";
				thermal-sensors = <0x6 0x7>;

				trips {

					bcl-lvl2 {
						hysteresis = <0x1>;
						phandle = <0x20>;
						temperature = <0x1>;
						type = "passive";
					};
				};
			};

			pm8550_tz {
				phandle = <0x3d>;
				polling-delay = <0x0>;
				polling-delay-passive = <0x64>;
				thermal-governor = "step_wise";
				thermal-sensors = <0x5>;

				trips {

					trip0 {
						hysteresis = <0x0>;
						phandle = <0x3e>;
						temperature = <0x17318>;
						type = "passive";
					};

					trip1 {
						hysteresis = <0x0>;
						phandle = <0x3f>;
						temperature = <0x1c138>;
						type = "passive";
					};

					trip2 {
						hysteresis = <0x0>;
						phandle = <0x40>;
						temperature = <0x23668>;
						type = "critical";
					};
				};
			};
		};
	};

	fragment@10 {
		target = <0xffffffff>;

		__overlay__ {

			pmr735d_k_tz {
				phandle = <0x6d>;
				polling-delay = <0x0>;
				polling-delay-passive = <0x64>;
				thermal-governor = "step_wise";
				thermal-sensors = <0x11>;

				trips {

					trip0 {
						hysteresis = <0x0>;
						phandle = <0x6e>;
						temperature = <0x17318>;
						type = "passive";
					};

					trip1 {
						hysteresis = <0x0>;
						phandle = <0x6f>;
						temperature = <0x1c138>;
						type = "passive";
					};

					trip2 {
						hysteresis = <0x0>;
						phandle = <0x70>;
						temperature = <0x23668>;
						type = "critical";
					};
				};
			};

			pmr735d_l_tz {
				phandle = <0x71>;
				polling-delay = <0x0>;
				polling-delay-passive = <0x64>;
				thermal-governor = "step_wise";
				thermal-sensors = <0x12>;

				trips {

					trip0 {
						hysteresis = <0x0>;
						phandle = <0x72>;
						temperature = <0x17318>;
						type = "passive";
					};

					trip1 {
						hysteresis = <0x0>;
						phandle = <0x73>;
						temperature = <0x1c138>;
						type = "passive";
					};

					trip2 {
						hysteresis = <0x0>;
						phandle = <0x74>;
						temperature = <0x23668>;
						type = "critical";
					};
				};
			};
		};
	};

	fragment@11 {
		target = <0xffffffff>;

		__overlay__ {
			#address-cells = <0x2>;
			#interrupt-cells = <0x4>;
			#size-cells = <0x0>;
			interrupt-controller;

			qcom,pm8010@c {
				#address-cells = <0x1>;
				#size-cells = <0x0>;
				compatible = "qcom,spmi-pmic";
				phandle = <0x75>;
				reg = <0xc 0x0>;

				pm8010-m-temp-alarm@2400 {
					#thermal-sensor-cells = <0x0>;
					compatible = "qcom,spmi-temp-alarm";
					interrupts = <0xc 0x24 0x0 0x3>;
					phandle = <0x13>;
					reg = <0x2400>;
				};
			};

			qcom,pm8010@d {
				#address-cells = <0x1>;
				#size-cells = <0x0>;
				compatible = "qcom,spmi-pmic";
				phandle = <0x76>;
				reg = <0xd 0x0>;

				pm8010-n-temp-alarm@2400 {
					#thermal-sensor-cells = <0x0>;
					compatible = "qcom,spmi-temp-alarm";
					interrupts = <0xd 0x24 0x0 0x3>;
					phandle = <0x14>;
					reg = <0x2400>;
				};
			};
		};
	};

	fragment@12 {
		target = <0xffffffff>;

		__overlay__ {

			pm8010m_tz {
				polling-delay = <0x0>;
				polling-delay-passive = <0x64>;
				thermal-governor = "step_wise";
				thermal-sensors = <0x13>;

				trips {

					trip0 {
						hysteresis = <0x0>;
						temperature = <0x17318>;
						type = "passive";
					};

					trip1 {
						hysteresis = <0x0>;
						temperature = <0x1c138>;
						type = "passive";
					};

					trip2 {
						hysteresis = <0x0>;
						temperature = <0x23668>;
						type = "critical";
					};
				};
			};

			pm8010n_tz {
				polling-delay = <0x0>;
				polling-delay-passive = <0x64>;
				thermal-governor = "step_wise";
				thermal-sensors = <0x14>;

				trips {

					trip0 {
						hysteresis = <0x0>;
						temperature = <0x17318>;
						type = "passive";
					};

					trip1 {
						hysteresis = <0x0>;
						temperature = <0x1c138>;
						type = "passive";
					};

					trip2 {
						hysteresis = <0x0>;
						temperature = <0x23668>;
						type = "critical";
					};
				};
			};

			xo-therm {
				polling-delay = <0x0>;
				polling-delay-passive = <0x0>;
				thermal-sensors = <0x1 0x44>;

				trips {

					active-config0 {
						hysteresis = <0x3e8>;
						temperature = <0x1e848>;
						type = "passive";
					};

					active-config1 {
						hysteresis = <0x3e8>;
						temperature = <0x1e848>;
						type = "passive";
					};

					display-test-config1 {
						hysteresis = <0x3e8>;
						phandle = <0x26>;
						temperature = <0x1e848>;
						type = "passive";
					};

					display-test-config2 {
						hysteresis = <0x3e8>;
						phandle = <0x27>;
						temperature = <0x1e848>;
						type = "passive";
					};

					display-test-config3 {
						hysteresis = <0x3e8>;
						phandle = <0x28>;
						temperature = <0x1e848>;
						type = "passive";
					};

					display-test-config4 {
						hysteresis = <0x3e8>;
						phandle = <0x29>;
						temperature = <0x1e848>;
						type = "passive";
					};

					xo-config0 {
						hysteresis = <0x1f40>;
						phandle = <0x24>;
						temperature = <0x130b0>;
						type = "passive";
					};

					xo-config1 {
						hysteresis = <0x2710>;
						phandle = <0x25>;
						temperature = <0x13880>;
						type = "passive";
					};
				};
			};
		};
	};

	fragment@13 {
		target = <0xffffffff>;

		__overlay__ {

			pmic-pon-log {
				compatible = "qcom,pmic-pon-log";
				nvmem = <0x17 0x18>;
				nvmem-names = "pon_log0", "pon_log1";
			};

			reboot_reason {
				compatible = "qcom,reboot-reason";
				nvmem-cell-names = "restart_reason";
				nvmem-cells = <0x15>;
			};

			regulator-dbo3 {
				compatible = "qti-regulator-fixed";
				enable-active-high;
				gpio = <0x16 0x9 0x0>;
				phandle = <0x77>;
				regulator-enable-ramp-delay = <0x5dc>;
				regulator-max-microvolt = <0x36ee80>;
				regulator-min-microvolt = <0x36ee80>;
				regulator-name = "dbo3";
			};

			regulator-ocp-notifier {
				compatible = "qcom,regulator-ocp-notifier";
				interrupt-parent = <0xffffffff>;
				interrupts = <0x0 0x71 0x1 0x1>;
				nvmem-cell-names = "ocp_log";
				nvmem-cells = <0x19>;
				periph-1c1-supply = <0xffffffff>;
				periph-1c2-supply = <0xffffffff>;
				periph-1c5-supply = <0xffffffff>;
				periph-1c6-supply = <0xffffffff>;
				periph-1c7-supply = <0xffffffff>;
				periph-1c8-supply = <0xffffffff>;
				periph-1c9-supply = <0xffffffff>;
				periph-1ca-supply = <0xffffffff>;
				periph-1cb-supply = <0xffffffff>;
				periph-1cc-supply = <0xffffffff>;
				periph-1cd-supply = <0xffffffff>;
				periph-1ce-supply = <0xffffffff>;
				periph-1cf-supply = <0xffffffff>;
				periph-1d0-supply = <0xffffffff>;
				periph-1d1-supply = <0xffffffff>;
				periph-2c1-supply = <0xffffffff>;
				periph-2c3-supply = <0xffffffff>;
				periph-3c1-supply = <0xffffffff>;
				periph-3c2-supply = <0xffffffff>;
				periph-4c1-supply = <0xffffffff>;
				periph-4c2-supply = <0xffffffff>;
				periph-4c3-supply = <0xffffffff>;
				periph-5c1-supply = <0xffffffff>;
				periph-5c2-supply = <0xffffffff>;
				periph-5c3-supply = <0xffffffff>;
				periph-6c1-supply = <0xffffffff>;
				periph-6c2-supply = <0xffffffff>;
				periph-6c3-supply = <0xffffffff>;
				periph-ac1-supply = <0xffffffff>;
				periph-ac2-supply = <0xffffffff>;
				periph-ac3-supply = <0xffffffff>;
				periph-ac4-supply = <0xffffffff>;
				periph-ac5-supply = <0xffffffff>;
				periph-ac6-supply = <0xffffffff>;
				periph-ac7-supply = <0xffffffff>;
				periph-bc3-supply = <0xffffffff>;
				periph-bc4-supply = <0xffffffff>;
				periph-bc5-supply = <0xffffffff>;
				periph-bc6-supply = <0xffffffff>;
				periph-bc7-supply = <0xffffffff>;
				periph-c40-supply = <0xffffffff>;
				periph-c41-supply = <0xffffffff>;
				periph-c42-supply = <0xffffffff>;
				periph-c43-supply = <0xffffffff>;
				periph-c44-supply = <0xffffffff>;
				periph-c45-supply = <0xffffffff>;
				periph-c46-supply = <0xffffffff>;
				periph-d40-supply = <0xffffffff>;
				periph-d41-supply = <0xffffffff>;
				periph-d42-supply = <0xffffffff>;
				periph-d43-supply = <0xffffffff>;
				periph-d44-supply = <0xffffffff>;
				periph-d45-supply = <0xffffffff>;
				periph-d46-supply = <0xffffffff>;
				phandle = <0x78>;
			};
		};
	};

	fragment@14 {
		target = <0xffffffff>;

		__overlay__ {

			pm8550-bcl-lvl0 {

				cooling-maps {

					vph_cdsp0 {
						cooling-device = <0xffffffff 0x2 0x2>;
						trip = <0x1e>;
					};

					vph_cpu_3_4_5 {
						cooling-device = <0xffffffff 0x1 0x1>;
						trip = <0x1e>;
					};

					vph_gpu0 {
						cooling-device = <0xffffffff 0x2 0x2>;
						trip = <0x1e>;
					};

					vph_lte0 {
						cooling-device = <0xffffffff 0x8 0x8>;
						trip = <0x1e>;
					};

					vph_nr0 {
						cooling-device = <0xffffffff 0x6 0x6>;
						trip = <0x1e>;
					};

					vph_nr0_scg {
						cooling-device = <0xffffffff 0x3 0x3>;
						trip = <0x1e>;
					};
				};
			};

			pm8550-bcl-lvl1 {

				cooling-maps {

					vph_cdsp1 {
						cooling-device = <0xffffffff 0x4 0x4>;
						trip = <0x1f>;
					};

					vph_cpu_6_7 {
						cooling-device = <0xffffffff 0x1 0x1>;
						trip = <0x1f>;
					};

					vph_gpu1 {
						cooling-device = <0xffffffff 0x4 0x4>;
						trip = <0x1f>;
					};

					vph_lte1 {
						cooling-device = <0xffffffff 0xa 0xa>;
						trip = <0x1f>;
					};

					vph_nr1 {
						cooling-device = <0xffffffff 0x9 0x9>;
						trip = <0x1f>;
					};

					vph_nr1_scg {
						cooling-device = <0xffffffff 0xa 0xa>;
						trip = <0x1f>;
					};
				};
			};

			pm8550-bcl-lvl2 {

				cooling-maps {

					vph_cdsp2 {
						cooling-device = <0xffffffff 0x5 0xffffffff>;
						trip = <0x20>;
					};

					vph_gpu2 {
						cooling-device = <0xffffffff 0x5 0xffffffff>;
						trip = <0x20>;
					};
				};
			};

			pm8550b-bcl-lvl0 {

				cooling-maps {

					lbat_0_mdm_lte {
						cooling-device = <0xffffffff 0x8 0x8>;
						trip = <0x1b>;
					};

					lbat_0_nr {
						cooling-device = <0xffffffff 0x6 0x6>;
						trip = <0x1b>;
					};

					lbat_0_nr_scg {
						cooling-device = <0xffffffff 0x3 0x3>;
						trip = <0x1b>;
					};

					lbat_cdsp0 {
						cooling-device = <0xffffffff 0x2 0x2>;
						trip = <0x1b>;
					};

					lbat_cpu_3_4_5 {
						cooling-device = <0xffffffff 0x1 0x1>;
						trip = <0x1b>;
					};

					lbat_gpu0 {
						cooling-device = <0xffffffff 0x2 0x2>;
						trip = <0x1b>;
					};
				};
			};

			pm8550b-bcl-lvl1 {

				cooling-maps {

					lbat_1_mdm_lte {
						cooling-device = <0xffffffff 0xa 0xa>;
						trip = <0x1c>;
					};

					lbat_1_nr {
						cooling-device = <0xffffffff 0x9 0x9>;
						trip = <0x1c>;
					};

					lbat_1_nr_scg {
						cooling-device = <0xffffffff 0xa 0xa>;
						trip = <0x1c>;
					};

					lbat_cdsp1 {
						cooling-device = <0xffffffff 0x4 0x4>;
						trip = <0x1c>;
					};

					lbat_cpu_6_7 {
						cooling-device = <0xffffffff 0x1 0x1>;
						trip = <0x1c>;
					};

					lbat_gpu1 {
						cooling-device = <0xffffffff 0x4 0x4>;
						trip = <0x1c>;
					};
				};
			};

			pm8550b-bcl-lvl2 {

				cooling-maps {

					lbat_cdsp2 {
						cooling-device = <0xffffffff 0x5 0xffffffff>;
						trip = <0x1d>;
					};

					lbat_gpu2 {
						cooling-device = <0xffffffff 0x5 0xffffffff>;
						trip = <0x1d>;
					};
				};
			};

			pm8550ve_f_tz {

				cooling-maps {

					pm8550vs_e_lte {
						cooling-device = <0xffffffff 0xff 0xff>;
						trip = <0x23>;
					};

					pm8550vs_e_nr {
						cooling-device = <0xffffffff 0xff 0xff>;
						trip = <0x23>;
					};

					pm8550vs_e_nsp {
						cooling-device = <0xffffffff 0x5 0xffffffff>;
						trip = <0x23>;
					};
				};
			};

			pm8550vs_c_tz {

				cooling-maps {

					pm8550vs_c_apc1 {
						cooling-device = <0xffffffff 0x1 0x1>;
						trip = <0x21>;
					};
				};
			};

			pm8550vs_d_tz {

				cooling-maps {

					pm8550vs_d_gpu {
						cooling-device = <0xffffffff 0x5 0xffffffff>;
						trip = <0x22>;
					};
				};
			};

			socd {

				cooling-maps {

					socd_apc1 {
						cooling-device = <0xffffffff 0x1 0x1>;
						trip = <0x1a>;
					};

					socd_cdsp1 {
						cooling-device = <0xffffffff 0x4 0x4>;
						trip = <0x1a>;
					};

					socd_gpu0 {
						cooling-device = <0xffffffff 0x4 0x4>;
						trip = <0x1a>;
					};
				};
			};

			xo-therm {

				cooling-maps {

					apc1_cdev {
						cooling-device = <0xffffffff 0x1 0x1>;
						trip = <0x24>;
					};

					cdsp_cdev {
						cooling-device = <0xffffffff 0x5 0xffffffff>;
						trip = <0x24>;
					};

					cpu3_hot_cdev {
						cooling-device = <0xffffffff 0x1 0x1>;
						trip = <0x25>;
					};

					cpu4_hot_cdev {
						cooling-device = <0xffffffff 0x1 0x1>;
						trip = <0x25>;
					};

					cpu5_hot_cdev {
						cooling-device = <0xffffffff 0x1 0x1>;
						trip = <0x25>;
					};

					cpu6_hot_cdev {
						cooling-device = <0xffffffff 0x1 0x1>;
						trip = <0x25>;
					};

					cpu7_hot_cdev {
						cooling-device = <0xffffffff 0x1 0x1>;
						trip = <0x25>;
					};

					display_cdev1 {
						cooling-device = <0xffffffff 0x1 0x1>;
						trip = <0x26>;
					};

					display_cdev2 {
						cooling-device = <0xffffffff 0x2 0x2>;
						trip = <0x27>;
					};

					display_cdev3 {
						cooling-device = <0xffffffff 0x3 0x3>;
						trip = <0x28>;
					};

					display_cdev4 {
						cooling-device = <0xffffffff 0x4 0x4>;
						trip = <0x29>;
					};

					gpu_cdev {
						cooling-device = <0xffffffff 0x5 0xffffffff>;
						trip = <0x24>;
					};

					lte_cdev {
						cooling-device = <0xffffffff 0xff 0xff>;
						trip = <0x25>;
					};

					nr_cdev {
						cooling-device = <0xffffffff 0xff 0xff>;
						trip = <0x25>;
					};
				};
			};
		};
	};

	fragment@15 {
		target = <0xffffffff>;

		__overlay__ {
			cd-gpios = <0x16 0xc 0x1>;
			pinctrl-0 = <0xffffffff 0x2a>;
			pinctrl-1 = <0xffffffff 0x2a>;
			pinctrl-names = "default", "sleep";
			qcom,iommu-dma = "fastmap";
			qcom,uses_level_shifter;
			qcom,vdd-current-level = <0x0 0xc3500>;
			qcom,vdd-io-current-level = <0x0 0x15e0>;
			qcom,vdd-io-voltage-level = <0x1b7740 0x2d2a80>;
			qcom,vdd-voltage-level = <0x2d0370 0x2d2a80>;
			reset-names = "core_reset";
			resets = <0xffffffff 0x16>;
			status = "ok";
			vdd-io-supply = <0xffffffff>;
			vdd-supply = <0xffffffff>;
		};
	};

	fragment@16 {
		target = <0xffffffff>;

		__overlay__ {

			gpio_keys {
				compatible = "gpio-keys";
				label = "gpio-keys";
				pinctrl-0 = <0x2b>;
				pinctrl-names = "default";

				vol_up {
					debounce-interval = <0xf>;
					gpio-key,wakeup;
					gpios = <0x16 0x6 0x1>;
					label = "volume_up";
					linux,can-disable;
					linux,code = <0x73>;
					linux,input-type = <0x1>;
				};
			};
		};
	};

	fragment@17 {
		target = <0xffffffff>;

		__overlay__ {
			compatible = "qcom,ufs-phy-qmp-v4-kalama";
			status = "ok";
			vdd-phy-gdsc-supply = <0xffffffff>;
			vdda-phy-max-microamp = <0x2de60>;
			vdda-phy-supply = <0xffffffff>;
			vdda-pll-max-microamp = <0x477c>;
			vdda-pll-supply = <0xffffffff>;
			vdda-qref-max-microamp = <0x7530>;
			vdda-qref-supply = <0xffffffff>;
		};
	};

	fragment@18 {
		target = <0xffffffff>;

		__overlay__ {
			qcom,vccq-parent-max-microamp = <0x33450>;
			qcom,vccq-parent-supply = <0xffffffff>;
			qcom,vddp-ref-clk-max-microamp = <0x64>;
			qcom,vddp-ref-clk-supply = <0xffffffff>;
			reset-gpios = <0xffffffff 0xd2 0x1>;
			reset-names = "rst";
			resets = <0xffffffff 0x18>;
			status = "ok";
			vcc-max-microamp = <0x13d620>;
			vcc-supply = <0xffffffff>;
			vccq-max-microamp = <0x124f80>;
			vccq-supply = <0xffffffff>;
			vdd-hba-supply = <0xffffffff>;
		};
	};

	fragment@19 {
		target = <0xffffffff>;

		__overlay__ {
			#address-cells = <0x1>;
			#size-cells = <0x0>;
			qcom,i2c-touch-active = "goodix,gt9916";
			status = "ok";

			goodix-berlin@5d {
				avdd-supply = <0xffffffff>;
				compatible = "goodix,gt9916";
				goodix,avdd-name = "avdd";
				goodix,config-name = "goodix_cfg_group_i2c.bin";
				goodix,firmware-name = "goodix_firmware_i2c.bin";
				goodix,iovdd-name = "iovdd";
				goodix,irq-flags = <0x2>;
				goodix,irq-gpio = <0xffffffff 0x19 0x2008>;
				goodix,panel-max-p = <0x1000>;
				goodix,panel-max-w = <0xff>;
				goodix,panel-max-x = <0x438>;
				goodix,panel-max-y = <0x960>;
				goodix,qts_en;
				goodix,reset-gpio = <0xffffffff 0x18 0x0>;
				goodix,touch-type = "primary";
				interrupt-parent = <0xffffffff>;
				interrupts = <0x19 0x2008>;
				invert_xy;
				iovdd-supply = <0xffffffff>;
				qts,touch-environment = "pvm";
				qts,trusted-touch-io-bases = <0xa90000>;
				qts,trusted-touch-io-sizes = <0x1000>;
				qts,trusted-touch-mode = "vm_mode";
				qts,trusted-touch-spi-irq = <0x239>;
				qts,trusted-touch-type = "primary";
				qts,trusted-touch-vm-gpio-list = <0xffffffff 0x2c 0x0 0xffffffff 0x2d 0x0 0xffffffff 0x2e 0x0 0xffffffff 0x2f 0x0 0xffffffff 0x18 0x0 0xffffffff 0x19 0x2008>;
				reg = <0x5d>;
			};
		};
	};

	fragment@2 {
		target = <0xffffffff>;

		__overlay__ {
			#address-cells = <0x2>;
			#interrupt-cells = <0x4>;
			#size-cells = <0x0>;
			interrupt-controller;

			qcom,pm8550b@7 {
				#address-cells = <0x1>;
				#size-cells = <0x0>;
				compatible = "qcom,spmi-pmic";
				reg = <0x7 0x0>;

				bcl-soc {
					#thermal-sensor-cells = <0x0>;
					compatible = "qcom,msm-bcl-soc";
					phandle = <0x44>;
				};

				bcl@4700 {
					#thermal-sensor-cells = <0x1>;
					compatible = "qcom,bcl-v5";
					interrupt-names = "bcl-lvl0", "bcl-lvl1", "bcl-lvl2";
					interrupts = <0x7 0x47 0x0 0x0 0x7 0x47 0x1 0x0 0x7 0x47 0x2 0x0>;
					phandle = <0xa>;
					qcom,pmic7-threshold;
					reg = <0x4700 0x100>;
				};

				pinctrl@8800 {
					#gpio-cells = <0x2>;
					#interrupt-cells = <0x2>;
					compatible = "qcom,pm8550b-gpio";
					gpio-controller;
					interrupt-controller;
					phandle = <0x41>;
					reg = <0x8800>;
				};

				pm8550b-temp-alarm-lite@c00 {
					#thermal-sensor-cells = <0x0>;
					compatible = "qcom,spmi-temp-alarm";
					interrupts = <0x7 0xc 0x0 0x3>;
					io-channel-names = "thermal";
					io-channels = <0x1 0x718>;
					phandle = <0x9>;
					reg = <0xc00>;
				};

				pm8550b-temp-alarm@a00 {
					#thermal-sensor-cells = <0x0>;
					compatible = "qcom,spmi-temp-alarm";
					interrupts = <0x7 0xa 0x0 0x3>;
					io-channel-names = "thermal";
					io-channels = <0x1 0x703>;
					phandle = <0x8>;
					reg = <0xa00>;
				};

				qcom,eusb2-repeater@fd00 {
					compatible = "qcom,pmic-eusb2-repeater";
					phandle = <0x2c>;
					qcom,param-override-seq = <0x8 0x51 0x3 0x54 0x5 0x57>;
					reg = <0xfd00>;
					vdd18-supply = <0xffffffff>;
					vdd3-supply = <0xffffffff>;
				};

				qcom,hv-haptics@f000 {
					compatible = "qcom,hv-haptics";
					interrupt-names = "fifo-empty";
					interrupts = <0x7 0xf0 0x1 0x1>;
					nvmem = <0x7>;
					nvmem-names = "hap_cfg_sdam";
					phandle = <0x42>;
					qcom,brake-mode = <0x1>;
					qcom,brake-pattern = [ff 3f 1f];
					qcom,brake-sig-shape = <0x1>;
					qcom,drv-sig-shape = <0x1>;
					qcom,lra-period-us = <0x1a0b>;
					qcom,vmax-mv = <0xe10>;
					reg = <0xf000 0xf100 0xf200>;
					status = "okay";

					effect_0 {
						qcom,effect-id = <0x0>;
						qcom,wf-auto-res-disable;
						qcom,wf-brake-pattern = [00 00 00];
						qcom,wf-pattern-data = <0x1f 0x0 0x0 0x3f 0x0 0x0 0x5f 0x0 0x0 0x7f 0x0 0x0 0x17f 0x0 0x0 0x15f 0x0 0x0 0x13f 0x0 0x0 0x11f 0x0 0x0>;
						qcom,wf-pattern-period-us = <0x1a0b>;
						qcom,wf-pattern-preload;
						qcom,wf-vmax-mv = <0xe10>;
					};

					effect_1 {
						qcom,effect-id = <0x1>;
						qcom,wf-auto-res-disable;
						qcom,wf-brake-pattern = [00 00 00];
						qcom,wf-pattern-data = <0x1f 0x0 0x0 0x3f 0x0 0x0 0x5f 0x0 0x0 0x7f 0x0 0x0 0x17f 0x0 0x0 0x15f 0x0 0x0 0x13f 0x0 0x0 0x11f 0x0 0x0>;
						qcom,wf-pattern-period-us = <0x1a0b>;
						qcom,wf-vmax-mv = <0xe10>;
					};

					effect_2 {
						qcom,effect-id = <0x2>;
						qcom,wf-auto-res-disable;
						qcom,wf-brake-pattern = [00 00 00];
						qcom,wf-pattern-data = <0x1f 0x0 0x0 0x3f 0x0 0x0 0x5f 0x0 0x0 0x7f 0x0 0x0 0x17f 0x0 0x0 0x15f 0x0 0x0 0x13f 0x0 0x0 0x11f 0x0 0x0>;
						qcom,wf-pattern-period-us = <0x1a0b>;
						qcom,wf-vmax-mv = <0xe10>;
					};

					effect_3 {
						qcom,effect-id = <0x3>;
						qcom,wf-auto-res-disable;
						qcom,wf-brake-pattern = [00 00 00];
						qcom,wf-pattern-data = <0x1f 0x0 0x0 0x3f 0x0 0x0 0x5f 0x0 0x0 0x7f 0x0 0x0 0x17f 0x0 0x0 0x15f 0x0 0x0 0x13f 0x0 0x0 0x11f 0x0 0x0>;
						qcom,wf-pattern-period-us = <0x1a0b>;
						qcom,wf-vmax-mv = <0xe10>;
					};

					effect_4 {
						qcom,effect-id = <0x4>;
						qcom,wf-auto-res-disable;
						qcom,wf-brake-pattern = [00 00 00];
						qcom,wf-pattern-data = <0x1f 0x0 0x0 0x3f 0x0 0x0 0x5f 0x0 0x0 0x7f 0x0 0x0 0x17f 0x0 0x0 0x15f 0x0 0x0 0x13f 0x0 0x0 0x11f 0x0 0x0>;
						qcom,wf-pattern-period-us = <0x1a0b>;
						qcom,wf-vmax-mv = <0xe10>;
					};

					effect_5 {
						qcom,effect-id = <0x5>;
						qcom,wf-auto-res-disable;
						qcom,wf-brake-pattern = [00 00 00];
						qcom,wf-pattern-data = <0x1f 0x0 0x0 0x3f 0x0 0x0 0x5f 0x0 0x0 0x7f 0x0 0x0 0x17f 0x0 0x0 0x15f 0x0 0x0 0x13f 0x0 0x0 0x11f 0x0 0x0>;
						qcom,wf-pattern-period-us = <0x1a0b>;
						qcom,wf-vmax-mv = <0xe10>;
					};

					primitive_0 {
						qcom,primitive-id = <0x0>;
						qcom,wf-auto-res-disable;
						qcom,wf-brake-pattern = [00 00 00];
						qcom,wf-pattern-data = <0x0 0x0 0x0 0x0 0x0 0x0>;
						qcom,wf-pattern-period-us = <0x1047>;
						qcom,wf-vmax-mv = <0x12c0>;
					};

					primitive_1 {
						qcom,primitive-id = <0x1>;
						qcom,wf-auto-res-disable;
						qcom,wf-brake-pattern = [00 00 00];
						qcom,wf-pattern-data = <0xff 0x0 0x0 0x7f 0x0 0x0>;
						qcom,wf-pattern-period-us = <0x1047>;
						qcom,wf-vmax-mv = <0x12c0>;
					};

					primitive_2 {
						qcom,primitive-id = <0x2>;
						qcom,wf-auto-res-disable;
						qcom,wf-brake-pattern = [00 00 00];
						qcom,wf-pattern-data = <0xff 0x0 0x0 0x7f 0x0 0x0>;
						qcom,wf-pattern-period-us = <0x1047>;
						qcom,wf-vmax-mv = <0x12c0>;
					};

					primitive_3 {
						qcom,primitive-id = <0x3>;
						qcom,wf-auto-res-disable;
						qcom,wf-brake-pattern = [00 00 00];
						qcom,wf-pattern-data = <0xff 0x0 0x0 0x7f 0x0 0x0>;
						qcom,wf-pattern-period-us = <0x1047>;
						qcom,wf-vmax-mv = <0x12c0>;
					};

					primitive_4 {
						qcom,primitive-id = <0x4>;
						qcom,wf-auto-res-disable;
						qcom,wf-brake-pattern = [00 00 00];
						qcom,wf-pattern-data = <0xff 0x0 0x0 0x7f 0x0 0x0>;
						qcom,wf-pattern-period-us = <0x1047>;
						qcom,wf-vmax-mv = <0x12c0>;
					};

					primitive_5 {
						qcom,primitive-id = <0x5>;
						qcom,wf-auto-res-disable;
						qcom,wf-brake-pattern = [00 00 00];
						qcom,wf-pattern-data = <0xff 0x0 0x0 0x7f 0x0 0x0>;
						qcom,wf-pattern-period-us = <0x1047>;
						qcom,wf-vmax-mv = <0x12c0>;
					};

					primitive_6 {
						qcom,primitive-id = <0x6>;
						qcom,wf-auto-res-disable;
						qcom,wf-brake-pattern = [00 00 00];
						qcom,wf-pattern-data = <0xff 0x0 0x0 0x7f 0x0 0x0>;
						qcom,wf-pattern-period-us = <0x1047>;
						qcom,wf-vmax-mv = <0x12c0>;
					};

					primitive_7 {
						qcom,primitive-id = <0x7>;
						qcom,wf-auto-res-disable;
						qcom,wf-brake-pattern = [00 00 00];
						qcom,wf-pattern-data = <0xff 0x0 0x0 0x7f 0x0 0x0>;
						qcom,wf-pattern-period-us = <0x1047>;
						qcom,wf-vmax-mv = <0x12c0>;
					};

					primitive_8 {
						qcom,primitive-id = <0x8>;
						qcom,wf-auto-res-disable;
						qcom,wf-brake-pattern = [00 00 00];
						qcom,wf-pattern-data = <0xff 0x0 0x0 0x7f 0x0 0x0>;
						qcom,wf-pattern-period-us = <0x1047>;
						qcom,wf-vmax-mv = <0x12c0>;
					};

					qcom,hap-swr-slave-reg {
						phandle = <0x43>;
						regulator-name = "hap-swr-slave-reg";
					};
				};
			};
		};
	};

	fragment@20 {
		target = <0xffffffff>;

		__overlay__ {
			dummy-supply = <0x2c>;
			usb-repeater = <0x2c>;
		};
	};

	fragment@21 {
		target = <0xffffffff>;

		__overlay__ {
			usb-role-switch;

			port {

				endpoint {
					phandle = <0x2e>;
					remote-endpoint = <0x2d>;
				};
			};
		};
	};

	fragment@22 {
		target = <0xffffffff>;

		__overlay__ {

			connector {

				port {

					endpoint {
						phandle = <0x2d>;
						remote-endpoint = <0x2e>;
					};
				};
			};
		};
	};

	fragment@23 {
		target = <0xffffffff>;

		__overlay__ {
			qcom,thermal-mitigation = <0x2dc6c0 0x16e360 0xf4240 0x7a120>;
			qcom,wireless-fw-name = "idt9418.bin";
		};
	};

	fragment@24 {
		target = <0xffffffff>;

		__overlay__ {
			qcom,pcie-phy-ver = <0x68>;
			qcom,phy-sequence = <0x1240 0x3 0x0 0x30 0x18 0x0 0x34 0x3 0x0 0x78 0x1 0x0 0x7c 0x0 0x0 0x80 0x51 0x0 0x90 0x12 0x0 0xac 0x34 0x0 0xb0 0x0 0x0 0xcc 0x0 0x0 0x208 0xc 0x0 0x20c 0xa 0x0 0x218 0x4 0x0 0x220 0x16 0x0 0x234 0x0 0x0 0x29c 0x80 0x0 0x2a0 0x7c 0x0 0x2ac 0x0 0x0 0x2b0 0x20 0x0 0x2b4 0x5 0x0 0x2b8 0x0 0x0 0x2e0 0x40 0x0 0x2e4 0x0 0x0 0x2e8 0xa 0x0 0x30c 0xd 0x0 0x318 0x80 0x0 0x31c 0xa 0x0 0x320 0xf 0x0 0x33c 0x74 0x0 0x340 0x0 0x0 0x348 0x1c 0x0 0x34c 0x24 0x0 0x354 0xe 0x0 0x388 0x20 0x0 0x390 0x28 0x0 0x394 0x30 0x0 0x39c 0xc 0x0 0x3dc 0x9 0x0 0x3f4 0x14 0x0 0x3f8 0xb3 0x0 0x3fc 0x58 0x0 0x400 0x9a 0x0 0x404 0x26 0x0 0x408 0xb6 0x0 0x40c 0xee 0x0 0x410 0xdb 0x0 0x414 0xdb 0x0 0x418 0xa0 0x0 0x41c 0xdf 0x0 0x420 0x78 0x0 0x424 0x76 0x0 0x428 0xff 0x0 0x830 0x18 0x0 0x834 0x3 0x0 0x878 0x1 0x0 0x87c 0x0 0x0 0x880 0x51 0x0 0x890 0x12 0x0 0x8ac 0x34 0x0 0x8b0 0x0 0x0 0x8cc 0x0 0x0 0xa08 0xc 0x0 0xa0c 0xa 0x0 0xa18 0x4 0x0 0xa20 0x16 0x0 0xa34 0x0 0x0 0xa9c 0x80 0x0 0xaa0 0x7c 0x0 0xaac 0x0 0x0 0xab0 0x20 0x0 0xab4 0x5 0x0 0xab8 0x0 0x0 0xae0 0x40 0x0 0xae4 0x0 0x0 0xae8 0xa 0x0 0xb0c 0xd 0x0 0xb18 0x80 0x0 0xb1c 0xa 0x0 0xb20 0xf 0x0 0xb3c 0x74 0x0 0xb40 0x0 0x0 0xb48 0x1c 0x0 0xb4c 0x24 0x0 0xb54 0xe 0x0 0xb88 0x20 0x0 0xb90 0x28 0x0 0xb94 0x30 0x0 0xb9c 0xc 0x0 0xbdc 0x9 0x0 0xbf4 0x14 0x0 0xbf8 0xb3 0x0 0xbfc 0x58 0x0 0xc00 0x9a 0x0 0xc04 0x26 0x0 0xc08 0xb6 0x0 0xc0c 0xee 0x0 0xc10 0xdb 0x0 0xc14 0xdb 0x0 0xc18 0xa0 0x0 0xc1c 0xdf 0x0 0xc20 0x78 0x0 0xc24 0x76 0x0 0xc28 0xff 0x0 0xea0 0x1 0x0 0xeb4 0x0 0x0 0xeb8 0x8 0x0 0xebc 0x3e 0x0 0xec0 0x1e 0x0 0xec4 0x0 0x0 0xec8 0x1f 0x0 0xed4 0x12 0x0 0xed8 0x12 0x0 0xedc 0xdb 0x0 0xee0 0x9a 0x0 0xee4 0x3f 0x0 0xee8 0xb6 0x0 0xeec 0x64 0x0 0xef0 0x1f 0x0 0xef4 0x1f 0x0 0xef8 0x1f 0x0 0xefc 0x1f 0x0 0xf00 0x1f 0x0 0xf04 0x1f 0x0 0xf0c 0x1f 0x0 0xf14 0x1f 0x0 0xf1c 0x1f 0x0 0xf28 0x5b 0x0 0x1000 0x26 0x0 0x1004 0x3 0x0 0x1010 0x6 0x0 0x1014 0x16 0x0 0x1018 0x36 0x0 0x101c 0x4 0x0 0x1020 0xa 0x0 0x1024 0x1a 0x0 0x1028 0x68 0x0 0x1030 0xab 0x0 0x1034 0xaa 0x0 0x1038 0x2 0x0 0x103c 0x12 0x0 0x1060 0xf8 0x0 0x1064 0x1 0x0 0x1070 0x6 0x0 0x1074 0x16 0x0 0x1078 0x36 0x0 0x107c 0xa 0x0 0x1080 0x4 0x0 0x1084 0xd 0x0 0x1088 0x41 0x0 0x1090 0xab 0x0 0x1094 0xaa 0x0 0x1098 0x1 0x0 0x109c 0x0 0x0 0x10bc 0xa 0x0 0x10c0 0x1 0x0 0x10cc 0x62 0x0 0x10d0 0x2 0x0 0x10d8 0x40 0x0 0x10dc 0x14 0x0 0x10e0 0x90 0x0 0x10e4 0x82 0x0 0x10f4 0xf 0x0 0x1110 0x8 0x0 0x1120 0x46 0x0 0x1124 0x4 0x0 0x1140 0x14 0x0 0x1164 0x34 0x0 0x1170 0xa0 0x0 0x1174 0x6 0x0 0x1184 0x88 0x0 0x1188 0x14 0x0 0x118c 0x0 0x0 0x1190 0x64 0x0 0x1194 0x0 0x0 0x1198 0xf 0x0 0x1378 0x2e 0x0 0x1390 0xcc 0x0 0x13f0 0xd 0x0 0x13f8 0x0 0x0 0x13fc 0x22 0x0 0x141c 0xc1 0x0 0x1490 0x0 0x0 0x14a0 0x16 0x0 0x14f0 0x27 0x0 0x14f4 0x27 0x0 0x14fc 0xd 0x0 0x1508 0x2 0x0 0x155c 0x2e 0x0 0x157c 0x3 0x0 0x1584 0x28 0x0 0x13dc 0x4 0x0 0x13e0 0x2 0x0 0x1418 0xc0 0x0 0x140c 0x1d 0x0 0x158c 0xf 0x0 0x1370 0xf 0x0 0x15ac 0xf2 0x0 0x15c0 0xf2 0x0 0x1200 0x0 0x0 0x1244 0x3 0x0>;
		};
	};

	fragment@3 {
		target = <0xffffffff>;

		__overlay__ {

			pm8550b-bcl-lvl0 {
				polling-delay = <0x0>;
				polling-delay-passive = <0x64>;
				thermal-sensors = <0xa 0x5>;

				trips {

					b-bcl-lvl0 {
						hysteresis = <0x1>;
						phandle = <0x1b>;
						temperature = <0x1>;
						type = "passive";
					};

					thermal-engine-trip {
						hysteresis = <0x0>;
						temperature = <0x64>;
						type = "passive";
					};

					thermal-hal-trip {
						hysteresis = <0x0>;
						temperature = <0x64>;
						type = "passive";
					};
				};
			};

			pm8550b-bcl-lvl1 {
				polling-delay = <0x0>;
				polling-delay-passive = <0x64>;
				thermal-sensors = <0xa 0x6>;

				trips {

					b-bcl-lvl1 {
						hysteresis = <0x1>;
						phandle = <0x1c>;
						temperature = <0x1>;
						type = "passive";
					};

					thermal-engine-trip {
						hysteresis = <0x0>;
						temperature = <0x64>;
						type = "passive";
					};

					thermal-hal-trip {
						hysteresis = <0x0>;
						temperature = <0x64>;
						type = "passive";
					};
				};
			};

			pm8550b-bcl-lvl2 {
				polling-delay = <0x0>;
				polling-delay-passive = <0x64>;
				thermal-sensors = <0xa 0x7>;

				trips {

					b-bcl-lvl2 {
						hysteresis = <0x1>;
						phandle = <0x1d>;
						temperature = <0x1>;
						type = "passive";
					};

					thermal-engine-trip {
						hysteresis = <0x0>;
						temperature = <0x64>;
						type = "passive";
					};

					thermal-hal-trip {
						hysteresis = <0x0>;
						temperature = <0x64>;
						type = "passive";
					};
				};
			};

			pm8550b-ibat-lvl0 {
				polling-delay = <0x0>;
				polling-delay-passive = <0x0>;
				thermal-sensors = <0xa 0x0>;

				trips {

					ibat-lvl0 {
						hysteresis = <0xc8>;
						phandle = <0x4a>;
						temperature = <0x2710>;
						type = "passive";
					};
				};
			};

			pm8550b-ibat-lvl1 {
				polling-delay = <0x0>;
				polling-delay-passive = <0x0>;
				thermal-sensors = <0xa 0x1>;

				trips {

					ibat-lvl1 {
						hysteresis = <0xc8>;
						phandle = <0x4b>;
						temperature = <0x2cec>;
						type = "passive";
					};
				};
			};

			pm8550b_lite_tz {
				phandle = <0x49>;
				polling-delay = <0x0>;
				polling-delay-passive = <0x64>;
				thermal-governor = "step_wise";
				thermal-sensors = <0x9>;

				trips {

					trip0 {
						hysteresis = <0x0>;
						temperature = <0x1e848>;
						type = "passive";
					};

					trip1 {
						hysteresis = <0x0>;
						temperature = <0x20f58>;
						type = "passive";
					};

					trip2 {
						hysteresis = <0x0>;
						temperature = <0x23668>;
						type = "critical";
					};
				};
			};

			pm8550b_tz {
				phandle = <0x45>;
				polling-delay = <0x0>;
				polling-delay-passive = <0x64>;
				thermal-governor = "step_wise";
				thermal-sensors = <0x8>;

				trips {

					trip0 {
						hysteresis = <0x0>;
						phandle = <0x46>;
						temperature = <0x17318>;
						type = "passive";
					};

					trip1 {
						hysteresis = <0x0>;
						phandle = <0x47>;
						temperature = <0x1c138>;
						type = "passive";
					};

					trip2 {
						hysteresis = <0x0>;
						phandle = <0x48>;
						temperature = <0x23668>;
						type = "critical";
					};
				};
			};

			socd {
				polling-delay = <0x0>;
				polling-delay-passive = <0x64>;

				trips {

					socd-trip {
						hysteresis = <0x0>;
						phandle = <0x1a>;
						temperature = <0x5a>;
						type = "passive";
					};

					thermal-engine-trip {
						hysteresis = <0x0>;
						temperature = <0x64>;
						type = "passive";
					};

					thermal-hal-trip {
						hysteresis = <0x0>;
						temperature = <0x64>;
						type = "passive";
					};
				};
			};
		};
	};

	fragment@4 {
		target = <0xffffffff>;

		__overlay__ {
			#address-cells = <0x2>;
			#interrupt-cells = <0x4>;
			#size-cells = <0x0>;
			interrupt-controller;

			qcom,pm8550ve_f@5 {
				#address-cells = <0x1>;
				#size-cells = <0x0>;
				compatible = "qcom,spmi-pmic";
				reg = <0x5 0x0>;

				pinctrl@8800 {
					#gpio-cells = <0x2>;
					#interrupt-cells = <0x2>;
					compatible = "qcom,pm8550ve-gpio";
					gpio-controller;
					interrupt-controller;
					phandle = <0x4c>;
					reg = <0x8800>;
				};

				pm8550ve-f-temp-alarm@a00 {
					#thermal-sensor-cells = <0x0>;
					compatible = "qcom,spmi-temp-alarm";
					interrupts = <0x5 0xa 0x0 0x3>;
					io-channel-names = "thermal";
					io-channels = <0x1 0x503>;
					phandle = <0xb>;
					reg = <0xa00>;
				};
			};
		};
	};

	fragment@5 {
		target = <0xffffffff>;

		__overlay__ {

			pm8550ve_f_tz {
				phandle = <0x4d>;
				polling-delay = <0x0>;
				polling-delay-passive = <0x64>;
				thermal-governor = "step_wise";
				thermal-sensors = <0xb>;

				trips {

					trip0 {
						hysteresis = <0x0>;
						phandle = <0x23>;
						temperature = <0x17318>;
						type = "passive";
					};

					trip1 {
						hysteresis = <0x0>;
						phandle = <0x4e>;
						temperature = <0x1c138>;
						type = "passive";
					};

					trip2 {
						hysteresis = <0x0>;
						phandle = <0x4f>;
						temperature = <0x23668>;
						type = "critical";
					};
				};
			};
		};
	};

	fragment@6 {
		target = <0xffffffff>;

		__overlay__ {
			#address-cells = <0x2>;
			#interrupt-cells = <0x4>;
			#size-cells = <0x0>;
			interrupt-controller;

			qcom,pm8550vs@2 {
				#address-cells = <0x1>;
				#size-cells = <0x0>;
				compatible = "qcom,spmi-pmic";
				phandle = <0x50>;
				reg = <0x2 0x0>;

				pinctrl@8800 {
					#gpio-cells = <0x2>;
					#interrupt-cells = <0x2>;
					compatible = "qcom,pm8550vs-gpio";
					gpio-controller;
					interrupt-controller;
					phandle = <0x51>;
					reg = <0x8800>;
				};

				pm8550vs-c-temp-alarm@a00 {
					#thermal-sensor-cells = <0x0>;
					compatible = "qcom,spmi-temp-alarm";
					interrupts = <0x2 0xa 0x0 0x3>;
					io-channel-names = "thermal";
					io-channels = <0x1 0x203>;
					phandle = <0xc>;
					reg = <0xa00>;
				};
			};

			qcom,pm8550vs@3 {
				#address-cells = <0x1>;
				#size-cells = <0x0>;
				compatible = "qcom,spmi-pmic";
				phandle = <0x52>;
				reg = <0x3 0x0>;
				status = "ok";

				pinctrl@8800 {
					#gpio-cells = <0x2>;
					#interrupt-cells = <0x2>;
					compatible = "qcom,pm8550vs-gpio";
					gpio-controller;
					interrupt-controller;
					phandle = <0x53>;
					reg = <0x8800>;

					eusb2_repeater_reset {

						eusb2_repeater_reset_default {
							bias-disable;
							function = "normal";
							input-enable;
							output-enable;
							phandle = <0x54>;
							pins = "gpio4";
							power-source = <0x1>;
							qcom,drive-strength = <0x2>;
						};
					};
				};

				pm8550vs-d-temp-alarm@a00 {
					#thermal-sensor-cells = <0x0>;
					compatible = "qcom,spmi-temp-alarm";
					interrupts = <0x3 0xa 0x0 0x3>;
					io-channel-names = "thermal";
					io-channels = <0x1 0x303>;
					phandle = <0xd>;
					reg = <0xa00>;
				};
			};

			qcom,pm8550vs@4 {
				#address-cells = <0x1>;
				#size-cells = <0x0>;
				compatible = "qcom,spmi-pmic";
				phandle = <0x55>;
				reg = <0x4 0x0>;
				status = "ok";

				pinctrl@8800 {
					#gpio-cells = <0x2>;
					#interrupt-cells = <0x2>;
					compatible = "qcom,pm8550vs-gpio";
					gpio-controller;
					interrupt-controller;
					phandle = <0x56>;
					reg = <0x8800>;
				};

				pm8550vs-e-temp-alarm@a00 {
					#thermal-sensor-cells = <0x0>;
					compatible = "qcom,spmi-temp-alarm";
					interrupts = <0x4 0xa 0x0 0x3>;
					io-channel-names = "thermal";
					io-channels = <0x1 0x403>;
					phandle = <0xe>;
					reg = <0xa00>;
				};
			};

			qcom,pm8550vs@6 {
				#address-cells = <0x1>;
				#size-cells = <0x0>;
				compatible = "qcom,spmi-pmic";
				phandle = <0x57>;
				reg = <0x6 0x0>;
				status = "ok";

				pinctrl@8800 {
					#gpio-cells = <0x2>;
					#interrupt-cells = <0x2>;
					compatible = "qcom,pm8550vs-gpio";
					gpio-controller;
					interrupt-controller;
					phandle = <0x58>;
					reg = <0x8800>;
				};

				pm8550vs-g-temp-alarm@a00 {
					#thermal-sensor-cells = <0x0>;
					compatible = "qcom,spmi-temp-alarm";
					interrupts = <0x6 0xa 0x0 0x3>;
					io-channel-names = "thermal";
					io-channels = <0x1 0x603>;
					phandle = <0xf>;
					reg = <0xa00>;
				};
			};
		};
	};

	fragment@7 {
		target = <0xffffffff>;

		__overlay__ {

			pm8550vs_c_tz {
				phandle = <0x59>;
				polling-delay = <0x0>;
				polling-delay-passive = <0x64>;
				thermal-governor = "step_wise";
				thermal-sensors = <0xc>;

				trips {

					trip0 {
						hysteresis = <0x0>;
						phandle = <0x21>;
						temperature = <0x17318>;
						type = "passive";
					};

					trip1 {
						hysteresis = <0x0>;
						phandle = <0x5a>;
						temperature = <0x1c138>;
						type = "passive";
					};

					trip2 {
						hysteresis = <0x0>;
						phandle = <0x5b>;
						temperature = <0x23668>;
						type = "critical";
					};
				};
			};

			pm8550vs_d_tz {
				phandle = <0x5c>;
				polling-delay = <0x0>;
				polling-delay-passive = <0x64>;
				status = "ok";
				thermal-governor = "step_wise";
				thermal-sensors = <0xd>;

				trips {

					trip0 {
						hysteresis = <0x0>;
						phandle = <0x22>;
						temperature = <0x17318>;
						type = "passive";
					};

					trip1 {
						hysteresis = <0x0>;
						phandle = <0x5d>;
						temperature = <0x1c138>;
						type = "passive";
					};

					trip2 {
						hysteresis = <0x0>;
						phandle = <0x5e>;
						temperature = <0x23668>;
						type = "critical";
					};
				};
			};

			pm8550vs_e_tz {
				phandle = <0x5f>;
				polling-delay = <0x0>;
				polling-delay-passive = <0x64>;
				status = "ok";
				thermal-governor = "step_wise";
				thermal-sensors = <0xe>;

				trips {

					trip0 {
						hysteresis = <0x0>;
						phandle = <0x60>;
						temperature = <0x17318>;
						type = "passive";
					};

					trip1 {
						hysteresis = <0x0>;
						phandle = <0x61>;
						temperature = <0x1c138>;
						type = "passive";
					};

					trip2 {
						hysteresis = <0x0>;
						phandle = <0x62>;
						temperature = <0x23668>;
						type = "critical";
					};
				};
			};

			pm8550vs_g_tz {
				phandle = <0x63>;
				polling-delay = <0x0>;
				polling-delay-passive = <0x64>;
				status = "ok";
				thermal-governor = "step_wise";
				thermal-sensors = <0xf>;

				trips {

					trip0 {
						hysteresis = <0x0>;
						phandle = <0x64>;
						temperature = <0x17318>;
						type = "passive";
					};

					trip1 {
						hysteresis = <0x0>;
						phandle = <0x65>;
						temperature = <0x1c138>;
						type = "passive";
					};

					trip2 {
						hysteresis = <0x0>;
						phandle = <0x66>;
						temperature = <0x23668>;
						type = "critical";
					};
				};
			};
		};
	};

	fragment@8 {
		target = <0xffffffff>;

		__overlay__ {
			#address-cells = <0x2>;
			#interrupt-cells = <0x4>;
			#size-cells = <0x0>;
			interrupt-controller;

			qcom,pmk8550@0 {
				#address-cells = <0x1>;
				#size-cells = <0x0>;
				compatible = "qcom,spmi-pmic";
				reg = <0x0 0x0>;

				pinctrl@b800 {
					#gpio-cells = <0x2>;
					#interrupt-cells = <0x2>;
					compatible = "qcom,pmk8550-gpio";
					gpio-controller;
					interrupt-controller;
					phandle = <0x69>;
					pinctrl-0 = <0x10>;
					pinctrl-names = "default";
					reg = <0xb800>;

					alt_sleep_clk {

						alt_sleep_clk_default {
							bias-disable;
							function = "func1";
							input-disable;
							output-enable;
							phandle = <0x10>;
							pins = "gpio3";
							power-source = <0x0>;
						};
					};
				};

				pon_hlos@1300 {
					compatible = "qcom,pm8998-pon";
					reg = <0x1300 0x800>;
					reg-names = "pon_hlos", "pon_pbs";

					pwrkey {
						compatible = "qcom,pmk8350-pwrkey";
						interrupts = <0x0 0x13 0x7 0x3>;
						linux,code = <0x74>;
					};

					pwrkey-bark {
						compatible = "qcom,pmk8350-pwrkey-bark";
						interrupts = <0x0 0x13 0x0 0x3>;
						linux,code = <0x74>;
					};

					pwrkey-resin-bark {
						compatible = "qcom,pmk8350-pwrkey-resin-bark";
						interrupts = <0x0 0x13 0x2 0x3>;
						linux,code = <0x74>;
					};

					resin {
						compatible = "qcom,pmk8350-resin";
						interrupts = <0x0 0x13 0x6 0x3>;
						linux,code = <0x72>;
					};
				};

				rtc@6100 {
					compatible = "qcom,pmk8350-rtc";
					interrupts = <0x0 0x62 0x1 0x1>;
					phandle = <0x6a>;
					reg = <0x6100 0x6200>;
					reg-names = "rtc", "alarm";
				};

				sdam@7000 {
					#address-cells = <0x1>;
					#size-cells = <0x1>;
					compatible = "qcom,spmi-sdam";
					phandle = <0x67>;
					reg = <0x7000>;

					ocp-log@76 {
						phandle = <0x19>;
						reg = <0x76 0x6>;
					};
				};

				sdam@7100 {
					#address-cells = <0x1>;
					#size-cells = <0x1>;
					compatible = "qcom,spmi-sdam";
					phandle = <0x68>;
					reg = <0x7100>;

					restart@48 {
						bits = <0x1 0x7>;
						phandle = <0x15>;
						reg = <0x48 0x1>;
					};
				};

				sdam@7400 {
					compatible = "qcom,spmi-sdam";
					phandle = <0x17>;
					reg = <0x7400>;
				};

				sdam@7500 {
					compatible = "qcom,spmi-sdam";
					phandle = <0x18>;
					reg = <0x7500>;
				};

				sdam@8400 {
					compatible = "qcom,spmi-sdam";
					phandle = <0x2>;
					reg = <0x8400>;
				};

				sdam@8500 {
					compatible = "qcom,spmi-sdam";
					phandle = <0x3>;
					reg = <0x8500>;
				};

				sdam@9d00 {
					compatible = "qcom,spmi-sdam";
					phandle = <0x7>;
					reg = <0x9d00>;
				};

				vadc@9000 {
					#address-cells = <0x1>;
					#io-channel-cells = <0x1>;
					#size-cells = <0x0>;
					#thermal-sensor-cells = <0x1>;
					compatible = "qcom,spmi-adc5-gen3";
					interrupt-names = "adc-sdam0", "adc-sdam1";
					interrupts = <0x0 0x90 0x1 0x1 0x0 0x91 0x1 0x1>;
					io-channel-ranges;
					phandle = <0x1>;
					reg = <0x9000 0x9100>;

					pm8550_die_temp {
						label = "pm8550_die_temp";
						qcom,pre-scaling = <0x1 0x1>;
						reg = <0x103>;
					};

					pm8550_offset_ref {
						label = "pm8550_offset_ref";
						qcom,pre-scaling = <0x1 0x1>;
						reg = <0x100>;
					};

					pm8550_vph_pwr {
						label = "pm8550_vph_pwr";
						qcom,pre-scaling = <0x1 0x3>;
						reg = <0x18e>;
					};

					pm8550_vref_1p25 {
						label = "pm8550_vref_1p25";
						qcom,pre-scaling = <0x1 0x1>;
						reg = <0x101>;
					};

					pm8550b_die_temp {
						label = "pm8550b_die_temp";
						qcom,pre-scaling = <0x1 0x1>;
						reg = <0x703>;
					};

					pm8550b_lite_die_temp {
						label = "pm8550b_lite_die_temp";
						qcom,pre-scaling = <0x1 0x1>;
						reg = <0x718>;
					};

					pm8550b_offset_ref {
						label = "pm8550b_offset_ref";
						qcom,pre-scaling = <0x1 0x1>;
						reg = <0x700>;
					};

					pm8550b_vbat_sns_qbg {
						label = "pm8550b_vbat_sns_qbg";
						qcom,pre-scaling = <0x1 0x3>;
						reg = <0x78f>;
					};

					pm8550b_vph_pwr {
						label = "pm8550b_vph_pwr";
						qcom,pre-scaling = <0x1 0x3>;
						reg = <0x78e>;
					};

					pm8550b_vref_1p25 {
						label = "pm8550b_vref_1p25";
						qcom,pre-scaling = <0x1 0x1>;
						reg = <0x701>;
					};

					pm8550ve_die_temp {
						label = "pm8550ve_die_temp";
						qcom,pre-scaling = <0x1 0x1>;
						reg = <0x503>;
					};

					pm8550vs_c_die_temp {
						label = "pm8550vs_c_die_temp";
						qcom,pre-scaling = <0x1 0x1>;
						reg = <0x203>;
					};

					pm8550vs_d_die_temp {
						label = "pm8550vs_d_die_temp";
						qcom,pre-scaling = <0x1 0x1>;
						reg = <0x303>;
					};

					pm8550vs_e_die_temp {
						label = "pm8550vs_e_die_temp";
						qcom,pre-scaling = <0x1 0x1>;
						reg = <0x403>;
					};

					pm8550vs_g_die_temp {
						label = "pm8550vs_g_die_temp";
						qcom,pre-scaling = <0x1 0x1>;
						reg = <0x603>;
					};

					pmk8550_die_temp {
						label = "pmk8550_die_temp";
						qcom,pre-scaling = <0x1 0x1>;
						reg = <0x3>;
					};

					pmk8550_offset_ref {
						label = "pmk8550_offset_ref";
						qcom,pre-scaling = <0x1 0x1>;
						reg = <0x0>;
					};

					pmk8550_vref_1p25 {
						label = "pmk8550_vref_1p25";
						qcom,pre-scaling = <0x1 0x1>;
						reg = <0x1>;
					};

					pmk8550_xo_therm {
						label = "pmk8550_xo_therm";
						qcom,adc-tm-type = <0x1>;
						qcom,hw-settle-time = <0xc8>;
						qcom,pre-scaling = <0x1 0x1>;
						qcom,ratiometric;
						reg = <0x44>;
					};
				};
			};
		};
	};

	fragment@9 {
		target = <0xffffffff>;

		__overlay__ {
			#address-cells = <0x2>;
			#interrupt-cells = <0x4>;
			#size-cells = <0x0>;
			interrupt-controller;

			qcom,pmr735d@a {
				#address-cells = <0x1>;
				#size-cells = <0x0>;
				compatible = "qcom,spmi-pmic";
				reg = <0xa 0x0>;

				pinctrl@8800 {
					#gpio-cells = <0x2>;
					#interrupt-cells = <0x2>;
					compatible = "qcom,pmr735d-gpio";
					gpio-controller;
					interrupt-controller;
					phandle = <0x6b>;
					reg = <0x8800>;
				};

				pmr735d-k-temp-alarm@a00 {
					#thermal-sensor-cells = <0x0>;
					compatible = "qcom,spmi-temp-alarm";
					interrupts = <0xa 0xa 0x0 0x3>;
					phandle = <0x11>;
					reg = <0xa00>;
				};
			};

			qcom,pmr735d@b {
				#address-cells = <0x1>;
				#size-cells = <0x0>;
				compatible = "qcom,spmi-pmic";
				reg = <0xb 0x0>;

				pinctrl@8800 {
					#gpio-cells = <0x2>;
					#interrupt-cells = <0x2>;
					compatible = "qcom,pmr735d-gpio";
					gpio-controller;
					interrupt-controller;
					phandle = <0x6c>;
					reg = <0x8800>;
				};

				pmr735d-l-temp-alarm@a00 {
					#thermal-sensor-cells = <0x0>;
					compatible = "qcom,spmi-temp-alarm";
					interrupts = <0xb 0xa 0x0 0x3>;
					phandle = <0x12>;
					reg = <0xa00>;
				};
			};
		};
	};
};
