/dts-v1/;

/ {
	compatible = "qcom,kalama-mtp", "qcom,kalama", "qcom,mtp";
	model = "Qualcomm Technologies, Inc. 8550 fuxi";
	qcom,board-id = <0x10008 0x0>;
	qcom,msm-id = <0x258 0x20000 0x259 0x20000>;
	xiaomi,miboard-id = <0x2 0x0>;

	__fixups__ {
		APC1_pause = "/fragment@15/__overlay__/socd/cooling-maps/socd_apc1:cooling-device:0", "/fragment@15/__overlay__/pm8550vs_c_tz/cooling-maps/pm8550vs_c_apc1:cooling-device:0", "/fragment@15/__overlay__/xo-therm/cooling-maps/apc1_cdev:cooling-device:0";
		L10B = "/fragment@14/__overlay__/regulator-ocp-notifier:periph-1ca-supply:0";
		L11B = "/fragment@14/__overlay__/regulator-ocp-notifier:periph-1cb-supply:0";
		L12B = "/fragment@14/__overlay__/regulator-ocp-notifier:periph-1cc-supply:0", "/fragment@21/__overlay__/goodix-berlin@5d:iovdd-supply:0", "/fragment@34/__overlay__/fts@0:vdd-supply:0";
		L13B = "/fragment@14/__overlay__/regulator-ocp-notifier:periph-1cd-supply:0", "/fragment@40:target:0";
		L14B = "/fragment@14/__overlay__/regulator-ocp-notifier:periph-1ce-supply:0", "/fragment@21/__overlay__/goodix-berlin@5d:avdd-supply:0";
		L15B = "/fragment@14/__overlay__/regulator-ocp-notifier:periph-1cf-supply:0", "/fragment@35/__overlay__/nq@28:qcom,sn-vdd-1p8-supply:0";
		L16B = "/fragment@14/__overlay__/regulator-ocp-notifier:periph-1d0-supply:0";
		L17B = "/fragment@14/__overlay__/regulator-ocp-notifier:periph-1d1-supply:0";
		L1B = "/fragment@14/__overlay__/regulator-ocp-notifier:periph-1c1-supply:0";
		L1C = "/fragment@14/__overlay__/regulator-ocp-notifier:periph-2c1-supply:0";
		L1D = "/fragment@14/__overlay__/regulator-ocp-notifier:periph-3c1-supply:0";
		L1E = "/fragment@14/__overlay__/regulator-ocp-notifier:periph-4c1-supply:0";
		L1F = "/fragment@14/__overlay__/regulator-ocp-notifier:periph-5c1-supply:0";
		L1G = "/fragment@14/__overlay__/regulator-ocp-notifier:periph-6c1-supply:0";
		L1K = "/fragment@14/__overlay__/regulator-ocp-notifier:periph-ac1-supply:0";
		L1M = "/fragment@14/__overlay__/regulator-ocp-notifier:periph-c40-supply:0";
		L2B = "/fragment@14/__overlay__/regulator-ocp-notifier:periph-1c2-supply:0";
		L2D_LEVEL = "/fragment@14/__overlay__/regulator-ocp-notifier:periph-3c2-supply:0";
		L2E = "/fragment@14/__overlay__/regulator-ocp-notifier:periph-4c2-supply:0";
		L2F = "/fragment@14/__overlay__/regulator-ocp-notifier:periph-5c2-supply:0";
		L2G = "/fragment@14/__overlay__/regulator-ocp-notifier:periph-6c2-supply:0";
		L2K = "/fragment@14/__overlay__/regulator-ocp-notifier:periph-ac2-supply:0";
		L2M = "/fragment@14/__overlay__/regulator-ocp-notifier:periph-c41-supply:0";
		L3E = "/fragment@14/__overlay__/regulator-ocp-notifier:periph-4c3-supply:0";
		L3F = "/fragment@14/__overlay__/regulator-ocp-notifier:periph-5c3-supply:0";
		L3G = "/fragment@14/__overlay__/regulator-ocp-notifier:periph-6c3-supply:0";
		L3K = "/fragment@14/__overlay__/regulator-ocp-notifier:periph-ac3-supply:0";
		L3M = "/fragment@14/__overlay__/regulator-ocp-notifier:periph-c42-supply:0";
		L4K = "/fragment@14/__overlay__/regulator-ocp-notifier:periph-ac4-supply:0";
		L4M = "/fragment@14/__overlay__/regulator-ocp-notifier:periph-c43-supply:0";
		L5B = "/fragment@14/__overlay__/regulator-ocp-notifier:periph-1c5-supply:0";
		L5K = "/fragment@14/__overlay__/regulator-ocp-notifier:periph-ac5-supply:0";
		L5M = "/fragment@14/__overlay__/regulator-ocp-notifier:periph-c44-supply:0";
		L6B = "/fragment@14/__overlay__/regulator-ocp-notifier:periph-1c6-supply:0";
		L6K = "/fragment@14/__overlay__/regulator-ocp-notifier:periph-ac6-supply:0";
		L6M = "/fragment@14/__overlay__/regulator-ocp-notifier:periph-c45-supply:0", "/fragment@33:target:0", "/fragment@34/__overlay__/fts@0:avdd-supply:0";
		L7B = "/fragment@14/__overlay__/regulator-ocp-notifier:periph-1c7-supply:0";
		L7K = "/fragment@14/__overlay__/regulator-ocp-notifier:periph-ac7-supply:0";
		L7M = "/fragment@14/__overlay__/regulator-ocp-notifier:periph-c46-supply:0";
		L8B = "/fragment@14/__overlay__/regulator-ocp-notifier:periph-1c8-supply:0";
		L9B = "/fragment@14/__overlay__/regulator-ocp-notifier:periph-1c9-supply:0", "/fragment@28/__overlay__/fingerprint_goodix:l11c_vdd-supply:0", "/fragment@29:target:0";
		battery_charger = "/fragment@25:target:0", "/fragment@39:target:0";
		cdsp_sw = "/fragment@15/__overlay__/socd/cooling-maps/socd_cdsp1:cooling-device:0", "/fragment@15/__overlay__/pm8550b-bcl-lvl0/cooling-maps/lbat_cdsp0:cooling-device:0", "/fragment@15/__overlay__/pm8550b-bcl-lvl1/cooling-maps/lbat_cdsp1:cooling-device:0", "/fragment@15/__overlay__/pm8550b-bcl-lvl2/cooling-maps/lbat_cdsp2:cooling-device:0", "/fragment@15/__overlay__/pm8550-bcl-lvl0/cooling-maps/vph_cdsp0:cooling-device:0", "/fragment@15/__overlay__/pm8550-bcl-lvl1/cooling-maps/vph_cdsp1:cooling-device:0", "/fragment@15/__overlay__/pm8550-bcl-lvl2/cooling-maps/vph_cdsp2:cooling-device:0", "/fragment@15/__overlay__/pm8550ve_f_tz/cooling-maps/pm8550vs_e_nsp:cooling-device:0", "/fragment@15/__overlay__/xo-therm/cooling-maps/cdsp_cdev:cooling-device:0";
		cpu3_hotplug = "/fragment@15/__overlay__/xo-therm/cooling-maps/cpu3_hot_cdev:cooling-device:0";
		cpu4_hotplug = "/fragment@15/__overlay__/xo-therm/cooling-maps/cpu4_hot_cdev:cooling-device:0";
		cpu5_hotplug = "/fragment@15/__overlay__/xo-therm/cooling-maps/cpu5_hot_cdev:cooling-device:0";
		cpu6_hotplug = "/fragment@15/__overlay__/xo-therm/cooling-maps/cpu6_hot_cdev:cooling-device:0";
		cpu7_hotplug = "/fragment@15/__overlay__/xo-therm/cooling-maps/cpu7_hot_cdev:cooling-device:0";
		cpu_3_4_5_pause = "/fragment@15/__overlay__/pm8550b-bcl-lvl0/cooling-maps/lbat_cpu_3_4_5:cooling-device:0", "/fragment@15/__overlay__/pm8550-bcl-lvl0/cooling-maps/vph_cpu_3_4_5:cooling-device:0";
		cpu_6_7_pause = "/fragment@15/__overlay__/pm8550b-bcl-lvl1/cooling-maps/lbat_cpu_6_7:cooling-device:0", "/fragment@15/__overlay__/pm8550-bcl-lvl1/cooling-maps/vph_cpu_6_7:cooling-device:0";
		display_fps = "/fragment@15/__overlay__/xo-therm/cooling-maps/display_cdev1:cooling-device:0", "/fragment@15/__overlay__/xo-therm/cooling-maps/display_cdev2:cooling-device:0", "/fragment@15/__overlay__/xo-therm/cooling-maps/display_cdev3:cooling-device:0", "/fragment@15/__overlay__/xo-therm/cooling-maps/display_cdev4:cooling-device:0";
		eusb2_phy0 = "/fragment@22:target:0";
		gcc = "/fragment@16/__overlay__:resets:0", "/fragment@20/__overlay__:resets:0";
		gcc_ufs_mem_phy_gdsc = "/fragment@19/__overlay__:vdd-phy-gdsc-supply:0";
		gcc_ufs_phy_gdsc = "/fragment@20/__overlay__:vdd-hba-supply:0";
		modem_lte_dsc = "/fragment@15/__overlay__/pm8550b-bcl-lvl0/cooling-maps/lbat_0_mdm_lte:cooling-device:0", "/fragment@15/__overlay__/pm8550b-bcl-lvl1/cooling-maps/lbat_1_mdm_lte:cooling-device:0", "/fragment@15/__overlay__/pm8550-bcl-lvl0/cooling-maps/vph_lte0:cooling-device:0", "/fragment@15/__overlay__/pm8550-bcl-lvl1/cooling-maps/vph_lte1:cooling-device:0", "/fragment@15/__overlay__/pm8550ve_f_tz/cooling-maps/pm8550vs_e_lte:cooling-device:0", "/fragment@15/__overlay__/xo-therm/cooling-maps/lte_cdev:cooling-device:0";
		modem_nr_dsc = "/fragment@15/__overlay__/pm8550b-bcl-lvl0/cooling-maps/lbat_0_nr:cooling-device:0", "/fragment@15/__overlay__/pm8550b-bcl-lvl1/cooling-maps/lbat_1_nr:cooling-device:0", "/fragment@15/__overlay__/pm8550-bcl-lvl0/cooling-maps/vph_nr0:cooling-device:0", "/fragment@15/__overlay__/pm8550-bcl-lvl1/cooling-maps/vph_nr1:cooling-device:0";
		modem_nr_scg_dsc = "/fragment@15/__overlay__/pm8550b-bcl-lvl0/cooling-maps/lbat_0_nr_scg:cooling-device:0", "/fragment@15/__overlay__/pm8550b-bcl-lvl1/cooling-maps/lbat_1_nr_scg:cooling-device:0", "/fragment@15/__overlay__/pm8550-bcl-lvl0/cooling-maps/vph_nr0_scg:cooling-device:0", "/fragment@15/__overlay__/pm8550-bcl-lvl1/cooling-maps/vph_nr1_scg:cooling-device:0", "/fragment@15/__overlay__/pm8550ve_f_tz/cooling-maps/pm8550vs_e_nr:cooling-device:0", "/fragment@15/__overlay__/xo-therm/cooling-maps/nr_cdev:cooling-device:0";
		msm_gpu = "/fragment@15/__overlay__/socd/cooling-maps/socd_gpu0:cooling-device:0", "/fragment@15/__overlay__/pm8550b-bcl-lvl0/cooling-maps/lbat_gpu0:cooling-device:0", "/fragment@15/__overlay__/pm8550b-bcl-lvl1/cooling-maps/lbat_gpu1:cooling-device:0", "/fragment@15/__overlay__/pm8550b-bcl-lvl2/cooling-maps/lbat_gpu2:cooling-device:0", "/fragment@15/__overlay__/pm8550-bcl-lvl0/cooling-maps/vph_gpu0:cooling-device:0", "/fragment@15/__overlay__/pm8550-bcl-lvl1/cooling-maps/vph_gpu1:cooling-device:0", "/fragment@15/__overlay__/pm8550-bcl-lvl2/cooling-maps/vph_gpu2:cooling-device:0", "/fragment@15/__overlay__/pm8550vs_d_tz/cooling-maps/pm8550vs_d_gpu:cooling-device:0", "/fragment@15/__overlay__/xo-therm/cooling-maps/gpu_cdev:cooling-device:0";
		pcie1 = "/fragment@27:target:0";
		pm_humu_l15 = "/fragment@3/__overlay__/qcom,pm8550b@7/qcom,eusb2-repeater@fd00:vdd18-supply:0";
		pm_humu_l17 = "/fragment@20/__overlay__:vcc-supply:0";
		pm_humu_l5 = "/fragment@3/__overlay__/qcom,pm8550b@7/qcom,eusb2-repeater@fd00:vdd3-supply:0";
		pm_humu_l8 = "/fragment@16/__overlay__:vdd-io-supply:0";
		pm_humu_l9 = "/fragment@16/__overlay__:vdd-supply:0";
		pm_v6d_l1 = "/fragment@19/__overlay__:vdda-phy-supply:0";
		pm_v6e_l1 = "/fragment@19/__overlay__:vdda-qref-supply:0";
		pm_v6e_l3 = "/fragment@19/__overlay__:vdda-pll-supply:0";
		pm_v6g_l1 = "/fragment@20/__overlay__:vccq-supply:0";
		pm_v6g_l3 = "/fragment@20/__overlay__:qcom,vddp-ref-clk-supply:0";
		pm_v6g_s4 = "/fragment@20/__overlay__:qcom,vccq-parent-supply:0";
		qseecom_mem = "/fragment@30:target:0";
		qseecom_ta_mem = "/fragment@31:target:0";
		qupv3_se0_i2c = "/fragment@35:target:0";
		qupv3_se4_i2c = "/fragment@21:target:0";
		qupv3_se4_spi = "/fragment@34:target:0";
		qupv3_se4_spi_clk_active = "/fragment@34/__overlay__:pinctrl-0:8";
		qupv3_se4_spi_miso_active = "/fragment@34/__overlay__:pinctrl-0:4";
		qupv3_se4_spi_mosi_active = "/fragment@34/__overlay__:pinctrl-0:0";
		qupv3_se8_i2c = "/fragment@36:target:0";
		qupv3_se9_spi = "/fragment@18:target:0";
		reserved_memory = "/fragment@26:target:0";
		rpmhcc = "/fragment@35/__overlay__/nq@28:clocks:0";
		sdc2_off = "/fragment@16/__overlay__:pinctrl-1:0";
		sdc2_on = "/fragment@16/__overlay__:pinctrl-0:0";
		sdhc_2 = "/fragment@16:target:0";
		soc = "/fragment@14:target:0", "/fragment@17:target:0", "/fragment@28:target:0", "/fragment@38:target:0";
		spmi_bus = "/fragment@1:target:0", "/fragment@3:target:0", "/fragment@5:target:0", "/fragment@7:target:0", "/fragment@9:target:0", "/fragment@10:target:0", "/fragment@12:target:0", "/fragment@14/__overlay__/regulator-ocp-notifier:interrupt-parent:0";
		thermal_zones = "/fragment@2:target:0", "/fragment@4:target:0", "/fragment@6:target:0", "/fragment@8:target:0", "/fragment@11:target:0", "/fragment@13:target:0", "/fragment@15:target:0", "/fragment@37:target:0";
		tlmm = "/fragment@0:target:0", "/fragment@20/__overlay__:reset-gpios:0", "/fragment@21/__overlay__/goodix-berlin@5d:interrupt-parent:0", "/fragment@21/__overlay__/goodix-berlin@5d:goodix,reset-gpio:0", "/fragment@21/__overlay__/goodix-berlin@5d:goodix,irq-gpio:0", "/fragment@21/__overlay__/goodix-berlin@5d:qts,trusted-touch-vm-gpio-list:0", "/fragment@21/__overlay__/goodix-berlin@5d:qts,trusted-touch-vm-gpio-list:12", "/fragment@21/__overlay__/goodix-berlin@5d:qts,trusted-touch-vm-gpio-list:24", "/fragment@21/__overlay__/goodix-berlin@5d:qts,trusted-touch-vm-gpio-list:36", "/fragment@21/__overlay__/goodix-berlin@5d:qts,trusted-touch-vm-gpio-list:48", "/fragment@21/__overlay__/goodix-berlin@5d:qts,trusted-touch-vm-gpio-list:60", "/fragment@28/__overlay__/fingerprint_goodix:goodix,gpio-reset:0", "/fragment@28/__overlay__/fingerprint_goodix:goodix,gpio-irq:0", "/fragment@32:target:0", "/fragment@34/__overlay__/fts@0:interrupt-parent:0", "/fragment@34/__overlay__/fts@0:fts,irq-gpio:0", "/fragment@34/__overlay__/fts@0:fts,reset-gpio:0", "/fragment@35/__overlay__/nq@28:qcom,sn-irq:0", "/fragment@35/__overlay__/nq@28:qcom,sn-ven:0", "/fragment@35/__overlay__/nq@28:qcom,sn-firm:0", "/fragment@35/__overlay__/nq@28:qcom,sn-clkreq:0", "/fragment@35/__overlay__/nq@28:interrupt-parent:0", "/fragment@36/__overlay__/cs35l41@40:interrupt-parent:0", "/fragment@36/__overlay__/cs35l41@40:reset-gpios:0", "/fragment@36/__overlay__/cs35l41@42:interrupt-parent:0", "/fragment@36/__overlay__/cs35l41@42:reset-gpios:0";
		ts_int_suspend = "/fragment@34/__overlay__/fts@0:pinctrl-1:0";
		ts_reset_suspend = "/fragment@34/__overlay__/fts@0:pinctrl-1:4";
		ucsi = "/fragment@24:target:0";
		ufshc_mem = "/fragment@20:target:0";
		ufsphy_mem = "/fragment@19:target:0";
		usb0 = "/fragment@23:target:0";
	};

	__local_fixups__ {

		fragment@1 {

			__overlay__ {

				qcom,pm8550@1 {

					pm8550-temp-alarm@a00 {
						io-channels = <0x0>;
					};

					pwms@e800 {
						nvmem = <0x0 0x4>;
					};

					qcom,leds@ef00 {

						blue {
							pwms = <0x0>;
						};

						green {
							pwms = <0x0>;
						};

						red {
							pwms = <0x0>;
						};
					};
				};
			};
		};

		fragment@11 {

			__overlay__ {

				pmr735d_k_tz {
					thermal-sensors = <0x0>;
				};

				pmr735d_l_tz {
					thermal-sensors = <0x0>;
				};
			};
		};

		fragment@13 {

			__overlay__ {

				pm8010m_tz {
					thermal-sensors = <0x0>;
				};

				pm8010n_tz {
					thermal-sensors = <0x0>;
				};

				xo-therm {
					thermal-sensors = <0x0>;
				};
			};
		};

		fragment@14 {

			__overlay__ {

				pmic-pon-log {
					nvmem = <0x0 0x4>;
				};

				reboot_reason {
					nvmem-cells = <0x0>;
				};

				regulator-dbo3 {
					gpio = <0x0>;
				};

				regulator-ocp-notifier {
					nvmem-cells = <0x0>;
				};
			};
		};

		fragment@15 {

			__overlay__ {

				pm8550-bcl-lvl0 {

					cooling-maps {

						vph_cdsp0 {
							trip = <0x0>;
						};

						vph_cpu_3_4_5 {
							trip = <0x0>;
						};

						vph_gpu0 {
							trip = <0x0>;
						};

						vph_lte0 {
							trip = <0x0>;
						};

						vph_nr0 {
							trip = <0x0>;
						};

						vph_nr0_scg {
							trip = <0x0>;
						};
					};
				};

				pm8550-bcl-lvl1 {

					cooling-maps {

						vph_cdsp1 {
							trip = <0x0>;
						};

						vph_cpu_6_7 {
							trip = <0x0>;
						};

						vph_gpu1 {
							trip = <0x0>;
						};

						vph_lte1 {
							trip = <0x0>;
						};

						vph_nr1 {
							trip = <0x0>;
						};

						vph_nr1_scg {
							trip = <0x0>;
						};
					};
				};

				pm8550-bcl-lvl2 {

					cooling-maps {

						vph_cdsp2 {
							trip = <0x0>;
						};

						vph_gpu2 {
							trip = <0x0>;
						};
					};
				};

				pm8550b-bcl-lvl0 {

					cooling-maps {

						lbat_0_mdm_lte {
							trip = <0x0>;
						};

						lbat_0_nr {
							trip = <0x0>;
						};

						lbat_0_nr_scg {
							trip = <0x0>;
						};

						lbat_cdsp0 {
							trip = <0x0>;
						};

						lbat_cpu_3_4_5 {
							trip = <0x0>;
						};

						lbat_gpu0 {
							trip = <0x0>;
						};
					};
				};

				pm8550b-bcl-lvl1 {

					cooling-maps {

						lbat_1_mdm_lte {
							trip = <0x0>;
						};

						lbat_1_nr {
							trip = <0x0>;
						};

						lbat_1_nr_scg {
							trip = <0x0>;
						};

						lbat_cdsp1 {
							trip = <0x0>;
						};

						lbat_cpu_6_7 {
							trip = <0x0>;
						};

						lbat_gpu1 {
							trip = <0x0>;
						};
					};
				};

				pm8550b-bcl-lvl2 {

					cooling-maps {

						lbat_cdsp2 {
							trip = <0x0>;
						};

						lbat_gpu2 {
							trip = <0x0>;
						};
					};
				};

				pm8550ve_f_tz {

					cooling-maps {

						pm8550vs_e_lte {
							trip = <0x0>;
						};

						pm8550vs_e_nr {
							trip = <0x0>;
						};

						pm8550vs_e_nsp {
							trip = <0x0>;
						};
					};
				};

				pm8550vs_c_tz {

					cooling-maps {

						pm8550vs_c_apc1 {
							trip = <0x0>;
						};
					};
				};

				pm8550vs_d_tz {

					cooling-maps {

						pm8550vs_d_gpu {
							trip = <0x0>;
						};
					};
				};

				socd {

					cooling-maps {

						socd_apc1 {
							trip = <0x0>;
						};

						socd_cdsp1 {
							trip = <0x0>;
						};

						socd_gpu0 {
							trip = <0x0>;
						};
					};
				};

				xo-therm {

					cooling-maps {

						apc1_cdev {
							trip = <0x0>;
						};

						cdsp_cdev {
							trip = <0x0>;
						};

						cpu3_hot_cdev {
							trip = <0x0>;
						};

						cpu4_hot_cdev {
							trip = <0x0>;
						};

						cpu5_hot_cdev {
							trip = <0x0>;
						};

						cpu6_hot_cdev {
							trip = <0x0>;
						};

						cpu7_hot_cdev {
							trip = <0x0>;
						};

						display_cdev1 {
							trip = <0x0>;
						};

						display_cdev2 {
							trip = <0x0>;
						};

						display_cdev3 {
							trip = <0x0>;
						};

						display_cdev4 {
							trip = <0x0>;
						};

						gpu_cdev {
							trip = <0x0>;
						};

						lte_cdev {
							trip = <0x0>;
						};

						nr_cdev {
							trip = <0x0>;
						};
					};
				};
			};
		};

		fragment@16 {

			__overlay__ {
				cd-gpios = <0x0>;
				pinctrl-0 = <0x4>;
				pinctrl-1 = <0x4>;
			};
		};

		fragment@17 {

			__overlay__ {

				gpio_keys {
					pinctrl-0 = <0x0>;

					vol_up {
						gpios = <0x0>;
					};
				};
			};
		};

		fragment@2 {

			__overlay__ {

				pm8550-bcl-lvl0 {
					thermal-sensors = <0x0>;
				};

				pm8550-bcl-lvl1 {
					thermal-sensors = <0x0>;
				};

				pm8550-bcl-lvl2 {
					thermal-sensors = <0x0>;
				};

				pm8550_tz {
					thermal-sensors = <0x0>;
				};
			};
		};

		fragment@22 {

			__overlay__ {
				dummy-supply = <0x0>;
				usb-repeater = <0x0>;
			};
		};

		fragment@23 {

			__overlay__ {

				port {

					endpoint {
						remote-endpoint = <0x0>;
					};
				};
			};
		};

		fragment@24 {

			__overlay__ {

				connector {

					port {

						endpoint {
							remote-endpoint = <0x0>;
						};
					};
				};
			};
		};

		fragment@3 {

			__overlay__ {

				qcom,pm8550b@7 {

					pm8550b-temp-alarm-lite@c00 {
						io-channels = <0x0>;
					};

					pm8550b-temp-alarm@a00 {
						io-channels = <0x0>;
					};

					qcom,hv-haptics@f000 {
						nvmem = <0x0>;
					};
				};
			};
		};

		fragment@34 {

			__overlay__ {
				pinctrl-0 = <0xc>;
				pinctrl-1 = <0x0 0x4>;

				fts@0 {
					pinctrl-0 = <0x0>;
				};
			};
		};

		fragment@35 {

			__overlay__ {

				nq@28 {
					pinctrl-0 = <0x0 0x4>;
					pinctrl-1 = <0x0 0x4>;
				};
			};
		};

		fragment@36 {

			__overlay__ {

				cs35l41@40 {
					pinctrl-0 = <0x0 0x4>;
				};

				cs35l41@42 {
					pinctrl-0 = <0x0 0x4>;
					pinctrl-1 = <0x0>;
					pinctrl-2 = <0x0>;
				};
			};
		};

		fragment@37 {

			__overlay__ {

				charger_therm0 {
					thermal-sensors = <0x0>;
				};

				conn_therm {
					thermal-sensors = <0x0>;
				};

				cpu_therm {
					thermal-sensors = <0x0>;
				};

				flash_therm {
					thermal-sensors = <0x0>;
				};

				pa_therm0 {
					thermal-sensors = <0x0>;
				};

				pa_therm1 {
					thermal-sensors = <0x0>;
				};

				quiet_therm {
					thermal-sensors = <0x0>;
				};

				wifi_therm {
					thermal-sensors = <0x0>;
				};

				wireless_therm {
					thermal-sensors = <0x0>;
				};
			};
		};

		fragment@4 {

			__overlay__ {

				pm8550b-bcl-lvl0 {
					thermal-sensors = <0x0>;
				};

				pm8550b-bcl-lvl1 {
					thermal-sensors = <0x0>;
				};

				pm8550b-bcl-lvl2 {
					thermal-sensors = <0x0>;
				};

				pm8550b-ibat-lvl0 {
					thermal-sensors = <0x0>;
				};

				pm8550b-ibat-lvl1 {
					thermal-sensors = <0x0>;
				};

				pm8550b_lite_tz {
					thermal-sensors = <0x0>;
				};

				pm8550b_tz {
					thermal-sensors = <0x0>;
				};
			};
		};

		fragment@5 {

			__overlay__ {

				qcom,pm8550ve_f@5 {

					pm8550ve-f-temp-alarm@a00 {
						io-channels = <0x0>;
					};
				};
			};
		};

		fragment@6 {

			__overlay__ {

				pm8550ve_f_tz {
					thermal-sensors = <0x0>;
				};
			};
		};

		fragment@7 {

			__overlay__ {

				qcom,pm8550vs@2 {

					pm8550vs-c-temp-alarm@a00 {
						io-channels = <0x0>;
					};
				};

				qcom,pm8550vs@3 {

					pm8550vs-d-temp-alarm@a00 {
						io-channels = <0x0>;
					};
				};

				qcom,pm8550vs@4 {

					pm8550vs-e-temp-alarm@a00 {
						io-channels = <0x0>;
					};
				};

				qcom,pm8550vs@6 {

					pm8550vs-g-temp-alarm@a00 {
						io-channels = <0x0>;
					};
				};
			};
		};

		fragment@8 {

			__overlay__ {

				pm8550vs_c_tz {
					thermal-sensors = <0x0>;
				};

				pm8550vs_d_tz {
					thermal-sensors = <0x0>;
				};

				pm8550vs_e_tz {
					thermal-sensors = <0x0>;
				};

				pm8550vs_g_tz {
					thermal-sensors = <0x0>;
				};
			};
		};

		fragment@9 {

			__overlay__ {

				qcom,pmk8550@0 {

					pinctrl@b800 {
						pinctrl-0 = <0x0>;
					};

					vadc@9000 {
						pinctrl-0 = <0x0 0x4>;
					};
				};
			};
		};
	};

	__symbols__ {
		DBO3 = "/fragment@14/__overlay__/regulator-dbo3";
		alt_sleep_clk_default = "/fragment@9/__overlay__/qcom,pmk8550@0/pinctrl@b800/alt_sleep_clk/alt_sleep_clk_default";
		aop_image_mem = "/fragment@26/__overlay__/aop_image_region@81c00000";
		b_bcl_lvl0 = "/fragment@4/__overlay__/pm8550b-bcl-lvl0/trips/b-bcl-lvl0";
		b_bcl_lvl1 = "/fragment@4/__overlay__/pm8550b-bcl-lvl1/trips/b-bcl-lvl1";
		b_bcl_lvl2 = "/fragment@4/__overlay__/pm8550b-bcl-lvl2/trips/b-bcl-lvl2";
		bcl_lvl0 = "/fragment@2/__overlay__/pm8550-bcl-lvl0/trips/bcl-lvl0";
		bcl_lvl1 = "/fragment@2/__overlay__/pm8550-bcl-lvl1/trips/bcl-lvl1";
		bcl_lvl2 = "/fragment@2/__overlay__/pm8550-bcl-lvl2/trips/bcl-lvl2";
		bcl_soc = "/fragment@3/__overlay__/qcom,pm8550b@7/bcl-soc";
		charger_therm0_default = "/fragment@1/__overlay__/qcom,pm8550@1/pinctrl@8800/charger_therm0/charger_therm0_default";
		cirrus_irq_default_0 = "/fragment@0/__overlay__/cirrus_irq_default/cirrus_irq_default_0";
		cirrus_irq_default_1 = "/fragment@0/__overlay__/cirrus_irq_default/cirrus_irq_default_1";
		cirrus_reset_default_0 = "/fragment@0/__overlay__/cirrus_reset_default_0";
		cirrus_reset_default_1 = "/fragment@0/__overlay__/cirrus_reset_default_1";
		cs35l41_0 = "/fragment@36/__overlay__/cs35l41@40";
		cs35l41_1 = "/fragment@36/__overlay__/cs35l41@42";
		display_test_config1 = "/fragment@13/__overlay__/xo-therm/trips/display-test-config1";
		display_test_config2 = "/fragment@13/__overlay__/xo-therm/trips/display-test-config2";
		display_test_config3 = "/fragment@13/__overlay__/xo-therm/trips/display-test-config3";
		display_test_config4 = "/fragment@13/__overlay__/xo-therm/trips/display-test-config4";
		dump_display_mem = "/fragment@17/__overlay__/dump_display_region@a4a80000";
		eusb2_repeater_reset_default = "/fragment@7/__overlay__/qcom,pm8550vs@3/pinctrl@8800/eusb2_repeater_reset/eusb2_repeater_reset_default";
		hap_swr_slave_reg = "/fragment@3/__overlay__/qcom,pm8550b@7/qcom,hv-haptics@f000/qcom,hap-swr-slave-reg";
		ibat_lvl0 = "/fragment@4/__overlay__/pm8550b-ibat-lvl0/trips/ibat-lvl0";
		ibat_lvl1 = "/fragment@4/__overlay__/pm8550b-ibat-lvl1/trips/ibat-lvl1";
		key_vol_up_default = "/fragment@1/__overlay__/qcom,pm8550@1/pinctrl@8800/key_vol_up/key_vol_up_default";
		mi_ts_active = "/fragment@32/__overlay__/mi_ts_active";
		mi_ts_cs_active = "/fragment@32/__overlay__/mi_ts_cs_active";
		mi_ts_cs_suspend = "/fragment@32/__overlay__/mi_ts_cs_suspend";
		mi_ts_spi_suspend = "/fragment@32/__overlay__/mi_ts_spi_suspend";
		nfc_enable_active = "/fragment@0/__overlay__/nfc/nfc_enable_active";
		nfc_enable_suspend = "/fragment@0/__overlay__/nfc/nfc_enable_suspend";
		nfc_int_active = "/fragment@0/__overlay__/nfc/nfc_int_active";
		nfc_int_suspend = "/fragment@0/__overlay__/nfc/nfc_int_suspend";
		ocp_log = "/fragment@9/__overlay__/qcom,pmk8550@0/sdam@7000/ocp-log@76";
		pm8010_m = "/fragment@12/__overlay__/qcom,pm8010@c";
		pm8010_n = "/fragment@12/__overlay__/qcom,pm8010@d";
		pm8010m_tz = "/fragment@12/__overlay__/qcom,pm8010@c/pm8010-m-temp-alarm@2400";
		pm8010n_tz = "/fragment@12/__overlay__/qcom,pm8010@d/pm8010-n-temp-alarm@2400";
		pm8550_bcl = "/fragment@1/__overlay__/qcom,pm8550@1/bcl@4700";
		pm8550_flash = "/fragment@1/__overlay__/qcom,pm8550@1/qcom,flash_led@ee00";
		pm8550_flash0 = "/fragment@1/__overlay__/qcom,pm8550@1/qcom,flash_led@ee00/qcom,flash_0";
		pm8550_flash1 = "/fragment@1/__overlay__/qcom,pm8550@1/qcom,flash_led@ee00/qcom,flash_1";
		pm8550_flash2 = "/fragment@1/__overlay__/qcom,pm8550@1/qcom,flash_led@ee00/qcom,flash_2";
		pm8550_flash3 = "/fragment@1/__overlay__/qcom,pm8550@1/qcom,flash_led@ee00/qcom,flash_3";
		pm8550_gpios = "/fragment@1/__overlay__/qcom,pm8550@1/pinctrl@8800";
		pm8550_pwm_1 = "/fragment@1/__overlay__/qcom,pm8550@1/pwms@e800";
		pm8550_pwm_2 = "/fragment@1/__overlay__/qcom,pm8550@1/pwms@eb00";
		pm8550_rgb = "/fragment@1/__overlay__/qcom,pm8550@1/qcom,leds@ef00";
		pm8550_switch0 = "/fragment@1/__overlay__/qcom,pm8550@1/qcom,flash_led@ee00/qcom,led_switch_0";
		pm8550_switch1 = "/fragment@1/__overlay__/qcom,pm8550@1/qcom,flash_led@ee00/qcom,led_switch_1";
		pm8550_switch2 = "/fragment@1/__overlay__/qcom,pm8550@1/qcom,flash_led@ee00/qcom,led_switch_2";
		pm8550_temp_alarm = "/fragment@2/__overlay__/pm8550_tz";
		pm8550_torch0 = "/fragment@1/__overlay__/qcom,pm8550@1/qcom,flash_led@ee00/qcom,torch_0";
		pm8550_torch1 = "/fragment@1/__overlay__/qcom,pm8550@1/qcom,flash_led@ee00/qcom,torch_1";
		pm8550_torch2 = "/fragment@1/__overlay__/qcom,pm8550@1/qcom,flash_led@ee00/qcom,torch_2";
		pm8550_torch3 = "/fragment@1/__overlay__/qcom,pm8550@1/qcom,flash_led@ee00/qcom,torch_3";
		pm8550_trip0 = "/fragment@2/__overlay__/pm8550_tz/trips/trip0";
		pm8550_trip1 = "/fragment@2/__overlay__/pm8550_tz/trips/trip1";
		pm8550_trip2 = "/fragment@2/__overlay__/pm8550_tz/trips/trip2";
		pm8550_tz = "/fragment@1/__overlay__/qcom,pm8550@1/pm8550-temp-alarm@a00";
		pm8550b_bcl = "/fragment@3/__overlay__/qcom,pm8550b@7/bcl@4700";
		pm8550b_eusb2_repeater = "/fragment@3/__overlay__/qcom,pm8550b@7/qcom,eusb2-repeater@fd00";
		pm8550b_gpios = "/fragment@3/__overlay__/qcom,pm8550b@7/pinctrl@8800";
		pm8550b_haptics = "/fragment@3/__overlay__/qcom,pm8550b@7/qcom,hv-haptics@f000";
		pm8550b_lite_temp_alarm = "/fragment@4/__overlay__/pm8550b_lite_tz";
		pm8550b_lite_tz = "/fragment@3/__overlay__/qcom,pm8550b@7/pm8550b-temp-alarm-lite@c00";
		pm8550b_temp_alarm = "/fragment@4/__overlay__/pm8550b_tz";
		pm8550b_trip0 = "/fragment@4/__overlay__/pm8550b_tz/trips/trip0";
		pm8550b_trip1 = "/fragment@4/__overlay__/pm8550b_tz/trips/trip1";
		pm8550b_trip2 = "/fragment@4/__overlay__/pm8550b_tz/trips/trip2";
		pm8550b_tz = "/fragment@3/__overlay__/qcom,pm8550b@7/pm8550b-temp-alarm@a00";
		pm8550ve_f_gpios = "/fragment@5/__overlay__/qcom,pm8550ve_f@5/pinctrl@8800";
		pm8550ve_f_temp_alarm = "/fragment@6/__overlay__/pm8550ve_f_tz";
		pm8550ve_f_trip0 = "/fragment@6/__overlay__/pm8550ve_f_tz/trips/trip0";
		pm8550ve_f_trip1 = "/fragment@6/__overlay__/pm8550ve_f_tz/trips/trip1";
		pm8550ve_f_trip2 = "/fragment@6/__overlay__/pm8550ve_f_tz/trips/trip2";
		pm8550ve_f_tz = "/fragment@5/__overlay__/qcom,pm8550ve_f@5/pm8550ve-f-temp-alarm@a00";
		pm8550vs_c = "/fragment@7/__overlay__/qcom,pm8550vs@2";
		pm8550vs_c_gpios = "/fragment@7/__overlay__/qcom,pm8550vs@2/pinctrl@8800";
		pm8550vs_c_temp_alarm = "/fragment@8/__overlay__/pm8550vs_c_tz";
		pm8550vs_c_trip0 = "/fragment@8/__overlay__/pm8550vs_c_tz/trips/trip0";
		pm8550vs_c_trip1 = "/fragment@8/__overlay__/pm8550vs_c_tz/trips/trip1";
		pm8550vs_c_trip2 = "/fragment@8/__overlay__/pm8550vs_c_tz/trips/trip2";
		pm8550vs_c_tz = "/fragment@7/__overlay__/qcom,pm8550vs@2/pm8550vs-c-temp-alarm@a00";
		pm8550vs_d = "/fragment@7/__overlay__/qcom,pm8550vs@3";
		pm8550vs_d_gpios = "/fragment@7/__overlay__/qcom,pm8550vs@3/pinctrl@8800";
		pm8550vs_d_temp_alarm = "/fragment@8/__overlay__/pm8550vs_d_tz";
		pm8550vs_d_trip0 = "/fragment@8/__overlay__/pm8550vs_d_tz/trips/trip0";
		pm8550vs_d_trip1 = "/fragment@8/__overlay__/pm8550vs_d_tz/trips/trip1";
		pm8550vs_d_trip2 = "/fragment@8/__overlay__/pm8550vs_d_tz/trips/trip2";
		pm8550vs_d_tz = "/fragment@7/__overlay__/qcom,pm8550vs@3/pm8550vs-d-temp-alarm@a00";
		pm8550vs_e = "/fragment@7/__overlay__/qcom,pm8550vs@4";
		pm8550vs_e_gpios = "/fragment@7/__overlay__/qcom,pm8550vs@4/pinctrl@8800";
		pm8550vs_e_temp_alarm = "/fragment@8/__overlay__/pm8550vs_e_tz";
		pm8550vs_e_trip0 = "/fragment@8/__overlay__/pm8550vs_e_tz/trips/trip0";
		pm8550vs_e_trip1 = "/fragment@8/__overlay__/pm8550vs_e_tz/trips/trip1";
		pm8550vs_e_trip2 = "/fragment@8/__overlay__/pm8550vs_e_tz/trips/trip2";
		pm8550vs_e_tz = "/fragment@7/__overlay__/qcom,pm8550vs@4/pm8550vs-e-temp-alarm@a00";
		pm8550vs_g = "/fragment@7/__overlay__/qcom,pm8550vs@6";
		pm8550vs_g_gpios = "/fragment@7/__overlay__/qcom,pm8550vs@6/pinctrl@8800";
		pm8550vs_g_temp_alarm = "/fragment@8/__overlay__/pm8550vs_g_tz";
		pm8550vs_g_trip0 = "/fragment@8/__overlay__/pm8550vs_g_tz/trips/trip0";
		pm8550vs_g_trip1 = "/fragment@8/__overlay__/pm8550vs_g_tz/trips/trip1";
		pm8550vs_g_trip2 = "/fragment@8/__overlay__/pm8550vs_g_tz/trips/trip2";
		pm8550vs_g_tz = "/fragment@7/__overlay__/qcom,pm8550vs@6/pm8550vs-g-temp-alarm@a00";
		pmk8550_gpios = "/fragment@9/__overlay__/qcom,pmk8550@0/pinctrl@b800";
		pmk8550_rtc = "/fragment@9/__overlay__/qcom,pmk8550@0/rtc@6100";
		pmk8550_sdam_1 = "/fragment@9/__overlay__/qcom,pmk8550@0/sdam@7000";
		pmk8550_sdam_2 = "/fragment@9/__overlay__/qcom,pmk8550@0/sdam@7100";
		pmk8550_sdam_21 = "/fragment@9/__overlay__/qcom,pmk8550@0/sdam@8400";
		pmk8550_sdam_22 = "/fragment@9/__overlay__/qcom,pmk8550@0/sdam@8500";
		pmk8550_sdam_46 = "/fragment@9/__overlay__/qcom,pmk8550@0/sdam@9d00";
		pmk8550_sdam_5 = "/fragment@9/__overlay__/qcom,pmk8550@0/sdam@7400";
		pmk8550_sdam_6 = "/fragment@9/__overlay__/qcom,pmk8550@0/sdam@7500";
		pmk8550_vadc = "/fragment@9/__overlay__/qcom,pmk8550@0/vadc@9000";
		pmr735d_k_gpios = "/fragment@10/__overlay__/qcom,pmr735d@a/pinctrl@8800";
		pmr735d_k_temp_alarm = "/fragment@11/__overlay__/pmr735d_k_tz";
		pmr735d_k_trip0 = "/fragment@11/__overlay__/pmr735d_k_tz/trips/trip0";
		pmr735d_k_trip1 = "/fragment@11/__overlay__/pmr735d_k_tz/trips/trip1";
		pmr735d_k_trip2 = "/fragment@11/__overlay__/pmr735d_k_tz/trips/trip2";
		pmr735d_k_tz = "/fragment@10/__overlay__/qcom,pmr735d@a/pmr735d-k-temp-alarm@a00";
		pmr735d_l_gpios = "/fragment@10/__overlay__/qcom,pmr735d@b/pinctrl@8800";
		pmr735d_l_temp_alarm = "/fragment@11/__overlay__/pmr735d_l_tz";
		pmr735d_l_trip0 = "/fragment@11/__overlay__/pmr735d_l_tz/trips/trip0";
		pmr735d_l_trip1 = "/fragment@11/__overlay__/pmr735d_l_tz/trips/trip1";
		pmr735d_l_trip2 = "/fragment@11/__overlay__/pmr735d_l_tz/trips/trip2";
		pmr735d_l_tz = "/fragment@10/__overlay__/qcom,pmr735d@b/pmr735d-l-temp-alarm@a00";
		rcv_gpio_high = "/fragment@32/__overlay__/rcv_gpio_high";
		rcv_gpio_low = "/fragment@32/__overlay__/rcv_gpio_low";
		regulator_ocp_notifier = "/fragment@14/__overlay__/regulator-ocp-notifier";
		restart_reason = "/fragment@9/__overlay__/qcom,pmk8550@0/sdam@7100/restart@48";
		sbu_uart_en_active = "/fragment@0/__overlay__/sbu_uart_en_ctrl/uart_audio_en_active";
		sbu_uart_en_idle = "/fragment@0/__overlay__/sbu_uart_en_ctrl/uart_audio_en_idle";
		sd_card_det_default = "/fragment@1/__overlay__/qcom,pm8550@1/pinctrl@8800/sd_card_det/sd_card_det_default";
		socd_trip = "/fragment@4/__overlay__/socd/trips/socd-trip";
		usb_port0 = "/fragment@23/__overlay__/port/endpoint";
		usb_port0_connector = "/fragment@24/__overlay__/connector/port/endpoint";
		wls_therm_default = "/fragment@3/__overlay__/qcom,pm8550b@7/pinctrl@8800/wls_therm/wls_therm_default";
		xbl_dt_log_mem = "/fragment@26/__overlay__/xbl_dt_log@81a00000";
		xbl_ramdump_mem = "/fragment@26/__overlay__/xbl_ramdump_region@81200000";
		xo_config0 = "/fragment@13/__overlay__/xo-therm/trips/xo-config0";
		xo_config1 = "/fragment@13/__overlay__/xo-therm/trips/xo-config1";
	};

	fragment@0 {
		target = <0xffffffff>;

		__overlay__ {

			cirrus_irq_default {

				cirrus_irq_default_0 {
					phandle = <0x3a>;

					config {
						bias-pull-up;
						drive-strength = <0x2>;
						input-enable;
						pins = "gpio99";
					};

					mux {
						function = "gpio";
						pins = "gpio99";
					};
				};

				cirrus_irq_default_1 {
					phandle = <0x3c>;

					config {
						bias-pull-up;
						drive-strength = <0x2>;
						input-enable;
						pins = "gpio98";
					};

					mux {
						function = "gpio";
						pins = "gpio98";
					};
				};
			};

			cirrus_reset_default_0 {
				phandle = <0x39>;

				config {
					bias-disable;
					drive-strength = <0x10>;
					output-high;
					pins = "gpio183";
				};

				mux {
					function = "gpio";
					pins = "gpio183";
				};
			};

			cirrus_reset_default_1 {
				phandle = <0x3b>;

				config {
					bias-disable;
					drive-strength = <0x10>;
					output-high;
					pins = "gpio182";
				};

				mux {
					function = "gpio";
					pins = "gpio182";
				};
			};

			nfc {

				nfc_enable_active {
					phandle = <0x36>;

					config {
						bias-disable;
						drive-strength = <0x2>;
						pins = "gpio30", "gpio12", "gpio31";
					};

					mux {
						function = "gpio";
						pins = "gpio30", "gpio12", "gpio31";
					};
				};

				nfc_enable_suspend {
					phandle = <0x38>;

					config {
						bias-disable;
						drive-strength = <0x2>;
						pins = "gpio30", "gpio12", "gpio31";
					};

					mux {
						function = "gpio";
						pins = "gpio30", "gpio12", "gpio31";
					};
				};

				nfc_int_active {
					phandle = <0x35>;

					config {
						bias-pull-down;
						drive-strength = <0x2>;
						pins = "gpio55";
					};

					mux {
						function = "gpio";
						pins = "gpio55";
					};
				};

				nfc_int_suspend {
					phandle = <0x37>;

					config {
						bias-pull-down;
						drive-strength = <0x2>;
						pins = "gpio55";
					};

					mux {
						function = "gpio";
						pins = "gpio55";
					};
				};
			};

			sbu_uart_en_ctrl {

				uart_audio_en_active {
					phandle = <0x3f>;

					config {
						bias-disable;
						drive-strength = <0x2>;
						output-high;
						pins = "gpio7";
					};

					mux {
						function = "gpio";
						pins = "gpio7";
					};
				};

				uart_audio_en_idle {
					phandle = <0x40>;

					config {
						bias-pull-down;
						drive-strength = <0x2>;
						output-low;
						pins = "gpio7";
					};

					mux {
						function = "gpio";
						pins = "gpio7";
					};
				};
			};
		};
	};

	fragment@1 {
		target = <0xffffffff>;

		__overlay__ {
			#address-cells = <0x2>;
			#interrupt-cells = <0x4>;
			#size-cells = <0x0>;
			interrupt-controller;

			qcom,pm8550@1 {
				#address-cells = <0x1>;
				#size-cells = <0x0>;
				compatible = "qcom,spmi-pmic";
				reg = <0x1 0x0>;

				bcl@4700 {
					#thermal-sensor-cells = <0x1>;
					compatible = "qcom,bcl-v5";
					interrupt-names = "bcl-lvl0", "bcl-lvl1", "bcl-lvl2";
					interrupts = <0x1 0x47 0x0 0x0 0x1 0x47 0x1 0x0 0x1 0x47 0x2 0x0>;
					phandle = <0x6>;
					qcom,pmic7-threshold;
					reg = <0x4700 0x100>;
				};

				pinctrl@8800 {
					#gpio-cells = <0x2>;
					#interrupt-cells = <0x2>;
					compatible = "qcom,pm8550-gpio";
					gpio-controller;
					interrupt-controller;
					phandle = <0x18>;
					reg = <0x8800>;

					charger_therm0 {

						charger_therm0_default {
							bias-high-impedance;
							phandle = <0x12>;
							pins = "gpio2";
						};
					};

					key_vol_up {

						key_vol_up_default {
							bias-pull-up;
							function = "normal";
							input-enable;
							phandle = <0x2d>;
							pins = "gpio6";
							power-source = <0x1>;
						};
					};

					sd_card_det {

						sd_card_det_default {
							bias-pull-up;
							function = "normal";
							input-enable;
							output-disable;
							phandle = <0x2c>;
							pins = "gpio12";
							power-source = <0x1>;
						};
					};
				};

				pm8550-temp-alarm@a00 {
					#thermal-sensor-cells = <0x0>;
					compatible = "qcom,spmi-temp-alarm";
					interrupts = <0x1 0xa 0x0 0x3>;
					io-channel-names = "thermal";
					io-channels = <0x1 0x103>;
					phandle = <0x5>;
					reg = <0xa00>;
				};

				pwms@e800 {
					#pwm-cells = <0x2>;
					compatible = "qcom,pwm-lpg";
					nvmem = <0x2 0x3>;
					nvmem-names = "lpg_chan_sdam", "lut_sdam";
					phandle = <0x4>;
					qcom,lut-patterns = <0x0 0xa 0x14 0x1e 0x28 0x32 0x3c 0x46 0x50 0x5a 0x64 0x5a 0x50 0x46 0x3c 0x32 0x28 0x1e 0x14 0xa 0x0>;
					qcom,lut-sdam-base = <0x45>;
					qcom,num-lpg-channels = <0x3>;
					qcom,tick-duration-us = <0x1e78>;
					reg = <0xe800>;
					reg-names = "lpg-base";

					lpg@1 {
						qcom,lpg-chan-id = <0x1>;
						qcom,lpg-sdam-base = <0x48>;
						qcom,ramp-high-index = <0x13>;
						qcom,ramp-low-index = <0x0>;
						qcom,ramp-pattern-repeat;
						qcom,ramp-step-ms = <0x64>;
					};

					lpg@2 {
						qcom,lpg-chan-id = <0x2>;
						qcom,lpg-sdam-base = <0x56>;
						qcom,ramp-high-index = <0x13>;
						qcom,ramp-low-index = <0x0>;
						qcom,ramp-pattern-repeat;
						qcom,ramp-step-ms = <0x64>;
					};

					lpg@3 {
						qcom,lpg-chan-id = <0x3>;
						qcom,lpg-sdam-base = <0x64>;
						qcom,ramp-high-index = <0x13>;
						qcom,ramp-low-index = <0x0>;
						qcom,ramp-pattern-repeat;
						qcom,ramp-step-ms = <0x64>;
					};
				};

				pwms@eb00 {
					#pwm-cells = <0x2>;
					compatible = "qcom,pwm-lpg";
					phandle = <0x41>;
					qcom,num-lpg-channels = <0x1>;
					reg = <0xeb00>;
					reg-names = "lpg-base";
				};

				qcom,flash_led@ee00 {
					compatible = "qcom,pm8350c-flash-led";
					interrupt-names = "led-fault-irq", "all-ramp-down-done-irq", "all-ramp-up-done-irq";
					interrupts = <0x1 0xee 0x0 0x1 0x1 0xee 0x3 0x1 0x1 0xee 0x4 0x1>;
					phandle = <0x43>;
					qcom,thermal-derate-current = <0xc8 0x1f4>;
					reg = <0xee00>;
					status = "ok";

					qcom,flash_0 {
						label = "flash";
						phandle = <0x44>;
						qcom,default-led-trigger = "flash0_trigger";
						qcom,duration-ms = <0x500>;
						qcom,id = <0x0>;
						qcom,ires-ua = <0x30d4>;
						qcom,led-name = "led:flash_0";
						qcom,max-current-ma = <0x5dc>;
					};

					qcom,flash_1 {
						label = "flash";
						phandle = <0x45>;
						qcom,default-led-trigger = "flash1_trigger";
						qcom,duration-ms = <0x500>;
						qcom,id = <0x1>;
						qcom,ires-ua = <0x30d4>;
						qcom,led-name = "led:flash_1";
						qcom,max-current-ma = <0x5dc>;
					};

					qcom,flash_2 {
						label = "flash";
						phandle = <0x46>;
						qcom,default-led-trigger = "flash2_trigger";
						qcom,duration-ms = <0x500>;
						qcom,id = <0x2>;
						qcom,ires-ua = <0x30d4>;
						qcom,led-name = "led:flash_2";
						qcom,max-current-ma = <0x5dc>;
					};

					qcom,flash_3 {
						label = "flash";
						phandle = <0x47>;
						qcom,default-led-trigger = "flash3_trigger";
						qcom,duration-ms = <0x500>;
						qcom,id = <0x3>;
						qcom,ires-ua = <0x30d4>;
						qcom,led-name = "led:flash_3";
						qcom,max-current-ma = <0x5dc>;
					};

					qcom,led_switch_0 {
						label = "switch";
						phandle = <0x4c>;
						qcom,default-led-trigger = "switch0_trigger";
						qcom,led-mask = <0x9>;
						qcom,led-name = "led:switch_0";
						qcom,symmetry-en;
					};

					qcom,led_switch_1 {
						label = "switch";
						phandle = <0x4d>;
						qcom,default-led-trigger = "switch1_trigger";
						qcom,led-mask = <0x6>;
						qcom,led-name = "led:switch_1";
						qcom,symmetry-en;
					};

					qcom,led_switch_2 {
						label = "switch";
						phandle = <0x4e>;
						qcom,default-led-trigger = "switch2_trigger";
						qcom,led-mask = <0xf>;
						qcom,led-name = "led:switch_2";
						qcom,symmetry-en;
					};

					qcom,torch_0 {
						label = "torch";
						phandle = <0x48>;
						qcom,default-led-trigger = "torch0_trigger";
						qcom,id = <0x0>;
						qcom,ires-ua = <0x30d4>;
						qcom,led-name = "led:torch_0";
						qcom,max-current-ma = <0x1f4>;
					};

					qcom,torch_1 {
						label = "torch";
						phandle = <0x49>;
						qcom,default-led-trigger = "torch1_trigger";
						qcom,id = <0x1>;
						qcom,ires-ua = <0x30d4>;
						qcom,led-name = "led:torch_1";
						qcom,max-current-ma = <0x1f4>;
					};

					qcom,torch_2 {
						label = "torch";
						phandle = <0x4a>;
						qcom,default-led-trigger = "torch2_trigger";
						qcom,id = <0x2>;
						qcom,ires-ua = <0x30d4>;
						qcom,led-name = "led:torch_2";
						qcom,max-current-ma = <0x1f4>;
					};

					qcom,torch_3 {
						label = "torch";
						phandle = <0x4b>;
						qcom,default-led-trigger = "torch3_trigger";
						qcom,id = <0x3>;
						qcom,ires-ua = <0x30d4>;
						qcom,led-name = "led:torch_3";
						qcom,max-current-ma = <0x1f4>;
					};
				};

				qcom,leds@ef00 {
					compatible = "qcom,tri-led";
					phandle = <0x42>;
					reg = <0xef00>;

					blue {
						label = "blue";
						led-sources = <0x2>;
						linux,default-trigger = "timer";
						pwms = <0x4 0x2 0xf4240>;
					};

					green {
						label = "green";
						led-sources = <0x1>;
						linux,default-trigger = "timer";
						pwms = <0x4 0x1 0xf4240>;
					};

					red {
						label = "red";
						led-sources = <0x0>;
						linux,default-trigger = "timer";
						pwms = <0x4 0x0 0xf4240>;
					};
				};
			};
		};
	};

	fragment@10 {
		target = <0xffffffff>;

		__overlay__ {
			#address-cells = <0x2>;
			#interrupt-cells = <0x4>;
			#size-cells = <0x0>;
			interrupt-controller;

			qcom,pmr735d@a {
				#address-cells = <0x1>;
				#size-cells = <0x0>;
				compatible = "qcom,spmi-pmic";
				reg = <0xa 0x0>;

				pinctrl@8800 {
					#gpio-cells = <0x2>;
					#interrupt-cells = <0x2>;
					compatible = "qcom,pmr735d-gpio";
					gpio-controller;
					interrupt-controller;
					phandle = <0x7d>;
					reg = <0x8800>;
				};

				pmr735d-k-temp-alarm@a00 {
					#thermal-sensor-cells = <0x0>;
					compatible = "qcom,spmi-temp-alarm";
					interrupts = <0xa 0xa 0x0 0x3>;
					phandle = <0x13>;
					reg = <0xa00>;
				};
			};

			qcom,pmr735d@b {
				#address-cells = <0x1>;
				#size-cells = <0x0>;
				compatible = "qcom,spmi-pmic";
				reg = <0xb 0x0>;

				pinctrl@8800 {
					#gpio-cells = <0x2>;
					#interrupt-cells = <0x2>;
					compatible = "qcom,pmr735d-gpio";
					gpio-controller;
					interrupt-controller;
					phandle = <0x7e>;
					reg = <0x8800>;
				};

				pmr735d-l-temp-alarm@a00 {
					#thermal-sensor-cells = <0x0>;
					compatible = "qcom,spmi-temp-alarm";
					interrupts = <0xb 0xa 0x0 0x3>;
					phandle = <0x14>;
					reg = <0xa00>;
				};
			};
		};
	};

	fragment@11 {
		target = <0xffffffff>;

		__overlay__ {

			pmr735d_k_tz {
				phandle = <0x7f>;
				polling-delay = <0x0>;
				polling-delay-passive = <0x64>;
				thermal-governor = "step_wise";
				thermal-sensors = <0x13>;

				trips {

					trip0 {
						hysteresis = <0x0>;
						phandle = <0x80>;
						temperature = <0x17318>;
						type = "passive";
					};

					trip1 {
						hysteresis = <0x0>;
						phandle = <0x81>;
						temperature = <0x1c138>;
						type = "passive";
					};

					trip2 {
						hysteresis = <0x0>;
						phandle = <0x82>;
						temperature = <0x23668>;
						type = "critical";
					};
				};
			};

			pmr735d_l_tz {
				phandle = <0x83>;
				polling-delay = <0x0>;
				polling-delay-passive = <0x64>;
				thermal-governor = "step_wise";
				thermal-sensors = <0x14>;

				trips {

					trip0 {
						hysteresis = <0x0>;
						phandle = <0x84>;
						temperature = <0x17318>;
						type = "passive";
					};

					trip1 {
						hysteresis = <0x0>;
						phandle = <0x85>;
						temperature = <0x1c138>;
						type = "passive";
					};

					trip2 {
						hysteresis = <0x0>;
						phandle = <0x86>;
						temperature = <0x23668>;
						type = "critical";
					};
				};
			};
		};
	};

	fragment@12 {
		target = <0xffffffff>;

		__overlay__ {
			#address-cells = <0x2>;
			#interrupt-cells = <0x4>;
			#size-cells = <0x0>;
			interrupt-controller;

			qcom,pm8010@c {
				#address-cells = <0x1>;
				#size-cells = <0x0>;
				compatible = "qcom,spmi-pmic";
				phandle = <0x87>;
				reg = <0xc 0x0>;

				pm8010-m-temp-alarm@2400 {
					#thermal-sensor-cells = <0x0>;
					compatible = "qcom,spmi-temp-alarm";
					interrupts = <0xc 0x24 0x0 0x3>;
					phandle = <0x15>;
					reg = <0x2400>;
				};
			};

			qcom,pm8010@d {
				#address-cells = <0x1>;
				#size-cells = <0x0>;
				compatible = "qcom,spmi-pmic";
				phandle = <0x88>;
				reg = <0xd 0x0>;

				pm8010-n-temp-alarm@2400 {
					#thermal-sensor-cells = <0x0>;
					compatible = "qcom,spmi-temp-alarm";
					interrupts = <0xd 0x24 0x0 0x3>;
					phandle = <0x16>;
					reg = <0x2400>;
				};
			};
		};
	};

	fragment@13 {
		target = <0xffffffff>;

		__overlay__ {

			pm8010m_tz {
				polling-delay = <0x0>;
				polling-delay-passive = <0x64>;
				thermal-governor = "step_wise";
				thermal-sensors = <0x15>;

				trips {

					trip0 {
						hysteresis = <0x0>;
						temperature = <0x17318>;
						type = "passive";
					};

					trip1 {
						hysteresis = <0x0>;
						temperature = <0x1c138>;
						type = "passive";
					};

					trip2 {
						hysteresis = <0x0>;
						temperature = <0x23668>;
						type = "critical";
					};
				};
			};

			pm8010n_tz {
				polling-delay = <0x0>;
				polling-delay-passive = <0x64>;
				thermal-governor = "step_wise";
				thermal-sensors = <0x16>;

				trips {

					trip0 {
						hysteresis = <0x0>;
						temperature = <0x17318>;
						type = "passive";
					};

					trip1 {
						hysteresis = <0x0>;
						temperature = <0x1c138>;
						type = "passive";
					};

					trip2 {
						hysteresis = <0x0>;
						temperature = <0x23668>;
						type = "critical";
					};
				};
			};

			xo-therm {
				polling-delay = <0x0>;
				polling-delay-passive = <0x0>;
				thermal-sensors = <0x1 0x44>;

				trips {

					active-config0 {
						hysteresis = <0x3e8>;
						temperature = <0x1e848>;
						type = "passive";
					};

					active-config1 {
						hysteresis = <0x3e8>;
						temperature = <0x1e848>;
						type = "passive";
					};

					display-test-config1 {
						hysteresis = <0x3e8>;
						phandle = <0x28>;
						temperature = <0x1e848>;
						type = "passive";
					};

					display-test-config2 {
						hysteresis = <0x3e8>;
						phandle = <0x29>;
						temperature = <0x1e848>;
						type = "passive";
					};

					display-test-config3 {
						hysteresis = <0x3e8>;
						phandle = <0x2a>;
						temperature = <0x1e848>;
						type = "passive";
					};

					display-test-config4 {
						hysteresis = <0x3e8>;
						phandle = <0x2b>;
						temperature = <0x1e848>;
						type = "passive";
					};

					xo-config0 {
						hysteresis = <0x1f40>;
						phandle = <0x26>;
						temperature = <0x130b0>;
						type = "passive";
					};

					xo-config1 {
						hysteresis = <0x2710>;
						phandle = <0x27>;
						temperature = <0x13880>;
						type = "passive";
					};
				};
			};
		};
	};

	fragment@14 {
		target = <0xffffffff>;

		__overlay__ {

			pmic-pon-log {
				compatible = "qcom,pmic-pon-log";
				nvmem = <0x19 0x1a>;
				nvmem-names = "pon_log0", "pon_log1";
			};

			reboot_reason {
				compatible = "qcom,reboot-reason";
				nvmem-cell-names = "restart_reason";
				nvmem-cells = <0x17>;
			};

			regulator-dbo3 {
				compatible = "qti-regulator-fixed";
				enable-active-high;
				gpio = <0x18 0x9 0x0>;
				phandle = <0x89>;
				regulator-enable-ramp-delay = <0x5dc>;
				regulator-max-microvolt = <0x36ee80>;
				regulator-min-microvolt = <0x36ee80>;
				regulator-name = "dbo3";
			};

			regulator-ocp-notifier {
				compatible = "qcom,regulator-ocp-notifier";
				interrupt-parent = <0xffffffff>;
				interrupts = <0x0 0x71 0x1 0x1>;
				nvmem-cell-names = "ocp_log";
				nvmem-cells = <0x1b>;
				periph-1c1-supply = <0xffffffff>;
				periph-1c2-supply = <0xffffffff>;
				periph-1c5-supply = <0xffffffff>;
				periph-1c6-supply = <0xffffffff>;
				periph-1c7-supply = <0xffffffff>;
				periph-1c8-supply = <0xffffffff>;
				periph-1c9-supply = <0xffffffff>;
				periph-1ca-supply = <0xffffffff>;
				periph-1cb-supply = <0xffffffff>;
				periph-1cc-supply = <0xffffffff>;
				periph-1cd-supply = <0xffffffff>;
				periph-1ce-supply = <0xffffffff>;
				periph-1cf-supply = <0xffffffff>;
				periph-1d0-supply = <0xffffffff>;
				periph-1d1-supply = <0xffffffff>;
				periph-2c1-supply = <0xffffffff>;
				periph-3c1-supply = <0xffffffff>;
				periph-3c2-supply = <0xffffffff>;
				periph-4c1-supply = <0xffffffff>;
				periph-4c2-supply = <0xffffffff>;
				periph-4c3-supply = <0xffffffff>;
				periph-5c1-supply = <0xffffffff>;
				periph-5c2-supply = <0xffffffff>;
				periph-5c3-supply = <0xffffffff>;
				periph-6c1-supply = <0xffffffff>;
				periph-6c2-supply = <0xffffffff>;
				periph-6c3-supply = <0xffffffff>;
				periph-ac1-supply = <0xffffffff>;
				periph-ac2-supply = <0xffffffff>;
				periph-ac3-supply = <0xffffffff>;
				periph-ac4-supply = <0xffffffff>;
				periph-ac5-supply = <0xffffffff>;
				periph-ac6-supply = <0xffffffff>;
				periph-ac7-supply = <0xffffffff>;
				periph-c40-supply = <0xffffffff>;
				periph-c41-supply = <0xffffffff>;
				periph-c42-supply = <0xffffffff>;
				periph-c43-supply = <0xffffffff>;
				periph-c44-supply = <0xffffffff>;
				periph-c45-supply = <0xffffffff>;
				periph-c46-supply = <0xffffffff>;
				phandle = <0x8a>;
			};
		};
	};

	fragment@15 {
		target = <0xffffffff>;

		__overlay__ {

			pm8550-bcl-lvl0 {

				cooling-maps {

					vph_cdsp0 {
						cooling-device = <0xffffffff 0x2 0x2>;
						trip = <0x20>;
					};

					vph_cpu_3_4_5 {
						cooling-device = <0xffffffff 0x1 0x1>;
						trip = <0x20>;
					};

					vph_gpu0 {
						cooling-device = <0xffffffff 0x2 0x2>;
						trip = <0x20>;
					};

					vph_lte0 {
						cooling-device = <0xffffffff 0x8 0x8>;
						trip = <0x20>;
					};

					vph_nr0 {
						cooling-device = <0xffffffff 0x6 0x6>;
						trip = <0x20>;
					};

					vph_nr0_scg {
						cooling-device = <0xffffffff 0x3 0x3>;
						trip = <0x20>;
					};
				};
			};

			pm8550-bcl-lvl1 {

				cooling-maps {

					vph_cdsp1 {
						cooling-device = <0xffffffff 0x4 0x4>;
						trip = <0x21>;
					};

					vph_cpu_6_7 {
						cooling-device = <0xffffffff 0x1 0x1>;
						trip = <0x21>;
					};

					vph_gpu1 {
						cooling-device = <0xffffffff 0x4 0x4>;
						trip = <0x21>;
					};

					vph_lte1 {
						cooling-device = <0xffffffff 0xa 0xa>;
						trip = <0x21>;
					};

					vph_nr1 {
						cooling-device = <0xffffffff 0x9 0x9>;
						trip = <0x21>;
					};

					vph_nr1_scg {
						cooling-device = <0xffffffff 0xa 0xa>;
						trip = <0x21>;
					};
				};
			};

			pm8550-bcl-lvl2 {

				cooling-maps {

					vph_cdsp2 {
						cooling-device = <0xffffffff 0x5 0xffffffff>;
						trip = <0x22>;
					};

					vph_gpu2 {
						cooling-device = <0xffffffff 0x5 0xffffffff>;
						trip = <0x22>;
					};
				};
			};

			pm8550b-bcl-lvl0 {

				cooling-maps {

					lbat_0_mdm_lte {
						cooling-device = <0xffffffff 0x8 0x8>;
						trip = <0x1d>;
					};

					lbat_0_nr {
						cooling-device = <0xffffffff 0x6 0x6>;
						trip = <0x1d>;
					};

					lbat_0_nr_scg {
						cooling-device = <0xffffffff 0x3 0x3>;
						trip = <0x1d>;
					};

					lbat_cdsp0 {
						cooling-device = <0xffffffff 0x2 0x2>;
						trip = <0x1d>;
					};

					lbat_cpu_3_4_5 {
						cooling-device = <0xffffffff 0x1 0x1>;
						trip = <0x1d>;
					};

					lbat_gpu0 {
						cooling-device = <0xffffffff 0x2 0x2>;
						trip = <0x1d>;
					};
				};
			};

			pm8550b-bcl-lvl1 {

				cooling-maps {

					lbat_1_mdm_lte {
						cooling-device = <0xffffffff 0xa 0xa>;
						trip = <0x1e>;
					};

					lbat_1_nr {
						cooling-device = <0xffffffff 0x9 0x9>;
						trip = <0x1e>;
					};

					lbat_1_nr_scg {
						cooling-device = <0xffffffff 0xa 0xa>;
						trip = <0x1e>;
					};

					lbat_cdsp1 {
						cooling-device = <0xffffffff 0x4 0x4>;
						trip = <0x1e>;
					};

					lbat_cpu_6_7 {
						cooling-device = <0xffffffff 0x1 0x1>;
						trip = <0x1e>;
					};

					lbat_gpu1 {
						cooling-device = <0xffffffff 0x4 0x4>;
						trip = <0x1e>;
					};
				};
			};

			pm8550b-bcl-lvl2 {

				cooling-maps {

					lbat_cdsp2 {
						cooling-device = <0xffffffff 0x5 0xffffffff>;
						trip = <0x1f>;
					};

					lbat_gpu2 {
						cooling-device = <0xffffffff 0x5 0xffffffff>;
						trip = <0x1f>;
					};
				};
			};

			pm8550ve_f_tz {

				cooling-maps {

					pm8550vs_e_lte {
						cooling-device = <0xffffffff 0xff 0xff>;
						trip = <0x25>;
					};

					pm8550vs_e_nr {
						cooling-device = <0xffffffff 0xff 0xff>;
						trip = <0x25>;
					};

					pm8550vs_e_nsp {
						cooling-device = <0xffffffff 0x5 0xffffffff>;
						trip = <0x25>;
					};
				};
			};

			pm8550vs_c_tz {

				cooling-maps {

					pm8550vs_c_apc1 {
						cooling-device = <0xffffffff 0x1 0x1>;
						trip = <0x23>;
					};
				};
			};

			pm8550vs_d_tz {

				cooling-maps {

					pm8550vs_d_gpu {
						cooling-device = <0xffffffff 0x5 0xffffffff>;
						trip = <0x24>;
					};
				};
			};

			socd {

				cooling-maps {

					socd_apc1 {
						cooling-device = <0xffffffff 0x1 0x1>;
						trip = <0x1c>;
					};

					socd_cdsp1 {
						cooling-device = <0xffffffff 0x4 0x4>;
						trip = <0x1c>;
					};

					socd_gpu0 {
						cooling-device = <0xffffffff 0x4 0x4>;
						trip = <0x1c>;
					};
				};
			};

			xo-therm {

				cooling-maps {

					apc1_cdev {
						cooling-device = <0xffffffff 0x1 0x1>;
						trip = <0x26>;
					};

					cdsp_cdev {
						cooling-device = <0xffffffff 0x5 0xffffffff>;
						trip = <0x26>;
					};

					cpu3_hot_cdev {
						cooling-device = <0xffffffff 0x1 0x1>;
						trip = <0x27>;
					};

					cpu4_hot_cdev {
						cooling-device = <0xffffffff 0x1 0x1>;
						trip = <0x27>;
					};

					cpu5_hot_cdev {
						cooling-device = <0xffffffff 0x1 0x1>;
						trip = <0x27>;
					};

					cpu6_hot_cdev {
						cooling-device = <0xffffffff 0x1 0x1>;
						trip = <0x27>;
					};

					cpu7_hot_cdev {
						cooling-device = <0xffffffff 0x1 0x1>;
						trip = <0x27>;
					};

					display_cdev1 {
						cooling-device = <0xffffffff 0x1 0x1>;
						trip = <0x28>;
					};

					display_cdev2 {
						cooling-device = <0xffffffff 0x2 0x2>;
						trip = <0x29>;
					};

					display_cdev3 {
						cooling-device = <0xffffffff 0x3 0x3>;
						trip = <0x2a>;
					};

					display_cdev4 {
						cooling-device = <0xffffffff 0x4 0x4>;
						trip = <0x2b>;
					};

					gpu_cdev {
						cooling-device = <0xffffffff 0x5 0xffffffff>;
						trip = <0x26>;
					};

					lte_cdev {
						cooling-device = <0xffffffff 0xff 0xff>;
						trip = <0x27>;
					};

					nr_cdev {
						cooling-device = <0xffffffff 0xff 0xff>;
						trip = <0x27>;
					};
				};
			};
		};
	};

	fragment@16 {
		target = <0xffffffff>;

		__overlay__ {
			cd-gpios = <0x18 0xc 0x1>;
			pinctrl-0 = <0xffffffff 0x2c>;
			pinctrl-1 = <0xffffffff 0x2c>;
			pinctrl-names = "default", "sleep";
			qcom,iommu-dma = "fastmap";
			qcom,uses_level_shifter;
			qcom,vdd-current-level = <0x0 0xc3500>;
			qcom,vdd-io-current-level = <0x0 0x15e0>;
			qcom,vdd-io-voltage-level = <0x1b7740 0x2d2a80>;
			qcom,vdd-voltage-level = <0x2d0370 0x2d2a80>;
			reset-names = "core_reset";
			resets = <0xffffffff 0x16>;
			status = "disabled";
			vdd-io-supply = <0xffffffff>;
			vdd-supply = <0xffffffff>;
		};
	};

	fragment@17 {
		target = <0xffffffff>;

		__overlay__ {

			dump_display_region@a4a80000 {
				compatible = "xiaomi,dump_display";
				phandle = <0x8b>;
				reg = <0xa4a80000 0x800>;
			};

			gpio_keys {
				compatible = "gpio-keys";
				label = "gpio-keys";
				pinctrl-0 = <0x2d>;
				pinctrl-names = "default";

				vol_up {
					debounce-interval = <0x20>;
					gpio-key,wakeup;
					gpios = <0x18 0x6 0x1>;
					label = "volume_up";
					linux,can-disable;
					linux,code = <0x73>;
					linux,input-type = <0x1>;
				};
			};

			hardwareinfo {
				compatible = "xiaomi,hardware-info";
				status = "ok";
			};

			mtdoops_pmsg@0xa7000000 {
				compatible = "mtdoops_pmsg";
				console-size = <0x200000>;
				pmsg-size = <0x200000>;
				reg = <0xa7000000 0x400000>;
			};
		};
	};

	fragment@18 {
		target = <0xffffffff>;

		__overlay__ {
			status = "ok";

			ir-spi@0 {
				compatible = "ir-spi";
				reg = <0x0>;
				spi-max-frequency = <0x124f800>;
				status = "ok";
			};
		};
	};

	fragment@19 {
		target = <0xffffffff>;

		__overlay__ {
			compatible = "qcom,ufs-phy-qmp-v4-kalama";
			status = "ok";
			vdd-phy-gdsc-supply = <0xffffffff>;
			vdda-phy-max-microamp = <0x2de60>;
			vdda-phy-supply = <0xffffffff>;
			vdda-pll-max-microamp = <0x477c>;
			vdda-pll-supply = <0xffffffff>;
			vdda-qref-max-microamp = <0x7530>;
			vdda-qref-supply = <0xffffffff>;
		};
	};

	fragment@2 {
		target = <0xffffffff>;

		__overlay__ {

			pm8550-bcl-lvl0 {
				polling-delay = <0x0>;
				polling-delay-passive = <0x64>;
				thermal-governor = "step_wise";
				thermal-sensors = <0x6 0x5>;

				trips {

					bcl-lvl0 {
						hysteresis = <0x1>;
						phandle = <0x20>;
						temperature = <0x1>;
						type = "passive";
					};
				};
			};

			pm8550-bcl-lvl1 {
				polling-delay = <0x0>;
				polling-delay-passive = <0x64>;
				thermal-governor = "step_wise";
				thermal-sensors = <0x6 0x6>;

				trips {

					bcl-lvl1 {
						hysteresis = <0x1>;
						phandle = <0x21>;
						temperature = <0x1>;
						type = "passive";
					};
				};
			};

			pm8550-bcl-lvl2 {
				polling-delay = <0x0>;
				polling-delay-passive = <0x64>;
				thermal-governor = "step_wise";
				thermal-sensors = <0x6 0x7>;

				trips {

					bcl-lvl2 {
						hysteresis = <0x1>;
						phandle = <0x22>;
						temperature = <0x1>;
						type = "passive";
					};
				};
			};

			pm8550_tz {
				phandle = <0x4f>;
				polling-delay = <0x0>;
				polling-delay-passive = <0x64>;
				thermal-governor = "step_wise";
				thermal-sensors = <0x5>;

				trips {

					trip0 {
						hysteresis = <0x0>;
						phandle = <0x50>;
						temperature = <0x17318>;
						type = "passive";
					};

					trip1 {
						hysteresis = <0x0>;
						phandle = <0x51>;
						temperature = <0x1c138>;
						type = "passive";
					};

					trip2 {
						hysteresis = <0x0>;
						phandle = <0x52>;
						temperature = <0x23668>;
						type = "critical";
					};
				};
			};
		};
	};

	fragment@20 {
		target = <0xffffffff>;

		__overlay__ {
			qcom,vccq-parent-max-microamp = <0x33450>;
			qcom,vccq-parent-supply = <0xffffffff>;
			qcom,vddp-ref-clk-max-microamp = <0x64>;
			qcom,vddp-ref-clk-supply = <0xffffffff>;
			reset-gpios = <0xffffffff 0xd2 0x1>;
			reset-names = "rst";
			resets = <0xffffffff 0x18>;
			status = "ok";
			vcc-max-microamp = <0x13d620>;
			vcc-supply = <0xffffffff>;
			vccq-max-microamp = <0x124f80>;
			vccq-supply = <0xffffffff>;
			vdd-hba-supply = <0xffffffff>;
		};
	};

	fragment@21 {
		target = <0xffffffff>;

		__overlay__ {
			#address-cells = <0x1>;
			#size-cells = <0x0>;
			qcom,i2c-touch-active = "goodix,gt9916";
			status = "disabled";

			goodix-berlin@5d {
				avdd-supply = <0xffffffff>;
				compatible = "goodix,gt9916";
				goodix,avdd-name = "avdd";
				goodix,config-name = "goodix_cfg_group_i2c.bin";
				goodix,firmware-name = "goodix_firmware_i2c.bin";
				goodix,iovdd-name = "iovdd";
				goodix,irq-flags = <0x2>;
				goodix,irq-gpio = <0xffffffff 0x19 0x2008>;
				goodix,panel-max-p = <0x1000>;
				goodix,panel-max-w = <0xff>;
				goodix,panel-max-x = <0x438>;
				goodix,panel-max-y = <0x960>;
				goodix,qts_en;
				goodix,reset-gpio = <0xffffffff 0x18 0x0>;
				goodix,touch-type = "primary";
				interrupt-parent = <0xffffffff>;
				interrupts = <0x19 0x2008>;
				invert_xy;
				iovdd-supply = <0xffffffff>;
				qts,touch-environment = "pvm";
				qts,trusted-touch-io-bases = <0xa90000>;
				qts,trusted-touch-io-sizes = <0x1000>;
				qts,trusted-touch-mode = "vm_mode";
				qts,trusted-touch-spi-irq = <0x239>;
				qts,trusted-touch-type = "primary";
				qts,trusted-touch-vm-gpio-list = <0xffffffff 0x2c 0x0 0xffffffff 0x2d 0x0 0xffffffff 0x2e 0x0 0xffffffff 0x2f 0x0 0xffffffff 0x18 0x0 0xffffffff 0x19 0x2008>;
				reg = <0x5d>;
			};
		};
	};

	fragment@22 {
		target = <0xffffffff>;

		__overlay__ {
			dummy-supply = <0x2e>;
			usb-repeater = <0x2e>;
		};
	};

	fragment@23 {
		target = <0xffffffff>;

		__overlay__ {
			usb-role-switch;

			port {

				endpoint {
					phandle = <0x30>;
					remote-endpoint = <0x2f>;
				};
			};
		};
	};

	fragment@24 {
		target = <0xffffffff>;

		__overlay__ {

			connector {

				port {

					endpoint {
						phandle = <0x2f>;
						remote-endpoint = <0x30>;
					};
				};
			};
		};
	};

	fragment@25 {
		target = <0xffffffff>;

		__overlay__ {
			qcom,thermal-mitigation = <0x2dc6c0 0x16e360 0xf4240 0x7a120>;
			qcom,wireless-fw-name = "idt9418.bin";
		};
	};

	fragment@26 {
		target = <0xffffffff>;

		__overlay__ {
			#address-cells = <0x2>;
			#size-cells = <0x2>;
			ranges;

			aop_image_region@81c00000 {
				no-map;
				phandle = <0x8d>;
				reg = <0x0 0x81c00000 0x0 0x60000>;
			};

			ramoops@0xa7000000 {
				compatible = "ramoops";
				console-size = <0x200000>;
				pmsg-size = <0x200000>;
				reg = <0x0 0xa7000000 0x0 0x400000>;
			};

			xbl_dt_log@81a00000 {
				no-map;
				phandle = <0x8c>;
				reg = <0x0 0x81a00000 0x0 0x40000>;
			};

			xbl_ramdump_region@81200000 {
				no-map;
				phandle = <0x8e>;
				reg = <0x0 0x81200000 0x0 0x280000>;
			};
		};
	};

	fragment@27 {
		target = <0xffffffff>;

		__overlay__ {
			qcom,pcie-phy-ver = <0x68>;
			qcom,phy-sequence = <0x1240 0x3 0x0 0x30 0x18 0x0 0x34 0x3 0x0 0x78 0x1 0x0 0x7c 0x0 0x0 0x80 0x51 0x0 0x90 0x12 0x0 0xac 0x34 0x0 0xb0 0x0 0x0 0xcc 0x0 0x0 0x208 0xc 0x0 0x20c 0xa 0x0 0x218 0x4 0x0 0x220 0x16 0x0 0x234 0x0 0x0 0x29c 0x80 0x0 0x2a0 0x7c 0x0 0x2ac 0x0 0x0 0x2b0 0x20 0x0 0x2b4 0x5 0x0 0x2b8 0x0 0x0 0x2e0 0x40 0x0 0x2e4 0x0 0x0 0x2e8 0xa 0x0 0x30c 0xd 0x0 0x318 0x80 0x0 0x31c 0xa 0x0 0x320 0xf 0x0 0x33c 0x74 0x0 0x340 0x0 0x0 0x348 0x1c 0x0 0x34c 0x24 0x0 0x354 0xe 0x0 0x388 0x20 0x0 0x390 0x28 0x0 0x394 0x30 0x0 0x39c 0xc 0x0 0x3dc 0x9 0x0 0x3f4 0x14 0x0 0x3f8 0xb3 0x0 0x3fc 0x58 0x0 0x400 0x9a 0x0 0x404 0x26 0x0 0x408 0xb6 0x0 0x40c 0xee 0x0 0x410 0xdb 0x0 0x414 0xdb 0x0 0x418 0xa0 0x0 0x41c 0xdf 0x0 0x420 0x78 0x0 0x424 0x76 0x0 0x428 0xff 0x0 0x830 0x18 0x0 0x834 0x3 0x0 0x878 0x1 0x0 0x87c 0x0 0x0 0x880 0x51 0x0 0x890 0x12 0x0 0x8ac 0x34 0x0 0x8b0 0x0 0x0 0x8cc 0x0 0x0 0xa08 0xc 0x0 0xa0c 0xa 0x0 0xa18 0x4 0x0 0xa20 0x16 0x0 0xa34 0x0 0x0 0xa9c 0x80 0x0 0xaa0 0x7c 0x0 0xaac 0x0 0x0 0xab0 0x20 0x0 0xab4 0x5 0x0 0xab8 0x0 0x0 0xae0 0x40 0x0 0xae4 0x0 0x0 0xae8 0xa 0x0 0xb0c 0xd 0x0 0xb18 0x80 0x0 0xb1c 0xa 0x0 0xb20 0xf 0x0 0xb3c 0x74 0x0 0xb40 0x0 0x0 0xb48 0x1c 0x0 0xb4c 0x24 0x0 0xb54 0xe 0x0 0xb88 0x20 0x0 0xb90 0x28 0x0 0xb94 0x30 0x0 0xb9c 0xc 0x0 0xbdc 0x9 0x0 0xbf4 0x14 0x0 0xbf8 0xb3 0x0 0xbfc 0x58 0x0 0xc00 0x9a 0x0 0xc04 0x26 0x0 0xc08 0xb6 0x0 0xc0c 0xee 0x0 0xc10 0xdb 0x0 0xc14 0xdb 0x0 0xc18 0xa0 0x0 0xc1c 0xdf 0x0 0xc20 0x78 0x0 0xc24 0x76 0x0 0xc28 0xff 0x0 0xea0 0x1 0x0 0xeb4 0x0 0x0 0xeb8 0x8 0x0 0xebc 0x3e 0x0 0xec0 0x1e 0x0 0xec4 0x0 0x0 0xec8 0x1f 0x0 0xed4 0x12 0x0 0xed8 0x12 0x0 0xedc 0xdb 0x0 0xee0 0x9a 0x0 0xee4 0x3f 0x0 0xee8 0xb6 0x0 0xeec 0x64 0x0 0xef0 0x1f 0x0 0xef4 0x1f 0x0 0xef8 0x1f 0x0 0xefc 0x1f 0x0 0xf00 0x1f 0x0 0xf04 0x1f 0x0 0xf0c 0x1f 0x0 0xf14 0x1f 0x0 0xf1c 0x1f 0x0 0xf28 0x5b 0x0 0x1000 0x26 0x0 0x1004 0x3 0x0 0x1010 0x6 0x0 0x1014 0x16 0x0 0x1018 0x36 0x0 0x101c 0x4 0x0 0x1020 0xa 0x0 0x1024 0x1a 0x0 0x1028 0x68 0x0 0x1030 0xab 0x0 0x1034 0xaa 0x0 0x1038 0x2 0x0 0x103c 0x12 0x0 0x1060 0xf8 0x0 0x1064 0x1 0x0 0x1070 0x6 0x0 0x1074 0x16 0x0 0x1078 0x36 0x0 0x107c 0xa 0x0 0x1080 0x4 0x0 0x1084 0xd 0x0 0x1088 0x41 0x0 0x1090 0xab 0x0 0x1094 0xaa 0x0 0x1098 0x1 0x0 0x109c 0x0 0x0 0x10bc 0xa 0x0 0x10c0 0x1 0x0 0x10cc 0x62 0x0 0x10d0 0x2 0x0 0x10d8 0x40 0x0 0x10dc 0x14 0x0 0x10e0 0x90 0x0 0x10e4 0x82 0x0 0x10f4 0xf 0x0 0x1110 0x8 0x0 0x1120 0x46 0x0 0x1124 0x4 0x0 0x1140 0x14 0x0 0x1164 0x34 0x0 0x1170 0xa0 0x0 0x1174 0x6 0x0 0x1184 0x88 0x0 0x1188 0x14 0x0 0x118c 0x0 0x0 0x1190 0x64 0x0 0x1194 0x0 0x0 0x1198 0xf 0x0 0x1378 0x2e 0x0 0x1390 0xcc 0x0 0x13f0 0xd 0x0 0x13f8 0x0 0x0 0x13fc 0x22 0x0 0x141c 0xc1 0x0 0x1490 0x0 0x0 0x14a0 0x16 0x0 0x14f0 0x27 0x0 0x14f4 0x27 0x0 0x14fc 0xd 0x0 0x1508 0x2 0x0 0x155c 0x2e 0x0 0x157c 0x3 0x0 0x1584 0x28 0x0 0x13dc 0x4 0x0 0x13e0 0x2 0x0 0x1418 0xc0 0x0 0x140c 0x1d 0x0 0x158c 0xf 0x0 0x1370 0xf 0x0 0x15ac 0xf2 0x0 0x15c0 0xf2 0x0 0x1200 0x0 0x0 0x1244 0x3 0x0>;
		};
	};

	fragment@28 {
		target = <0xffffffff>;

		__overlay__ {

			fingerprint_goodix {
				compatible = "goodix,fingerprint";
				goodix,gpio-irq = <0xffffffff 0x28 0x0>;
				goodix,gpio-reset = <0xffffffff 0x29 0x0>;
				l11c_vdd-supply = <0xffffffff>;
				status = "ok";
			};

			xiaomi_touch {
				compatible = "xiaomi-touch";
				status = "ok";
				touch,name = "xiaomi-touch";
			};
		};
	};

	fragment@29 {
		target = <0xffffffff>;

		__overlay__ {
			qcom,init-voltage = <0x30d400>;
			regulator-always-on;
			regulator-boot-on;
			regulator-max-microvolt = <0x30d400>;
			regulator-min-microvolt = <0x30d400>;
		};
	};

	fragment@3 {
		target = <0xffffffff>;

		__overlay__ {
			#address-cells = <0x2>;
			#interrupt-cells = <0x4>;
			#size-cells = <0x0>;
			interrupt-controller;

			qcom,pm8550b@7 {
				#address-cells = <0x1>;
				#size-cells = <0x0>;
				compatible = "qcom,spmi-pmic";
				reg = <0x7 0x0>;

				bcl-soc {
					#thermal-sensor-cells = <0x0>;
					compatible = "qcom,msm-bcl-soc";
					phandle = <0x56>;
				};

				bcl@4700 {
					#thermal-sensor-cells = <0x1>;
					compatible = "qcom,bcl-v5";
					interrupt-names = "bcl-lvl0", "bcl-lvl1", "bcl-lvl2";
					interrupts = <0x7 0x47 0x0 0x0 0x7 0x47 0x1 0x0 0x7 0x47 0x2 0x0>;
					phandle = <0xa>;
					qcom,pmic7-threshold;
					reg = <0x4700 0x100>;
				};

				pinctrl@8800 {
					#gpio-cells = <0x2>;
					#interrupt-cells = <0x2>;
					compatible = "qcom,pm8550b-gpio";
					gpio-controller;
					interrupt-controller;
					phandle = <0x53>;
					reg = <0x8800>;

					wls_therm {

						wls_therm_default {
							bias-high-impedance;
							phandle = <0x11>;
							pins = "gpio10";
						};
					};
				};

				pm8550b-temp-alarm-lite@c00 {
					#thermal-sensor-cells = <0x0>;
					compatible = "qcom,spmi-temp-alarm";
					interrupts = <0x7 0xc 0x0 0x3>;
					io-channel-names = "thermal";
					io-channels = <0x1 0x718>;
					phandle = <0x9>;
					reg = <0xc00>;
				};

				pm8550b-temp-alarm@a00 {
					#thermal-sensor-cells = <0x0>;
					compatible = "qcom,spmi-temp-alarm";
					interrupts = <0x7 0xa 0x0 0x3>;
					io-channel-names = "thermal";
					io-channels = <0x1 0x703>;
					phandle = <0x8>;
					reg = <0xa00>;
				};

				qcom,eusb2-repeater@fd00 {
					compatible = "qcom,pmic-eusb2-repeater";
					phandle = <0x2e>;
					qcom,param-override-seq = <0x0 0x50 0xa 0x51 0x3 0x52 0x7 0x53 0x1 0x54 0x3 0x55 0x0 0x56 0x7 0x57 0x2 0x58 0x3 0x59 0x1 0x5a 0x2 0x5b>;
					qcom,param-override-seq-host = <0x0 0x50 0xf 0x51 0x4 0x52 0x7 0x53 0x2 0x54 0x3 0x55 0x0 0x56 0x7 0x57 0x2 0x58 0x3 0x59 0x3 0x5a 0x2 0x5b>;
					qcom,param-override-seq-host-ms = <0x0 0x50 0x6 0x51 0x4 0x52 0x7 0x53 0x2 0x54 0x0 0x55 0x0 0x56 0x4 0x57 0x2 0x58 0x3 0x59 0x1 0x5a 0x2 0x5b>;
					reg = <0xfd00>;
					vdd18-supply = <0xffffffff>;
					vdd3-supply = <0xffffffff>;
				};

				qcom,hv-haptics@f000 {
					compatible = "qcom,hv-haptics";
					interrupt-names = "fifo-empty";
					interrupts = <0x7 0xf0 0x1 0x1>;
					nvmem = <0x7>;
					nvmem-names = "hap_cfg_sdam";
					phandle = <0x54>;
					qcom,brake-mode = <0x1>;
					qcom,brake-pattern = [ff 3f 1f];
					qcom,brake-sig-shape = <0x1>;
					qcom,drv-sig-shape = <0x1>;
					qcom,lra-f0-cal-count = <0x230>;
					qcom,lra-f0-default = <0xaf>;
					qcom,lra-f0-max = <0xb9>;
					qcom,lra-f0-min = <0xa0>;
					qcom,lra-period-us = <0x16fa>;
					qcom,vmax-mv = <0x4b0>;
					reg = <0xf000 0xf100 0xf200>;
					status = "okay";

					effect_0 {
						qcom,effect-id = <0x0>;
						qcom,wf-auto-res-disable;
						qcom,wf-brake-pattern = [00 00 00];
						qcom,wf-pattern-data = <0x1f 0x0 0x0 0x3f 0x0 0x0 0x5f 0x0 0x0 0x7f 0x0 0x0 0x17f 0x0 0x0 0x15f 0x0 0x0 0x13f 0x0 0x0 0x11f 0x0 0x0>;
						qcom,wf-pattern-period-us = <0x1a0b>;
						qcom,wf-pattern-preload;
						qcom,wf-vmax-mv = <0xe10>;
					};

					effect_1 {
						qcom,effect-id = <0x1>;
						qcom,wf-auto-res-disable;
						qcom,wf-brake-pattern = [00 00 00];
						qcom,wf-pattern-data = <0x1f 0x0 0x0 0x3f 0x0 0x0 0x5f 0x0 0x0 0x7f 0x0 0x0 0x17f 0x0 0x0 0x15f 0x0 0x0 0x13f 0x0 0x0 0x11f 0x0 0x0>;
						qcom,wf-pattern-period-us = <0x1a0b>;
						qcom,wf-vmax-mv = <0xe10>;
					};

					effect_2 {
						qcom,effect-id = <0x2>;
						qcom,wf-auto-res-disable;
						qcom,wf-brake-pattern = [00 00 00];
						qcom,wf-pattern-data = <0x1f 0x0 0x0 0x3f 0x0 0x0 0x5f 0x0 0x0 0x7f 0x0 0x0 0x17f 0x0 0x0 0x15f 0x0 0x0 0x13f 0x0 0x0 0x11f 0x0 0x0>;
						qcom,wf-pattern-period-us = <0x1a0b>;
						qcom,wf-vmax-mv = <0xe10>;
					};

					effect_3 {
						qcom,effect-id = <0x3>;
						qcom,wf-auto-res-disable;
						qcom,wf-brake-pattern = [00 00 00];
						qcom,wf-pattern-data = <0x1f 0x0 0x0 0x3f 0x0 0x0 0x5f 0x0 0x0 0x7f 0x0 0x0 0x17f 0x0 0x0 0x15f 0x0 0x0 0x13f 0x0 0x0 0x11f 0x0 0x0>;
						qcom,wf-pattern-period-us = <0x1a0b>;
						qcom,wf-vmax-mv = <0xe10>;
					};

					effect_4 {
						qcom,effect-id = <0x4>;
						qcom,wf-auto-res-disable;
						qcom,wf-brake-pattern = [00 00 00];
						qcom,wf-pattern-data = <0x1f 0x0 0x0 0x3f 0x0 0x0 0x5f 0x0 0x0 0x7f 0x0 0x0 0x17f 0x0 0x0 0x15f 0x0 0x0 0x13f 0x0 0x0 0x11f 0x0 0x0>;
						qcom,wf-pattern-period-us = <0x1a0b>;
						qcom,wf-vmax-mv = <0xe10>;
					};

					effect_5 {
						qcom,effect-id = <0x5>;
						qcom,wf-auto-res-disable;
						qcom,wf-brake-pattern = [00 00 00];
						qcom,wf-pattern-data = <0x1f 0x0 0x0 0x3f 0x0 0x0 0x5f 0x0 0x0 0x7f 0x0 0x0 0x17f 0x0 0x0 0x15f 0x0 0x0 0x13f 0x0 0x0 0x11f 0x0 0x0>;
						qcom,wf-pattern-period-us = <0x1a0b>;
						qcom,wf-vmax-mv = <0xe10>;
					};

					primitive_0 {
						qcom,primitive-id = <0x0>;
						qcom,wf-auto-res-disable;
						qcom,wf-brake-pattern = [00 00 00];
						qcom,wf-pattern-data = <0x0 0x0 0x0 0x0 0x0 0x0>;
						qcom,wf-pattern-period-us = <0x1047>;
						qcom,wf-vmax-mv = <0x12c0>;
					};

					primitive_1 {
						qcom,primitive-id = <0x1>;
						qcom,wf-auto-res-disable;
						qcom,wf-brake-pattern = [00 00 00];
						qcom,wf-pattern-data = <0xff 0x0 0x0 0x7f 0x0 0x0>;
						qcom,wf-pattern-period-us = <0x1047>;
						qcom,wf-vmax-mv = <0x12c0>;
					};

					primitive_2 {
						qcom,primitive-id = <0x2>;
						qcom,wf-auto-res-disable;
						qcom,wf-brake-pattern = [00 00 00];
						qcom,wf-pattern-data = <0xff 0x0 0x0 0x7f 0x0 0x0>;
						qcom,wf-pattern-period-us = <0x1047>;
						qcom,wf-vmax-mv = <0x12c0>;
					};

					primitive_3 {
						qcom,primitive-id = <0x3>;
						qcom,wf-auto-res-disable;
						qcom,wf-brake-pattern = [00 00 00];
						qcom,wf-pattern-data = <0xff 0x0 0x0 0x7f 0x0 0x0>;
						qcom,wf-pattern-period-us = <0x1047>;
						qcom,wf-vmax-mv = <0x12c0>;
					};

					primitive_4 {
						qcom,primitive-id = <0x4>;
						qcom,wf-auto-res-disable;
						qcom,wf-brake-pattern = [00 00 00];
						qcom,wf-pattern-data = <0xff 0x0 0x0 0x7f 0x0 0x0>;
						qcom,wf-pattern-period-us = <0x1047>;
						qcom,wf-vmax-mv = <0x12c0>;
					};

					primitive_5 {
						qcom,primitive-id = <0x5>;
						qcom,wf-auto-res-disable;
						qcom,wf-brake-pattern = [00 00 00];
						qcom,wf-pattern-data = <0xff 0x0 0x0 0x7f 0x0 0x0>;
						qcom,wf-pattern-period-us = <0x1047>;
						qcom,wf-vmax-mv = <0x12c0>;
					};

					primitive_6 {
						qcom,primitive-id = <0x6>;
						qcom,wf-auto-res-disable;
						qcom,wf-brake-pattern = [00 00 00];
						qcom,wf-pattern-data = <0xff 0x0 0x0 0x7f 0x0 0x0>;
						qcom,wf-pattern-period-us = <0x1047>;
						qcom,wf-vmax-mv = <0x12c0>;
					};

					primitive_7 {
						qcom,primitive-id = <0x7>;
						qcom,wf-auto-res-disable;
						qcom,wf-brake-pattern = [00 00 00];
						qcom,wf-pattern-data = <0xff 0x0 0x0 0x7f 0x0 0x0>;
						qcom,wf-pattern-period-us = <0x1047>;
						qcom,wf-vmax-mv = <0x12c0>;
					};

					primitive_8 {
						qcom,primitive-id = <0x8>;
						qcom,wf-auto-res-disable;
						qcom,wf-brake-pattern = [00 00 00];
						qcom,wf-pattern-data = <0xff 0x0 0x0 0x7f 0x0 0x0>;
						qcom,wf-pattern-period-us = <0x1047>;
						qcom,wf-vmax-mv = <0x12c0>;
					};

					qcom,hap-swr-slave-reg {
						phandle = <0x55>;
						regulator-name = "hap-swr-slave-reg";
					};
				};
			};
		};
	};

	fragment@30 {
		target = <0xffffffff>;

		__overlay__ {
			size = <0x0 0x4000000>;
		};
	};

	fragment@31 {
		target = <0xffffffff>;

		__overlay__ {
			size = <0x0 0x3800000>;
		};
	};

	fragment@32 {
		target = <0xffffffff>;

		__overlay__ {

			mi_ts_active {
				phandle = <0x34>;

				config {
					bias-pull-up;
					drive-strength = <0x8>;
					pins = "gpio25", "gpio24";
				};

				mux {
					function = "gpio";
					pins = "gpio25", "gpio24";
				};
			};

			mi_ts_cs_active {
				phandle = <0x31>;

				config {
					bias-pull-up;
					drive-strength = <0x6>;
					pins = "gpio47";
				};

				mux {
					function = "qup1_se4_l3";
					pins = "gpio47";
				};
			};

			mi_ts_cs_suspend {
				phandle = <0x33>;

				config {
					bias-pull-up;
					drive-strength = <0x6>;
					pins = "gpio47";
				};

				mux {
					function = "gpio";
					pins = "gpio47";
				};
			};

			mi_ts_spi_suspend {
				phandle = <0x32>;

				config {
					bias-disable;
					drive-strength = <0x6>;
					pins = "gpio44", "gpio45", "gpio46";
				};

				mux {
					function = "gpio";
					pins = "gpio44", "gpio45", "gpio46";
				};
			};

			rcv_gpio_high {
				phandle = <0x3d>;

				config {
					bias-pull-up;
					drive-strength = <0x2>;
					output-high;
					pins = "gpio68";
				};

				mux {
					function = "gpio";
					pins = "gpio68";
				};
			};

			rcv_gpio_low {
				phandle = <0x3e>;

				config {
					bias-disable;
					drive-strength = <0x2>;
					output-low;
					pins = "gpio68";
				};

				mux {
					function = "gpio";
					pins = "gpio68";
				};
			};
		};
	};

	fragment@33 {
		target = <0xffffffff>;

		__overlay__ {
			qcom,init-voltage = <0x30d400>;
			regulator-max-microvolt = <0x30d400>;
		};
	};

	fragment@34 {
		target = <0xffffffff>;

		__overlay__ {
			pinctrl-0 = <0xffffffff 0xffffffff 0xffffffff 0x31>;
			pinctrl-1 = <0x32 0x33>;
			qcom,rt;
			status = "ok";

			fts@0 {
				avdd-supply = <0xffffffff>;
				compatible = "st,spi";
				fts,bus-reg-name = "vdd";
				fts,config-array-size = <0x1>;
				fts,cornerfilter-area-step1 = <0x64>;
				fts,cornerfilter-area-step2 = <0x96>;
				fts,cornerfilter-area-step3 = <0xc8>;
				fts,default-fw-name = "st_fts_m3.ftb";
				fts,fod-lx = <0x1144>;
				fts,fod-ly = <0x5028>;
				fts,fod-x-size = <0x7a8>;
				fts,fod-y-size = <0x7a8>;
				fts,irq-flags = <0x2008>;
				fts,irq-gpio = <0xffffffff 0x19 0x2008>;
				fts,irq-gpio-name = "fts_irq";
				fts,pwr-reg-name = "avdd";
				fts,reset-gpio = <0xffffffff 0x18 0x0>;
				fts,reset-gpio-enable;
				fts,reset-gpio-name = "fts_rst";
				fts,support-fod;
				fts,support-super-resolution = <0x1>;
				fts,touch-aim-sensitivity = <0xa 0x8 0x6 0x4 0x2>;
				fts,touch-aim-sensitivity-def = <0x3>;
				fts,touch-cornerzone-filter-hor1 = <0x0 0x0 0x0 0x0 0x96 0x96 0x0 0x0 0x0 0x1 0x0 0x0 0x0 0x0 0x0 0x0 0x0 0x2 0x0 0x8c9 0x96 0x95f 0x0 0x0 0x0 0x3 0x0 0x0 0x0 0x0 0x0 0x0>;
				fts,touch-cornerzone-filter-hor2 = <0x0 0x0 0x0 0x0 0x0 0x0 0x0 0x0 0x0 0x1 0x3a1 0x0 0x437 0x96 0x0 0x0 0x0 0x2 0x0 0x0 0x0 0x0 0x0 0x0 0x0 0x3 0x3a1 0x8c9 0x437 0x95f 0x0 0x0>;
				fts,touch-cornerzone-filter-ver = <0x0 0x0 0x0 0x0 0x0 0x0 0x0 0x0 0x0 0x1 0x0 0x0 0x0 0x0 0x0 0x0 0x0 0x2 0x0 0x8b5 0x96 0x95f 0x0 0x0 0x0 0x3 0x3a1 0x8b5 0x437 0x95f 0x0 0x0>;
				fts,touch-deadzone-filter-hor = <0x2 0x0 0x0 0x0 0x0 0x0 0x0 0x0 0x2 0x1 0x0 0x0 0x0 0x0 0x0 0x0 0x2 0x2 0x0 0x0 0x0 0x0 0x0 0x0 0x2 0x3 0x0 0x0 0x0 0x0 0x0 0x0>;
				fts,touch-deadzone-filter-ver = <0x2 0x0 0x0 0x0 0x0 0x0 0x0 0x0 0x2 0x1 0x0 0x0 0x0 0x0 0x0 0x0 0x2 0x2 0x0 0x0 0x0 0x0 0x0 0x0 0x2 0x3 0x0 0x0 0x0 0x0 0x0 0x0>;
				fts,touch-edgezone-filter-hor = <0x1 0x0 0x0 0x0 0x437 0x23 0x0 0x0 0x1 0x1 0x0 0x93c 0x437 0x95f 0x0 0x0 0x1 0x2 0x0 0x0 0x14 0x95f 0x0 0x0 0x1 0x3 0x423 0x0 0x437 0x95f 0x0 0x0>;
				fts,touch-edgezone-filter-ver = <0x1 0x0 0x0 0x0 0x0 0x0 0x0 0x0 0x1 0x1 0x0 0x0 0x0 0x0 0x0 0x0 0x1 0x2 0x0 0x0 0x23 0x95f 0x0 0x0 0x1 0x3 0x414 0x0 0x437 0x95f 0x0 0x0>;
				fts,touch-expert-array = <0x6 0xf 0x1 0x78 0x6 0xf 0x2 0xf 0x1 0x78 0x4 0xf 0x4 0xf 0x1 0x78 0x2 0xf>;
				fts,touch-follow-performance = <0xa 0xf 0x1 0x8 0xf 0x1 0x6 0xf 0x1 0x4 0xf 0x1 0x2 0xf 0x1>;
				fts,touch-follow-performance-def = <0x3>;
				fts,touch-tap-sensitivity = <0xa0 0x96 0x8c 0x78 0x64>;
				fts,touch-tap-sensitivity-def = <0x4>;
				fts,touch-tap-stability = <0x8 0xc 0xf 0x12 0x19>;
				fts,touch-tap-stability-def = <0x3>;
				fts,x-max = <0x2a30>;
				fts,y-max = <0x5dc0>;
				interrupt-parent = <0xffffffff>;
				interrupts = <0x19 0x2008>;
				pinctrl-0 = <0x34>;
				pinctrl-1 = <0xffffffff 0xffffffff>;
				pinctrl-names = "pmx_ts_active", "pmx_ts_suspend";
				reg = <0x0>;
				spi-max-frequency = <0xb71b00>;
				status = "ok";
				vdd-supply = <0xffffffff>;

				fts,cfg_0 {
					fts,fw-name = "st_fts_m3.ftb";
					fts,limit-name = "stm_fts_production_limits.csv";
					fts,tp-vendor = <0x38>;
				};
			};
		};
	};

	fragment@35 {
		target = <0xffffffff>;

		__overlay__ {
			#address-cells = <0x1>;
			#size-cells = <0x0>;
			qcom,clk-freq-out = <0xf4240>;
			status = "ok";

			nq@28 {
				clock-names = "nfc_ref_clk";
				clocks = <0xffffffff 0x2>;
				compatible = "qcom,sn-nci";
				interrupt-names = "nfc_irq";
				interrupt-parent = <0xffffffff>;
				interrupts = <0x37 0x0>;
				pinctrl-0 = <0x35 0x36>;
				pinctrl-1 = <0x37 0x38>;
				pinctrl-names = "nfc_active", "nfc_suspend";
				qcom,sn-clkreq = <0xffffffff 0x1f 0x0>;
				qcom,sn-firm = <0xffffffff 0xc 0x0>;
				qcom,sn-irq = <0xffffffff 0x37 0x0>;
				qcom,sn-szone = "enable";
				qcom,sn-vdd-1p8-current = <0x26548>;
				qcom,sn-vdd-1p8-supply = <0xffffffff>;
				qcom,sn-vdd-1p8-voltage = <0x1adb00 0x1b7740>;
				qcom,sn-ven = <0xffffffff 0x1e 0x0>;
				reg = <0x28>;
			};
		};
	};

	fragment@36 {
		target = <0xffffffff>;

		__overlay__ {
			status = "ok";

			cs35l41@40 {
				cirrus,asp-sdout-hiz = <0x3>;
				cirrus,boost-cap-microfarad = <0xf>;
				cirrus,boost-ind-nanohenry = <0x3e8>;
				cirrus,boost-peak-milliamp = <0xfa0>;
				cirrus,fast-switch = "B-music.txt", "B-handfree.txt";
				cirrus,right-channel-amp;
				cirrus,temp-warn_threshold = <0x3>;
				compatible = "cirrus,cs35l41";
				interrupt-parent = <0xffffffff>;
				interrupts = <0x63 0x2008>;
				phandle = <0x8f>;
				pinctrl-0 = <0x39 0x3a>;
				pinctrl-names = "default";
				reg = <0x40>;
				reset-gpios = <0xffffffff 0xb7 0x0>;
				sound-name-prefix = [42 00];
				status = "ok";

				cirrus,gpio-config2 {
					cirrus,gpio-output-enable;
					cirrus,gpio-src-select = <0x4>;
				};
			};

			cs35l41@42 {
				cirrus,asp-sdout-hiz = <0x3>;
				cirrus,boost-cap-microfarad = <0xf>;
				cirrus,boost-ind-nanohenry = <0x3e8>;
				cirrus,boost-peak-milliamp = <0xfa0>;
				cirrus,fast-switch = "T-music.txt", "T-handset.txt", "T-handfree.txt";
				cirrus,temp-warn_threshold = <0x3>;
				compatible = "cirrus,cs35l41";
				interrupt-parent = <0xffffffff>;
				interrupts = <0x62 0x2008>;
				phandle = <0x90>;
				pinctrl-0 = <0x3b 0x3c>;
				pinctrl-1 = <0x3d>;
				pinctrl-2 = <0x3e>;
				pinctrl-names = "default", "rcv_gpio_high", "rcv_gpio_low";
				reg = <0x42>;
				reset-gpios = <0xffffffff 0xb6 0x0>;
				sound-name-prefix = [54 00];
				status = "ok";

				cirrus,gpio-config2 {
					cirrus,gpio-output-enable;
					cirrus,gpio-src-select = <0x4>;
				};
			};
		};
	};

	fragment@37 {
		target = <0xffffffff>;

		__overlay__ {

			charger_therm0 {
				polling-delay = <0x0>;
				polling-delay-passive = <0x0>;
				thermal-sensors = <0x1 0x149>;

				trips {

					active-config0 {
						hysteresis = <0x3e8>;
						temperature = <0x1e848>;
						type = "passive";
					};

					active-config1 {
						hysteresis = <0x3e8>;
						temperature = <0x1e848>;
						type = "passive";
					};
				};
			};

			conn_therm {
				polling-delay = <0x0>;
				polling-delay-passive = <0x0>;
				thermal-sensors = <0x1 0x747>;

				trips {

					active-config0 {
						hysteresis = <0x3e8>;
						temperature = <0x1e848>;
						type = "passive";
					};

					active-config1 {
						hysteresis = <0x3e8>;
						temperature = <0x1e848>;
						type = "passive";
					};
				};
			};

			cpu_therm {
				polling-delay = <0x0>;
				polling-delay-passive = <0x0>;
				thermal-sensors = <0x1 0x146>;

				trips {

					active-config0 {
						hysteresis = <0x3e8>;
						temperature = <0x1e848>;
						type = "passive";
					};

					active-config1 {
						hysteresis = <0x3e8>;
						temperature = <0x1e848>;
						type = "passive";
					};
				};
			};

			flash_therm {
				polling-delay = <0x0>;
				polling-delay-passive = <0x0>;
				thermal-sensors = <0x1 0x145>;

				trips {

					active-config0 {
						hysteresis = <0x3e8>;
						temperature = <0x1e848>;
						type = "passive";
					};

					active-config1 {
						hysteresis = <0x3e8>;
						temperature = <0x1e848>;
						type = "passive";
					};
				};
			};

			pa_therm0 {
				polling-delay = <0x0>;
				polling-delay-passive = <0x0>;
				thermal-sensors = <0x1 0x147>;

				trips {

					active-config0 {
						hysteresis = <0x3e8>;
						temperature = <0x1e848>;
						type = "passive";
					};

					active-config1 {
						hysteresis = <0x3e8>;
						temperature = <0x1e848>;
						type = "passive";
					};
				};
			};

			pa_therm1 {
				polling-delay = <0x0>;
				polling-delay-passive = <0x0>;
				thermal-sensors = <0x1 0x148>;

				trips {

					active-config0 {
						hysteresis = <0x3e8>;
						temperature = <0x1e848>;
						type = "passive";
					};

					active-config1 {
						hysteresis = <0x3e8>;
						temperature = <0x1e848>;
						type = "passive";
					};
				};
			};

			quiet_therm {
				polling-delay = <0x0>;
				polling-delay-passive = <0x0>;
				thermal-sensors = <0x1 0x144>;

				trips {

					active-config0 {
						hysteresis = <0x3e8>;
						temperature = <0x1e848>;
						type = "passive";
					};

					active-config1 {
						hysteresis = <0x3e8>;
						temperature = <0x1e848>;
						type = "passive";
					};
				};
			};

			wifi_therm {
				polling-delay = <0x0>;
				polling-delay-passive = <0x0>;
				thermal-sensors = <0x1 0x74d>;

				trips {

					active-config0 {
						hysteresis = <0x3e8>;
						temperature = <0x1e848>;
						type = "passive";
					};

					active-config1 {
						hysteresis = <0x3e8>;
						temperature = <0x1e848>;
						type = "passive";
					};
				};
			};

			wireless_therm {
				polling-delay = <0x0>;
				polling-delay-passive = <0x0>;
				thermal-sensors = <0x1 0x749>;

				trips {

					active-config0 {
						hysteresis = <0x3e8>;
						temperature = <0x1e848>;
						type = "passive";
					};

					active-config1 {
						hysteresis = <0x3e8>;
						temperature = <0x1e848>;
						type = "passive";
					};
				};
			};
		};
	};

	fragment@38 {
		target = <0xffffffff>;

		__overlay__ {

			thermal-message {
				board-sensor = "VIRTUAL-SENSOR0";
			};
		};
	};

	fragment@39 {
		target = <0xffffffff>;

		__overlay__ {
			mi,support-shutdown-delay;
			qcom,shutdown-voltage = <0xc4e>;
		};
	};

	fragment@4 {
		target = <0xffffffff>;

		__overlay__ {

			pm8550b-bcl-lvl0 {
				polling-delay = <0x0>;
				polling-delay-passive = <0x64>;
				thermal-sensors = <0xa 0x5>;

				trips {

					b-bcl-lvl0 {
						hysteresis = <0x1>;
						phandle = <0x1d>;
						temperature = <0x1>;
						type = "passive";
					};

					thermal-engine-trip {
						hysteresis = <0x0>;
						temperature = <0x64>;
						type = "passive";
					};

					thermal-hal-trip {
						hysteresis = <0x0>;
						temperature = <0x64>;
						type = "passive";
					};
				};
			};

			pm8550b-bcl-lvl1 {
				polling-delay = <0x0>;
				polling-delay-passive = <0x64>;
				thermal-sensors = <0xa 0x6>;

				trips {

					b-bcl-lvl1 {
						hysteresis = <0x1>;
						phandle = <0x1e>;
						temperature = <0x1>;
						type = "passive";
					};

					thermal-engine-trip {
						hysteresis = <0x0>;
						temperature = <0x64>;
						type = "passive";
					};

					thermal-hal-trip {
						hysteresis = <0x0>;
						temperature = <0x64>;
						type = "passive";
					};
				};
			};

			pm8550b-bcl-lvl2 {
				polling-delay = <0x0>;
				polling-delay-passive = <0x64>;
				thermal-sensors = <0xa 0x7>;

				trips {

					b-bcl-lvl2 {
						hysteresis = <0x1>;
						phandle = <0x1f>;
						temperature = <0x1>;
						type = "passive";
					};

					thermal-engine-trip {
						hysteresis = <0x0>;
						temperature = <0x64>;
						type = "passive";
					};

					thermal-hal-trip {
						hysteresis = <0x0>;
						temperature = <0x64>;
						type = "passive";
					};
				};
			};

			pm8550b-ibat-lvl0 {
				polling-delay = <0x0>;
				polling-delay-passive = <0x0>;
				thermal-sensors = <0xa 0x0>;

				trips {

					ibat-lvl0 {
						hysteresis = <0xc8>;
						phandle = <0x5c>;
						temperature = <0x2710>;
						type = "passive";
					};
				};
			};

			pm8550b-ibat-lvl1 {
				polling-delay = <0x0>;
				polling-delay-passive = <0x0>;
				thermal-sensors = <0xa 0x1>;

				trips {

					ibat-lvl1 {
						hysteresis = <0xc8>;
						phandle = <0x5d>;
						temperature = <0x2cec>;
						type = "passive";
					};
				};
			};

			pm8550b_lite_tz {
				phandle = <0x5b>;
				polling-delay = <0x0>;
				polling-delay-passive = <0x64>;
				thermal-governor = "step_wise";
				thermal-sensors = <0x9>;

				trips {

					trip0 {
						hysteresis = <0x0>;
						temperature = <0x1e848>;
						type = "passive";
					};

					trip1 {
						hysteresis = <0x0>;
						temperature = <0x20f58>;
						type = "passive";
					};

					trip2 {
						hysteresis = <0x0>;
						temperature = <0x23668>;
						type = "critical";
					};
				};
			};

			pm8550b_tz {
				phandle = <0x57>;
				polling-delay = <0x0>;
				polling-delay-passive = <0x64>;
				thermal-governor = "step_wise";
				thermal-sensors = <0x8>;

				trips {

					trip0 {
						hysteresis = <0x0>;
						phandle = <0x58>;
						temperature = <0x17318>;
						type = "passive";
					};

					trip1 {
						hysteresis = <0x0>;
						phandle = <0x59>;
						temperature = <0x1c138>;
						type = "passive";
					};

					trip2 {
						hysteresis = <0x0>;
						phandle = <0x5a>;
						temperature = <0x23668>;
						type = "critical";
					};
				};
			};

			socd {
				polling-delay = <0x0>;
				polling-delay-passive = <0x64>;

				trips {

					socd-trip {
						hysteresis = <0x0>;
						phandle = <0x1c>;
						temperature = <0x5a>;
						type = "passive";
					};

					thermal-engine-trip {
						hysteresis = <0x0>;
						temperature = <0x64>;
						type = "passive";
					};

					thermal-hal-trip {
						hysteresis = <0x0>;
						temperature = <0x64>;
						type = "passive";
					};
				};
			};
		};
	};

	fragment@40 {
		target = <0xffffffff>;

		__overlay__ {
			qcom,proxy-consumer-enable;
		};
	};

	fragment@5 {
		target = <0xffffffff>;

		__overlay__ {
			#address-cells = <0x2>;
			#interrupt-cells = <0x4>;
			#size-cells = <0x0>;
			interrupt-controller;

			qcom,pm8550ve_f@5 {
				#address-cells = <0x1>;
				#size-cells = <0x0>;
				compatible = "qcom,spmi-pmic";
				reg = <0x5 0x0>;

				pinctrl@8800 {
					#gpio-cells = <0x2>;
					#interrupt-cells = <0x2>;
					compatible = "qcom,pm8550ve-gpio";
					gpio-controller;
					interrupt-controller;
					phandle = <0x5e>;
					reg = <0x8800>;
				};

				pm8550ve-f-temp-alarm@a00 {
					#thermal-sensor-cells = <0x0>;
					compatible = "qcom,spmi-temp-alarm";
					interrupts = <0x5 0xa 0x0 0x3>;
					io-channel-names = "thermal";
					io-channels = <0x1 0x503>;
					phandle = <0xb>;
					reg = <0xa00>;
				};
			};
		};
	};

	fragment@6 {
		target = <0xffffffff>;

		__overlay__ {

			pm8550ve_f_tz {
				phandle = <0x5f>;
				polling-delay = <0x0>;
				polling-delay-passive = <0x64>;
				thermal-governor = "step_wise";
				thermal-sensors = <0xb>;

				trips {

					trip0 {
						hysteresis = <0x0>;
						phandle = <0x25>;
						temperature = <0x17318>;
						type = "passive";
					};

					trip1 {
						hysteresis = <0x0>;
						phandle = <0x60>;
						temperature = <0x1c138>;
						type = "passive";
					};

					trip2 {
						hysteresis = <0x0>;
						phandle = <0x61>;
						temperature = <0x23668>;
						type = "critical";
					};
				};
			};
		};
	};

	fragment@7 {
		target = <0xffffffff>;

		__overlay__ {
			#address-cells = <0x2>;
			#interrupt-cells = <0x4>;
			#size-cells = <0x0>;
			interrupt-controller;

			qcom,pm8550vs@2 {
				#address-cells = <0x1>;
				#size-cells = <0x0>;
				compatible = "qcom,spmi-pmic";
				phandle = <0x62>;
				reg = <0x2 0x0>;

				pinctrl@8800 {
					#gpio-cells = <0x2>;
					#interrupt-cells = <0x2>;
					compatible = "qcom,pm8550vs-gpio";
					gpio-controller;
					interrupt-controller;
					phandle = <0x63>;
					reg = <0x8800>;
				};

				pm8550vs-c-temp-alarm@a00 {
					#thermal-sensor-cells = <0x0>;
					compatible = "qcom,spmi-temp-alarm";
					interrupts = <0x2 0xa 0x0 0x3>;
					io-channel-names = "thermal";
					io-channels = <0x1 0x203>;
					phandle = <0xc>;
					reg = <0xa00>;
				};
			};

			qcom,pm8550vs@3 {
				#address-cells = <0x1>;
				#size-cells = <0x0>;
				compatible = "qcom,spmi-pmic";
				phandle = <0x64>;
				reg = <0x3 0x0>;
				status = "ok";

				pinctrl@8800 {
					#gpio-cells = <0x2>;
					#interrupt-cells = <0x2>;
					compatible = "qcom,pm8550vs-gpio";
					gpio-controller;
					interrupt-controller;
					phandle = <0x65>;
					reg = <0x8800>;

					eusb2_repeater_reset {

						eusb2_repeater_reset_default {
							bias-disable;
							function = "normal";
							input-enable;
							output-enable;
							phandle = <0x66>;
							pins = "gpio4";
							power-source = <0x1>;
							qcom,drive-strength = <0x2>;
						};
					};
				};

				pm8550vs-d-temp-alarm@a00 {
					#thermal-sensor-cells = <0x0>;
					compatible = "qcom,spmi-temp-alarm";
					interrupts = <0x3 0xa 0x0 0x3>;
					io-channel-names = "thermal";
					io-channels = <0x1 0x303>;
					phandle = <0xd>;
					reg = <0xa00>;
				};
			};

			qcom,pm8550vs@4 {
				#address-cells = <0x1>;
				#size-cells = <0x0>;
				compatible = "qcom,spmi-pmic";
				phandle = <0x67>;
				reg = <0x4 0x0>;
				status = "ok";

				pinctrl@8800 {
					#gpio-cells = <0x2>;
					#interrupt-cells = <0x2>;
					compatible = "qcom,pm8550vs-gpio";
					gpio-controller;
					interrupt-controller;
					phandle = <0x68>;
					reg = <0x8800>;
				};

				pm8550vs-e-temp-alarm@a00 {
					#thermal-sensor-cells = <0x0>;
					compatible = "qcom,spmi-temp-alarm";
					interrupts = <0x4 0xa 0x0 0x3>;
					io-channel-names = "thermal";
					io-channels = <0x1 0x403>;
					phandle = <0xe>;
					reg = <0xa00>;
				};
			};

			qcom,pm8550vs@6 {
				#address-cells = <0x1>;
				#size-cells = <0x0>;
				compatible = "qcom,spmi-pmic";
				phandle = <0x69>;
				reg = <0x6 0x0>;
				status = "ok";

				pinctrl@8800 {
					#gpio-cells = <0x2>;
					#interrupt-cells = <0x2>;
					compatible = "qcom,pm8550vs-gpio";
					gpio-controller;
					interrupt-controller;
					phandle = <0x6a>;
					reg = <0x8800>;
				};

				pm8550vs-g-temp-alarm@a00 {
					#thermal-sensor-cells = <0x0>;
					compatible = "qcom,spmi-temp-alarm";
					interrupts = <0x6 0xa 0x0 0x3>;
					io-channel-names = "thermal";
					io-channels = <0x1 0x603>;
					phandle = <0xf>;
					reg = <0xa00>;
				};
			};
		};
	};

	fragment@8 {
		target = <0xffffffff>;

		__overlay__ {

			pm8550vs_c_tz {
				phandle = <0x6b>;
				polling-delay = <0x0>;
				polling-delay-passive = <0x64>;
				thermal-governor = "step_wise";
				thermal-sensors = <0xc>;

				trips {

					trip0 {
						hysteresis = <0x0>;
						phandle = <0x23>;
						temperature = <0x17318>;
						type = "passive";
					};

					trip1 {
						hysteresis = <0x0>;
						phandle = <0x6c>;
						temperature = <0x1c138>;
						type = "passive";
					};

					trip2 {
						hysteresis = <0x0>;
						phandle = <0x6d>;
						temperature = <0x23668>;
						type = "critical";
					};
				};
			};

			pm8550vs_d_tz {
				phandle = <0x6e>;
				polling-delay = <0x0>;
				polling-delay-passive = <0x64>;
				status = "ok";
				thermal-governor = "step_wise";
				thermal-sensors = <0xd>;

				trips {

					trip0 {
						hysteresis = <0x0>;
						phandle = <0x24>;
						temperature = <0x17318>;
						type = "passive";
					};

					trip1 {
						hysteresis = <0x0>;
						phandle = <0x6f>;
						temperature = <0x1c138>;
						type = "passive";
					};

					trip2 {
						hysteresis = <0x0>;
						phandle = <0x70>;
						temperature = <0x23668>;
						type = "critical";
					};
				};
			};

			pm8550vs_e_tz {
				phandle = <0x71>;
				polling-delay = <0x0>;
				polling-delay-passive = <0x64>;
				status = "ok";
				thermal-governor = "step_wise";
				thermal-sensors = <0xe>;

				trips {

					trip0 {
						hysteresis = <0x0>;
						phandle = <0x72>;
						temperature = <0x17318>;
						type = "passive";
					};

					trip1 {
						hysteresis = <0x0>;
						phandle = <0x73>;
						temperature = <0x1c138>;
						type = "passive";
					};

					trip2 {
						hysteresis = <0x0>;
						phandle = <0x74>;
						temperature = <0x23668>;
						type = "critical";
					};
				};
			};

			pm8550vs_g_tz {
				phandle = <0x75>;
				polling-delay = <0x0>;
				polling-delay-passive = <0x64>;
				status = "ok";
				thermal-governor = "step_wise";
				thermal-sensors = <0xf>;

				trips {

					trip0 {
						hysteresis = <0x0>;
						phandle = <0x76>;
						temperature = <0x17318>;
						type = "passive";
					};

					trip1 {
						hysteresis = <0x0>;
						phandle = <0x77>;
						temperature = <0x1c138>;
						type = "passive";
					};

					trip2 {
						hysteresis = <0x0>;
						phandle = <0x78>;
						temperature = <0x23668>;
						type = "critical";
					};
				};
			};
		};
	};

	fragment@9 {
		target = <0xffffffff>;

		__overlay__ {
			#address-cells = <0x2>;
			#interrupt-cells = <0x4>;
			#size-cells = <0x0>;
			interrupt-controller;

			qcom,pmk8550@0 {
				#address-cells = <0x1>;
				#size-cells = <0x0>;
				compatible = "qcom,spmi-pmic";
				reg = <0x0 0x0>;

				pinctrl@b800 {
					#gpio-cells = <0x2>;
					#interrupt-cells = <0x2>;
					compatible = "qcom,pmk8550-gpio";
					gpio-controller;
					interrupt-controller;
					phandle = <0x7b>;
					pinctrl-0 = <0x10>;
					pinctrl-names = "default";
					reg = <0xb800>;

					alt_sleep_clk {

						alt_sleep_clk_default {
							bias-disable;
							function = "func1";
							input-disable;
							output-enable;
							phandle = <0x10>;
							pins = "gpio3";
							power-source = <0x0>;
						};
					};
				};

				pon_hlos@1300 {
					compatible = "qcom,pm8998-pon";
					reg = <0x1300 0x800>;
					reg-names = "pon_hlos", "pon_pbs";

					pwrkey {
						compatible = "qcom,pmk8350-pwrkey";
						interrupts = <0x0 0x13 0x7 0x3>;
						linux,code = <0x74>;
					};

					pwrkey-bark {
						compatible = "qcom,pmk8350-pwrkey-bark";
						interrupts = <0x0 0x13 0x0 0x3>;
						linux,code = <0x74>;
					};

					pwrkey-resin-bark {
						compatible = "qcom,pmk8350-pwrkey-resin-bark";
						interrupts = <0x0 0x13 0x2 0x3>;
						linux,code = <0x74>;
					};

					resin {
						compatible = "qcom,pmk8350-resin";
						interrupts = <0x0 0x13 0x6 0x3>;
						linux,code = <0x72>;
					};
				};

				rtc@6100 {
					compatible = "qcom,pmk8350-rtc";
					interrupts = <0x0 0x62 0x1 0x1>;
					phandle = <0x7c>;
					reg = <0x6100 0x6200>;
					reg-names = "rtc", "alarm";
				};

				sdam@7000 {
					#address-cells = <0x1>;
					#size-cells = <0x1>;
					compatible = "qcom,spmi-sdam";
					phandle = <0x79>;
					reg = <0x7000>;

					ocp-log@76 {
						phandle = <0x1b>;
						reg = <0x76 0x6>;
					};
				};

				sdam@7100 {
					#address-cells = <0x1>;
					#size-cells = <0x1>;
					compatible = "qcom,spmi-sdam";
					phandle = <0x7a>;
					reg = <0x7100>;

					restart@48 {
						bits = <0x1 0x7>;
						phandle = <0x17>;
						reg = <0x48 0x1>;
					};
				};

				sdam@7400 {
					compatible = "qcom,spmi-sdam";
					phandle = <0x19>;
					reg = <0x7400>;
				};

				sdam@7500 {
					compatible = "qcom,spmi-sdam";
					phandle = <0x1a>;
					reg = <0x7500>;
				};

				sdam@8400 {
					compatible = "qcom,spmi-sdam";
					phandle = <0x2>;
					reg = <0x8400>;
				};

				sdam@8500 {
					compatible = "qcom,spmi-sdam";
					phandle = <0x3>;
					reg = <0x8500>;
				};

				sdam@9d00 {
					compatible = "qcom,spmi-sdam";
					phandle = <0x7>;
					reg = <0x9d00>;
				};

				vadc@9000 {
					#address-cells = <0x1>;
					#io-channel-cells = <0x1>;
					#size-cells = <0x0>;
					#thermal-sensor-cells = <0x1>;
					compatible = "qcom,spmi-adc5-gen3";
					interrupt-names = "adc-sdam0", "adc-sdam1";
					interrupts = <0x0 0x90 0x1 0x1 0x0 0x91 0x1 0x1>;
					io-channel-ranges;
					phandle = <0x1>;
					pinctrl-0 = <0x11 0x12>;
					pinctrl-names = "default";
					reg = <0x9000 0x9100>;

					pm8550_cam_flash_therm {
						label = "pm8550_cam_flash_therm";
						qcom,adc-tm-type = <0x1>;
						qcom,hw-settle-time = <0xc8>;
						qcom,pre-scaling = <0x1 0x1>;
						qcom,ratiometric;
						reg = <0x145>;
					};

					pm8550_charger_therm0 {
						label = "pm8550_charger_therm0";
						qcom,adc-tm-type = <0x1>;
						qcom,hw-settle-time = <0xc8>;
						qcom,pre-scaling = <0x1 0x1>;
						qcom,ratiometric;
						reg = <0x149>;
					};

					pm8550_die_temp {
						label = "pm8550_die_temp";
						qcom,pre-scaling = <0x1 0x1>;
						reg = <0x103>;
					};

					pm8550_msm_therm {
						label = "pm8550_msm_therm";
						qcom,adc-tm-type = <0x1>;
						qcom,hw-settle-time = <0xc8>;
						qcom,pre-scaling = <0x1 0x1>;
						qcom,ratiometric;
						reg = <0x144>;
					};

					pm8550_offset_ref {
						label = "pm8550_offset_ref";
						qcom,pre-scaling = <0x1 0x1>;
						reg = <0x100>;
					};

					pm8550_pa_therm_1 {
						label = "pm8550_pa_therm_1";
						qcom,adc-tm-type = <0x1>;
						qcom,hw-settle-time = <0xc8>;
						qcom,pre-scaling = <0x1 0x1>;
						qcom,ratiometric;
						reg = <0x147>;
					};

					pm8550_rear_tof_therm {
						label = "pm8550_rear_tof_therm";
						qcom,adc-tm-type = <0x1>;
						qcom,hw-settle-time = <0xc8>;
						qcom,pre-scaling = <0x1 0x1>;
						qcom,ratiometric;
						reg = <0x148>;
					};

					pm8550_vph_pwr {
						label = "pm8550_vph_pwr";
						qcom,pre-scaling = <0x1 0x3>;
						reg = <0x18e>;
					};

					pm8550_vref_1p25 {
						label = "pm8550_vref_1p25";
						qcom,pre-scaling = <0x1 0x1>;
						reg = <0x101>;
					};

					pm8550_wlan_therm {
						label = "pm8550_wlan_therm";
						qcom,adc-tm-type = <0x1>;
						qcom,hw-settle-time = <0xc8>;
						qcom,pre-scaling = <0x1 0x1>;
						qcom,ratiometric;
						reg = <0x146>;
					};

					pm8550b_die_temp {
						label = "pm8550b_die_temp";
						qcom,pre-scaling = <0x1 0x1>;
						reg = <0x703>;
					};

					pm8550b_lite_die_temp {
						label = "pm8550b_lite_die_temp";
						qcom,pre-scaling = <0x1 0x1>;
						reg = <0x718>;
					};

					pm8550b_offset_ref {
						label = "pm8550b_offset_ref";
						qcom,pre-scaling = <0x1 0x1>;
						reg = <0x700>;
					};

					pm8550b_usb_therm {
						label = "pm8550b_usb_therm";
						qcom,adc-tm-type = <0x1>;
						qcom,hw-settle-time = <0xc8>;
						qcom,pre-scaling = <0x1 0x1>;
						qcom,ratiometric;
						reg = <0x747>;
					};

					pm8550b_vbat_sns_qbg {
						label = "pm8550b_vbat_sns_qbg";
						qcom,pre-scaling = <0x1 0x3>;
						reg = <0x78f>;
					};

					pm8550b_vph_pwr {
						label = "pm8550b_vph_pwr";
						qcom,pre-scaling = <0x1 0x3>;
						reg = <0x78e>;
					};

					pm8550b_vref_1p25 {
						label = "pm8550b_vref_1p25";
						qcom,pre-scaling = <0x1 0x1>;
						reg = <0x701>;
					};

					pm8550b_wifi_therm {
						label = "pm8550b_wifi_therm";
						qcom,adc-tm-type = <0x1>;
						qcom,hw-settle-time = <0xc8>;
						qcom,pre-scaling = <0x1 0x1>;
						qcom,ratiometric;
						reg = <0x74d>;
					};

					pm8550b_wls_therm {
						label = "pm8550b_wls_therm";
						qcom,adc-tm-type = <0x1>;
						qcom,hw-settle-time = <0xc8>;
						qcom,pre-scaling = <0x1 0x1>;
						qcom,ratiometric;
						reg = <0x749>;
					};

					pm8550ve_die_temp {
						label = "pm8550ve_die_temp";
						qcom,pre-scaling = <0x1 0x1>;
						reg = <0x503>;
					};

					pm8550vs_c_die_temp {
						label = "pm8550vs_c_die_temp";
						qcom,pre-scaling = <0x1 0x1>;
						reg = <0x203>;
					};

					pm8550vs_d_die_temp {
						label = "pm8550vs_d_die_temp";
						qcom,pre-scaling = <0x1 0x1>;
						reg = <0x303>;
					};

					pm8550vs_e_die_temp {
						label = "pm8550vs_e_die_temp";
						qcom,pre-scaling = <0x1 0x1>;
						reg = <0x403>;
					};

					pm8550vs_g_die_temp {
						label = "pm8550vs_g_die_temp";
						qcom,pre-scaling = <0x1 0x1>;
						reg = <0x603>;
					};

					pmk8550_die_temp {
						label = "pmk8550_die_temp";
						qcom,pre-scaling = <0x1 0x1>;
						reg = <0x3>;
					};

					pmk8550_offset_ref {
						label = "pmk8550_offset_ref";
						qcom,pre-scaling = <0x1 0x1>;
						reg = <0x0>;
					};

					pmk8550_vref_1p25 {
						label = "pmk8550_vref_1p25";
						qcom,pre-scaling = <0x1 0x1>;
						reg = <0x1>;
					};

					pmk8550_xo_therm {
						label = "pmk8550_xo_therm";
						qcom,adc-tm-type = <0x1>;
						qcom,hw-settle-time = <0xc8>;
						qcom,pre-scaling = <0x1 0x1>;
						qcom,ratiometric;
						reg = <0x44>;
					};
				};
			};
		};
	};
};
